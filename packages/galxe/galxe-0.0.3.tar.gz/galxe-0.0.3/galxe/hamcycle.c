/* Generated by Cython 0.25a0 */

/* BEGIN: Cython Metadata
{
    "distutils": {
        "depends": [
            "lib/include/ds_nblist.h", 
            "lib/include/graph.h"
        ], 
        "include_dirs": [
            "lib/include"
        ], 
        "language": "c", 
        "libraries": [
            "galxe_support"
        ]
    }, 
    "module_name": "galxe.hamcycle"
}
END: Cython Metadata */

#define PY_SSIZE_T_CLEAN
#include "Python.h"
#ifndef Py_PYTHON_H
    #error Python headers needed to compile C extensions, please install development version of Python.
#elif PY_VERSION_HEX < 0x02060000 || (0x03000000 <= PY_VERSION_HEX && PY_VERSION_HEX < 0x03020000)
    #error Cython requires Python 2.6+ or Python 3.2+.
#else
#define CYTHON_ABI "0_25a0"
#include <stddef.h>
#ifndef offsetof
  #define offsetof(type, member) ( (size_t) & ((type*)0) -> member )
#endif
#if !defined(WIN32) && !defined(MS_WINDOWS)
  #ifndef __stdcall
    #define __stdcall
  #endif
  #ifndef __cdecl
    #define __cdecl
  #endif
  #ifndef __fastcall
    #define __fastcall
  #endif
#endif
#ifndef DL_IMPORT
  #define DL_IMPORT(t) t
#endif
#ifndef DL_EXPORT
  #define DL_EXPORT(t) t
#endif
#ifndef PY_LONG_LONG
  #define PY_LONG_LONG LONG_LONG
#endif
#ifndef Py_HUGE_VAL
  #define Py_HUGE_VAL HUGE_VAL
#endif
#ifdef PYPY_VERSION
  #define CYTHON_COMPILING_IN_PYPY 1
  #define CYTHON_COMPILING_IN_CPYTHON 0
  #undef CYTHON_USE_TYPE_SLOTS
  #define CYTHON_USE_TYPE_SLOTS 0
  #undef CYTHON_USE_ASYNC_SLOTS
  #define CYTHON_USE_ASYNC_SLOTS 0
  #undef CYTHON_USE_PYLIST_INTERNALS
  #define CYTHON_USE_PYLIST_INTERNALS 0
  #undef CYTHON_USE_UNICODE_INTERNALS
  #define CYTHON_USE_UNICODE_INTERNALS 0
  #undef CYTHON_USE_PYLONG_INTERNALS
  #define CYTHON_USE_PYLONG_INTERNALS 0
  #undef CYTHON_AVOID_BORROWED_REFS
  #define CYTHON_AVOID_BORROWED_REFS 1
  #undef CYTHON_ASSUME_SAFE_MACROS
  #define CYTHON_ASSUME_SAFE_MACROS 0
  #undef CYTHON_UNPACK_METHODS
  #define CYTHON_UNPACK_METHODS 0
  #undef CYTHON_FAST_THREAD_STATE
  #define CYTHON_FAST_THREAD_STATE 0
#else
  #define CYTHON_COMPILING_IN_PYPY 0
  #define CYTHON_COMPILING_IN_CPYTHON 1
  #ifndef CYTHON_USE_TYPE_SLOTS
    #define CYTHON_USE_TYPE_SLOTS 1
  #endif
  #if PY_MAJOR_VERSION < 3
    #undef CYTHON_USE_ASYNC_SLOTS
    #define CYTHON_USE_ASYNC_SLOTS 0
  #elif !defined(CYTHON_USE_ASYNC_SLOTS)
    #define CYTHON_USE_ASYNC_SLOTS 1
  #endif
  #if PY_VERSION_HEX < 0x02070000
    #undef CYTHON_USE_PYLONG_INTERNALS
    #define CYTHON_USE_PYLONG_INTERNALS 0
  #elif !defined(CYTHON_USE_PYLONG_INTERNALS)
    #define CYTHON_USE_PYLONG_INTERNALS 1
  #endif
  #ifndef CYTHON_USE_PYLIST_INTERNALS
    #define CYTHON_USE_PYLIST_INTERNALS 1
  #endif
  #ifndef CYTHON_USE_UNICODE_INTERNALS
    #define CYTHON_USE_UNICODE_INTERNALS 1
  #endif
  #ifndef CYTHON_AVOID_BORROWED_REFS
    #define CYTHON_AVOID_BORROWED_REFS 0
  #endif
  #ifndef CYTHON_ASSUME_SAFE_MACROS
    #define CYTHON_ASSUME_SAFE_MACROS 1
  #endif
  #ifndef CYTHON_UNPACK_METHODS
    #define CYTHON_UNPACK_METHODS 1
  #endif
  #ifndef CYTHON_FAST_THREAD_STATE
    #define CYTHON_FAST_THREAD_STATE 1
  #endif
#endif
#if CYTHON_USE_PYLONG_INTERNALS
  #include "longintrepr.h"
  #undef SHIFT
  #undef BASE
  #undef MASK
#endif
#if CYTHON_COMPILING_IN_PYPY && PY_VERSION_HEX < 0x02070600 && !defined(Py_OptimizeFlag)
  #define Py_OptimizeFlag 0
#endif
#define __PYX_BUILD_PY_SSIZE_T "n"
#define CYTHON_FORMAT_SSIZE_T "z"
#if PY_MAJOR_VERSION < 3
  #define __Pyx_BUILTIN_MODULE_NAME "__builtin__"
  #define __Pyx_PyCode_New(a, k, l, s, f, code, c, n, v, fv, cell, fn, name, fline, lnos)\
          PyCode_New(a+k, l, s, f, code, c, n, v, fv, cell, fn, name, fline, lnos)
  #define __Pyx_DefaultClassType PyClass_Type
#else
  #define __Pyx_BUILTIN_MODULE_NAME "builtins"
  #define __Pyx_PyCode_New(a, k, l, s, f, code, c, n, v, fv, cell, fn, name, fline, lnos)\
          PyCode_New(a, k, l, s, f, code, c, n, v, fv, cell, fn, name, fline, lnos)
  #define __Pyx_DefaultClassType PyType_Type
#endif
#ifndef Py_TPFLAGS_CHECKTYPES
  #define Py_TPFLAGS_CHECKTYPES 0
#endif
#ifndef Py_TPFLAGS_HAVE_INDEX
  #define Py_TPFLAGS_HAVE_INDEX 0
#endif
#ifndef Py_TPFLAGS_HAVE_NEWBUFFER
  #define Py_TPFLAGS_HAVE_NEWBUFFER 0
#endif
#ifndef Py_TPFLAGS_HAVE_FINALIZE
  #define Py_TPFLAGS_HAVE_FINALIZE 0
#endif
#if PY_VERSION_HEX > 0x03030000 && defined(PyUnicode_KIND)
  #define CYTHON_PEP393_ENABLED 1
  #define __Pyx_PyUnicode_READY(op)       (likely(PyUnicode_IS_READY(op)) ?\
                                              0 : _PyUnicode_Ready((PyObject *)(op)))
  #define __Pyx_PyUnicode_GET_LENGTH(u)   PyUnicode_GET_LENGTH(u)
  #define __Pyx_PyUnicode_READ_CHAR(u, i) PyUnicode_READ_CHAR(u, i)
  #define __Pyx_PyUnicode_KIND(u)         PyUnicode_KIND(u)
  #define __Pyx_PyUnicode_DATA(u)         PyUnicode_DATA(u)
  #define __Pyx_PyUnicode_READ(k, d, i)   PyUnicode_READ(k, d, i)
  #define __Pyx_PyUnicode_WRITE(k, d, i, ch)  PyUnicode_WRITE(k, d, i, ch)
  #define __Pyx_PyUnicode_IS_TRUE(u)      (0 != (likely(PyUnicode_IS_READY(u)) ? PyUnicode_GET_LENGTH(u) : PyUnicode_GET_SIZE(u)))
#else
  #define CYTHON_PEP393_ENABLED 0
  #define PyUnicode_1BYTE_KIND  1
  #define PyUnicode_2BYTE_KIND  2
  #define PyUnicode_4BYTE_KIND  4
  #define __Pyx_PyUnicode_READY(op)       (0)
  #define __Pyx_PyUnicode_GET_LENGTH(u)   PyUnicode_GET_SIZE(u)
  #define __Pyx_PyUnicode_READ_CHAR(u, i) ((Py_UCS4)(PyUnicode_AS_UNICODE(u)[i]))
  #define __Pyx_PyUnicode_KIND(u)         (sizeof(Py_UNICODE))
  #define __Pyx_PyUnicode_DATA(u)         ((void*)PyUnicode_AS_UNICODE(u))
  #define __Pyx_PyUnicode_READ(k, d, i)   ((void)(k), (Py_UCS4)(((Py_UNICODE*)d)[i]))
  #define __Pyx_PyUnicode_WRITE(k, d, i, ch)  (((void)(k)), ((Py_UNICODE*)d)[i] = ch)
  #define __Pyx_PyUnicode_IS_TRUE(u)      (0 != PyUnicode_GET_SIZE(u))
#endif
#if CYTHON_COMPILING_IN_PYPY
  #define __Pyx_PyUnicode_Concat(a, b)      PyNumber_Add(a, b)
  #define __Pyx_PyUnicode_ConcatSafe(a, b)  PyNumber_Add(a, b)
#else
  #define __Pyx_PyUnicode_Concat(a, b)      PyUnicode_Concat(a, b)
  #define __Pyx_PyUnicode_ConcatSafe(a, b)  ((unlikely((a) == Py_None) || unlikely((b) == Py_None)) ?\
      PyNumber_Add(a, b) : __Pyx_PyUnicode_Concat(a, b))
#endif
#if CYTHON_COMPILING_IN_PYPY && !defined(PyUnicode_Contains)
  #define PyUnicode_Contains(u, s)  PySequence_Contains(u, s)
#endif
#if CYTHON_COMPILING_IN_PYPY && !defined(PyByteArray_Check)
  #define PyByteArray_Check(obj)  PyObject_TypeCheck(obj, &PyByteArray_Type)
#endif
#if CYTHON_COMPILING_IN_PYPY && !defined(PyObject_Format)
  #define PyObject_Format(obj, fmt)  PyObject_CallMethod(obj, "__format__", "O", fmt)
#endif
#if CYTHON_COMPILING_IN_PYPY && !defined(PyObject_Malloc)
  #define PyObject_Malloc(s)   PyMem_Malloc(s)
  #define PyObject_Free(p)     PyMem_Free(p)
  #define PyObject_Realloc(p)  PyMem_Realloc(p)
#endif
#define __Pyx_PyCode_HasFreeVars(co)  (PyCode_GetNumFree(co) > 0)
#define __Pyx_PyFrame_SetLineNumber(frame, lineno)  (frame)->f_lineno = (lineno)
#define __Pyx_PyString_FormatSafe(a, b)   ((unlikely((a) == Py_None)) ? PyNumber_Remainder(a, b) : __Pyx_PyString_Format(a, b))
#define __Pyx_PyUnicode_FormatSafe(a, b)  ((unlikely((a) == Py_None)) ? PyNumber_Remainder(a, b) : PyUnicode_Format(a, b))
#if PY_MAJOR_VERSION >= 3
  #define __Pyx_PyString_Format(a, b)  PyUnicode_Format(a, b)
#else
  #define __Pyx_PyString_Format(a, b)  PyString_Format(a, b)
#endif
#if PY_MAJOR_VERSION < 3 && !defined(PyObject_ASCII)
  #define PyObject_ASCII(o)            PyObject_Repr(o)
#endif
#if PY_MAJOR_VERSION >= 3
  #define PyBaseString_Type            PyUnicode_Type
  #define PyStringObject               PyUnicodeObject
  #define PyString_Type                PyUnicode_Type
  #define PyString_Check               PyUnicode_Check
  #define PyString_CheckExact          PyUnicode_CheckExact
#endif
#if PY_MAJOR_VERSION >= 3
  #define __Pyx_PyBaseString_Check(obj) PyUnicode_Check(obj)
  #define __Pyx_PyBaseString_CheckExact(obj) PyUnicode_CheckExact(obj)
#else
  #define __Pyx_PyBaseString_Check(obj) (PyString_Check(obj) || PyUnicode_Check(obj))
  #define __Pyx_PyBaseString_CheckExact(obj) (PyString_CheckExact(obj) || PyUnicode_CheckExact(obj))
#endif
#ifndef PySet_CheckExact
  #define PySet_CheckExact(obj)        (Py_TYPE(obj) == &PySet_Type)
#endif
#define __Pyx_TypeCheck(obj, type) PyObject_TypeCheck(obj, (PyTypeObject *)type)
#if PY_MAJOR_VERSION >= 3
  #define PyIntObject                  PyLongObject
  #define PyInt_Type                   PyLong_Type
  #define PyInt_Check(op)              PyLong_Check(op)
  #define PyInt_CheckExact(op)         PyLong_CheckExact(op)
  #define PyInt_FromString             PyLong_FromString
  #define PyInt_FromUnicode            PyLong_FromUnicode
  #define PyInt_FromLong               PyLong_FromLong
  #define PyInt_FromSize_t             PyLong_FromSize_t
  #define PyInt_FromSsize_t            PyLong_FromSsize_t
  #define PyInt_AsLong                 PyLong_AsLong
  #define PyInt_AS_LONG                PyLong_AS_LONG
  #define PyInt_AsSsize_t              PyLong_AsSsize_t
  #define PyInt_AsUnsignedLongMask     PyLong_AsUnsignedLongMask
  #define PyInt_AsUnsignedLongLongMask PyLong_AsUnsignedLongLongMask
  #define PyNumber_Int                 PyNumber_Long
#endif
#if PY_MAJOR_VERSION >= 3
  #define PyBoolObject                 PyLongObject
#endif
#if PY_MAJOR_VERSION >= 3 && CYTHON_COMPILING_IN_PYPY
  #ifndef PyUnicode_InternFromString
    #define PyUnicode_InternFromString(s) PyUnicode_FromString(s)
  #endif
#endif
#if PY_VERSION_HEX < 0x030200A4
  typedef long Py_hash_t;
  #define __Pyx_PyInt_FromHash_t PyInt_FromLong
  #define __Pyx_PyInt_AsHash_t   PyInt_AsLong
#else
  #define __Pyx_PyInt_FromHash_t PyInt_FromSsize_t
  #define __Pyx_PyInt_AsHash_t   PyInt_AsSsize_t
#endif
#if PY_MAJOR_VERSION >= 3
  #define __Pyx_PyMethod_New(func, self, klass) ((self) ? PyMethod_New(func, self) : PyInstanceMethod_New(func))
#else
  #define __Pyx_PyMethod_New(func, self, klass) PyMethod_New(func, self, klass)
#endif
#if CYTHON_USE_ASYNC_SLOTS
  #if PY_VERSION_HEX >= 0x030500B1
    #define __Pyx_PyAsyncMethodsStruct PyAsyncMethods
    #define __Pyx_PyType_AsAsync(obj) (Py_TYPE(obj)->tp_as_async)
  #else
    typedef struct {
        unaryfunc am_await;
        unaryfunc am_aiter;
        unaryfunc am_anext;
    } __Pyx_PyAsyncMethodsStruct;
    #define __Pyx_PyType_AsAsync(obj) ((__Pyx_PyAsyncMethodsStruct*) (Py_TYPE(obj)->tp_reserved))
  #endif
#else
  #define __Pyx_PyType_AsAsync(obj) NULL
#endif
#ifndef CYTHON_RESTRICT
  #if defined(__GNUC__)
    #define CYTHON_RESTRICT __restrict__
  #elif defined(_MSC_VER) && _MSC_VER >= 1400
    #define CYTHON_RESTRICT __restrict
  #elif defined (__STDC_VERSION__) && __STDC_VERSION__ >= 199901L
    #define CYTHON_RESTRICT restrict
  #else
    #define CYTHON_RESTRICT
  #endif
#endif
#define __Pyx_void_to_None(void_result) ((void)(void_result), Py_INCREF(Py_None), Py_None)

#ifndef CYTHON_INLINE
  #if defined(__GNUC__)
    #define CYTHON_INLINE __inline__
  #elif defined(_MSC_VER)
    #define CYTHON_INLINE __inline
  #elif defined (__STDC_VERSION__) && __STDC_VERSION__ >= 199901L
    #define CYTHON_INLINE inline
  #else
    #define CYTHON_INLINE
  #endif
#endif

#if defined(WIN32) || defined(MS_WINDOWS)
  #define _USE_MATH_DEFINES
#endif
#include <math.h>
#ifdef NAN
#define __PYX_NAN() ((float) NAN)
#else
static CYTHON_INLINE float __PYX_NAN() {
  float value;
  memset(&value, 0xFF, sizeof(value));
  return value;
}
#endif
#if defined(__CYGWIN__) && defined(_LDBL_EQ_DBL)
#define __Pyx_truncl trunc
#else
#define __Pyx_truncl truncl
#endif


#define __PYX_ERR(f_index, lineno, Ln_error) \
{ \
  __pyx_filename = __pyx_f[f_index]; __pyx_lineno = lineno; __pyx_clineno = __LINE__; goto Ln_error; \
}

#if PY_MAJOR_VERSION >= 3
  #define __Pyx_PyNumber_Divide(x,y)         PyNumber_TrueDivide(x,y)
  #define __Pyx_PyNumber_InPlaceDivide(x,y)  PyNumber_InPlaceTrueDivide(x,y)
#else
  #define __Pyx_PyNumber_Divide(x,y)         PyNumber_Divide(x,y)
  #define __Pyx_PyNumber_InPlaceDivide(x,y)  PyNumber_InPlaceDivide(x,y)
#endif

#ifndef __PYX_EXTERN_C
  #ifdef __cplusplus
    #define __PYX_EXTERN_C extern "C"
  #else
    #define __PYX_EXTERN_C extern
  #endif
#endif

#define __PYX_HAVE__galxe__hamcycle
#define __PYX_HAVE_API__galxe__hamcycle
#include "graph.h"
#ifdef _OPENMP
#include <omp.h>
#endif /* _OPENMP */

#ifdef PYREX_WITHOUT_ASSERTIONS
#define CYTHON_WITHOUT_ASSERTIONS
#endif

#ifndef CYTHON_UNUSED
# if defined(__GNUC__)
#   if !(defined(__cplusplus)) || (__GNUC__ > 3 || (__GNUC__ == 3 && __GNUC_MINOR__ >= 4))
#     define CYTHON_UNUSED __attribute__ ((__unused__))
#   else
#     define CYTHON_UNUSED
#   endif
# elif defined(__ICC) || (defined(__INTEL_COMPILER) && !defined(_MSC_VER))
#   define CYTHON_UNUSED __attribute__ ((__unused__))
# else
#   define CYTHON_UNUSED
# endif
#endif
#ifndef CYTHON_NCP_UNUSED
# if CYTHON_COMPILING_IN_CPYTHON
#  define CYTHON_NCP_UNUSED
# else
#  define CYTHON_NCP_UNUSED CYTHON_UNUSED
# endif
#endif
typedef struct {PyObject **p; const char *s; const Py_ssize_t n; const char* encoding;
                const char is_unicode; const char is_str; const char intern; } __Pyx_StringTabEntry;

#define __PYX_DEFAULT_STRING_ENCODING_IS_ASCII 0
#define __PYX_DEFAULT_STRING_ENCODING_IS_DEFAULT 0
#define __PYX_DEFAULT_STRING_ENCODING ""
#define __Pyx_PyObject_FromString __Pyx_PyBytes_FromString
#define __Pyx_PyObject_FromStringAndSize __Pyx_PyBytes_FromStringAndSize
#define __Pyx_uchar_cast(c) ((unsigned char)c)
#define __Pyx_long_cast(x) ((long)x)
#define __Pyx_fits_Py_ssize_t(v, type, is_signed)  (\
    (sizeof(type) < sizeof(Py_ssize_t))  ||\
    (sizeof(type) > sizeof(Py_ssize_t) &&\
          likely(v < (type)PY_SSIZE_T_MAX ||\
                 v == (type)PY_SSIZE_T_MAX)  &&\
          (!is_signed || likely(v > (type)PY_SSIZE_T_MIN ||\
                                v == (type)PY_SSIZE_T_MIN)))  ||\
    (sizeof(type) == sizeof(Py_ssize_t) &&\
          (is_signed || likely(v < (type)PY_SSIZE_T_MAX ||\
                               v == (type)PY_SSIZE_T_MAX)))  )
#if defined (__cplusplus) && __cplusplus >= 201103L
    #include <cstdlib>
    #define __Pyx_sst_abs(value) std::abs(value)
#elif SIZEOF_INT >= SIZEOF_SIZE_T
    #define __Pyx_sst_abs(value) abs(value)
#elif SIZEOF_LONG >= SIZEOF_SIZE_T
    #define __Pyx_sst_abs(value) labs(value)
#elif defined (_MSC_VER) && defined (_M_X64)
    #define __Pyx_sst_abs(value) _abs64(value)
#elif defined (__STDC_VERSION__) && __STDC_VERSION__ >= 199901L
    #define __Pyx_sst_abs(value) llabs(value)
#elif defined (__GNUC__)
    #define __Pyx_sst_abs(value) __builtin_llabs(value)
#else
    #define __Pyx_sst_abs(value) ((value<0) ? -value : value)
#endif
static CYTHON_INLINE char* __Pyx_PyObject_AsString(PyObject*);
static CYTHON_INLINE char* __Pyx_PyObject_AsStringAndSize(PyObject*, Py_ssize_t* length);
#define __Pyx_PyByteArray_FromString(s) PyByteArray_FromStringAndSize((const char*)s, strlen((const char*)s))
#define __Pyx_PyByteArray_FromStringAndSize(s, l) PyByteArray_FromStringAndSize((const char*)s, l)
#define __Pyx_PyBytes_FromString        PyBytes_FromString
#define __Pyx_PyBytes_FromStringAndSize PyBytes_FromStringAndSize
static CYTHON_INLINE PyObject* __Pyx_PyUnicode_FromString(const char*);
#if PY_MAJOR_VERSION < 3
    #define __Pyx_PyStr_FromString        __Pyx_PyBytes_FromString
    #define __Pyx_PyStr_FromStringAndSize __Pyx_PyBytes_FromStringAndSize
#else
    #define __Pyx_PyStr_FromString        __Pyx_PyUnicode_FromString
    #define __Pyx_PyStr_FromStringAndSize __Pyx_PyUnicode_FromStringAndSize
#endif
#define __Pyx_PyObject_AsSString(s)    ((signed char*) __Pyx_PyObject_AsString(s))
#define __Pyx_PyObject_AsUString(s)    ((unsigned char*) __Pyx_PyObject_AsString(s))
#define __Pyx_PyObject_FromCString(s)  __Pyx_PyObject_FromString((const char*)s)
#define __Pyx_PyBytes_FromCString(s)   __Pyx_PyBytes_FromString((const char*)s)
#define __Pyx_PyByteArray_FromCString(s)   __Pyx_PyByteArray_FromString((const char*)s)
#define __Pyx_PyStr_FromCString(s)     __Pyx_PyStr_FromString((const char*)s)
#define __Pyx_PyUnicode_FromCString(s) __Pyx_PyUnicode_FromString((const char*)s)
#if PY_MAJOR_VERSION < 3
static CYTHON_INLINE size_t __Pyx_Py_UNICODE_strlen(const Py_UNICODE *u)
{
    const Py_UNICODE *u_end = u;
    while (*u_end++) ;
    return (size_t)(u_end - u - 1);
}
#else
#define __Pyx_Py_UNICODE_strlen Py_UNICODE_strlen
#endif
#define __Pyx_PyUnicode_FromUnicode(u)       PyUnicode_FromUnicode(u, __Pyx_Py_UNICODE_strlen(u))
#define __Pyx_PyUnicode_FromUnicodeAndLength PyUnicode_FromUnicode
#define __Pyx_PyUnicode_AsUnicode            PyUnicode_AsUnicode
#define __Pyx_NewRef(obj) (Py_INCREF(obj), obj)
#define __Pyx_Owned_Py_None(b) __Pyx_NewRef(Py_None)
#define __Pyx_PyBool_FromLong(b) ((b) ? __Pyx_NewRef(Py_True) : __Pyx_NewRef(Py_False))
static CYTHON_INLINE int __Pyx_PyObject_IsTrue(PyObject*);
static CYTHON_INLINE PyObject* __Pyx_PyNumber_IntOrLong(PyObject* x);
static CYTHON_INLINE Py_ssize_t __Pyx_PyIndex_AsSsize_t(PyObject*);
static CYTHON_INLINE PyObject * __Pyx_PyInt_FromSize_t(size_t);
#if CYTHON_ASSUME_SAFE_MACROS
#define __pyx_PyFloat_AsDouble(x) (PyFloat_CheckExact(x) ? PyFloat_AS_DOUBLE(x) : PyFloat_AsDouble(x))
#else
#define __pyx_PyFloat_AsDouble(x) PyFloat_AsDouble(x)
#endif
#define __pyx_PyFloat_AsFloat(x) ((float) __pyx_PyFloat_AsDouble(x))
#if PY_MAJOR_VERSION >= 3
#define __Pyx_PyNumber_Int(x) (PyLong_CheckExact(x) ? __Pyx_NewRef(x) : PyNumber_Long(x))
#else
#define __Pyx_PyNumber_Int(x) (PyInt_CheckExact(x) ? __Pyx_NewRef(x) : PyNumber_Int(x))
#endif
#define __Pyx_PyNumber_Float(x) (PyFloat_CheckExact(x) ? __Pyx_NewRef(x) : PyNumber_Float(x))
#if PY_MAJOR_VERSION < 3 && __PYX_DEFAULT_STRING_ENCODING_IS_ASCII
static int __Pyx_sys_getdefaultencoding_not_ascii;
static int __Pyx_init_sys_getdefaultencoding_params(void) {
    PyObject* sys;
    PyObject* default_encoding = NULL;
    PyObject* ascii_chars_u = NULL;
    PyObject* ascii_chars_b = NULL;
    const char* default_encoding_c;
    sys = PyImport_ImportModule("sys");
    if (!sys) goto bad;
    default_encoding = PyObject_CallMethod(sys, (char*) "getdefaultencoding", NULL);
    Py_DECREF(sys);
    if (!default_encoding) goto bad;
    default_encoding_c = PyBytes_AsString(default_encoding);
    if (!default_encoding_c) goto bad;
    if (strcmp(default_encoding_c, "ascii") == 0) {
        __Pyx_sys_getdefaultencoding_not_ascii = 0;
    } else {
        char ascii_chars[128];
        int c;
        for (c = 0; c < 128; c++) {
            ascii_chars[c] = c;
        }
        __Pyx_sys_getdefaultencoding_not_ascii = 1;
        ascii_chars_u = PyUnicode_DecodeASCII(ascii_chars, 128, NULL);
        if (!ascii_chars_u) goto bad;
        ascii_chars_b = PyUnicode_AsEncodedString(ascii_chars_u, default_encoding_c, NULL);
        if (!ascii_chars_b || !PyBytes_Check(ascii_chars_b) || memcmp(ascii_chars, PyBytes_AS_STRING(ascii_chars_b), 128) != 0) {
            PyErr_Format(
                PyExc_ValueError,
                "This module compiled with c_string_encoding=ascii, but default encoding '%.200s' is not a superset of ascii.",
                default_encoding_c);
            goto bad;
        }
        Py_DECREF(ascii_chars_u);
        Py_DECREF(ascii_chars_b);
    }
    Py_DECREF(default_encoding);
    return 0;
bad:
    Py_XDECREF(default_encoding);
    Py_XDECREF(ascii_chars_u);
    Py_XDECREF(ascii_chars_b);
    return -1;
}
#endif
#if __PYX_DEFAULT_STRING_ENCODING_IS_DEFAULT && PY_MAJOR_VERSION >= 3
#define __Pyx_PyUnicode_FromStringAndSize(c_str, size) PyUnicode_DecodeUTF8(c_str, size, NULL)
#else
#define __Pyx_PyUnicode_FromStringAndSize(c_str, size) PyUnicode_Decode(c_str, size, __PYX_DEFAULT_STRING_ENCODING, NULL)
#if __PYX_DEFAULT_STRING_ENCODING_IS_DEFAULT
static char* __PYX_DEFAULT_STRING_ENCODING;
static int __Pyx_init_sys_getdefaultencoding_params(void) {
    PyObject* sys;
    PyObject* default_encoding = NULL;
    char* default_encoding_c;
    sys = PyImport_ImportModule("sys");
    if (!sys) goto bad;
    default_encoding = PyObject_CallMethod(sys, (char*) (const char*) "getdefaultencoding", NULL);
    Py_DECREF(sys);
    if (!default_encoding) goto bad;
    default_encoding_c = PyBytes_AsString(default_encoding);
    if (!default_encoding_c) goto bad;
    __PYX_DEFAULT_STRING_ENCODING = (char*) malloc(strlen(default_encoding_c));
    if (!__PYX_DEFAULT_STRING_ENCODING) goto bad;
    strcpy(__PYX_DEFAULT_STRING_ENCODING, default_encoding_c);
    Py_DECREF(default_encoding);
    return 0;
bad:
    Py_XDECREF(default_encoding);
    return -1;
}
#endif
#endif


/* Test for GCC > 2.95 */
#if defined(__GNUC__)     && (__GNUC__ > 2 || (__GNUC__ == 2 && (__GNUC_MINOR__ > 95)))
  #define likely(x)   __builtin_expect(!!(x), 1)
  #define unlikely(x) __builtin_expect(!!(x), 0)
#else /* !__GNUC__ or GCC < 2.95 */
  #define likely(x)   (x)
  #define unlikely(x) (x)
#endif /* __GNUC__ */

static PyObject *__pyx_m;
static PyObject *__pyx_d;
static PyObject *__pyx_b;
static PyObject *__pyx_empty_tuple;
static PyObject *__pyx_empty_bytes;
static PyObject *__pyx_empty_unicode;
static int __pyx_lineno;
static int __pyx_clineno = 0;
static const char * __pyx_cfilenm= __FILE__;
static const char *__pyx_filename;


static const char *__pyx_f[] = {
  "galxe/hamcycle.pyx",
  "galxe/utils.pxd",
  "galxe/core.pxd",
  "galxe/graph.pxd",
};

/*--- Type declarations ---*/
struct __pyx_obj_5galxe_5utils__MBlock;
struct __pyx_obj_5galxe_5utils__MBlockIter;
struct __pyx_obj_5galxe_5utils_MBlockAllocator;
struct __pyx_obj_5galxe_5utils_TextFileTokenizer;
struct __pyx_obj_5galxe_4core_VertexManager;
struct __pyx_obj_5galxe_4core_EdgeManager;
struct __pyx_obj_5galxe_5graph_Graph;
struct __pyx_opt_args_5galxe_5utils_15MBlockAllocator_available;

/* "utils.pxd":41
 * 
 *         void    *request(self, size_t bytes) except NULL
 *         size_t   available(self, size_t bytes=*)             # <<<<<<<<<<<<<<
 * 
 * cdef class TextFileTokenizer:
 */
struct __pyx_opt_args_5galxe_5utils_15MBlockAllocator_available {
  int __pyx_n;
  size_t bytes;
};
struct __pyx_opt_args_5galxe_5graph_5Graph_make_repr;
struct __pyx_opt_args_5galxe_5graph_write_file;

/* "graph.pxd":42
 *     cpdef size_t arc_count(self)
 *     cpdef void parse_repr(self, repr) except *
 *     cpdef list make_repr(self, bint sort=*)             # <<<<<<<<<<<<<<
 *     cpdef Graph ensure_edge(self, size_t u, size_t v)
 *     cpdef Graph ensure_vertex(self, size_t v)
 */
struct __pyx_opt_args_5galxe_5graph_5Graph_make_repr {
  int __pyx_n;
  int sort;
};

/* "graph.pxd":53
 * 
 * cpdef list parse_file(str file_name)
 * cpdef size_t write_file(str file_name, list graphs, bint relabel=*)             # <<<<<<<<<<<<<<
 * 
 */
struct __pyx_opt_args_5galxe_5graph_write_file {
  int __pyx_n;
  int relabel;
};
struct __pyx_t_5galxe_8hamcycle_hc_marker;

/* "galxe/hamcycle.pyx":30
 * from .utils cimport MBlockAllocator
 * 
 * cdef struct hc_marker:             # <<<<<<<<<<<<<<
 *     hc_marker    *next
 *     graph_vertex *v
 */
struct __pyx_t_5galxe_8hamcycle_hc_marker {
  struct __pyx_t_5galxe_8hamcycle_hc_marker *next;
  struct graph_vertex *v;
  struct graph_arc *m_created;
  struct graph_arc *m_detached;
  struct graph_arc *g_detached;
};

/* "utils.pxd":21
 * # distutils: language=c
 * 
 * cdef class _MBlock:             # <<<<<<<<<<<<<<
 *     cdef:
 *         (void*) start, end, ptr, _ptr
 */
struct __pyx_obj_5galxe_5utils__MBlock {
  PyObject_HEAD
  struct __pyx_vtabstruct_5galxe_5utils__MBlock *__pyx_vtab;
  void *start;
  void *end;
  void *ptr;
  void *_ptr;
  struct __pyx_obj_5galxe_5utils__MBlock *next;
};


/* "utils.pxd":31
 *         void  *request(self, size_t bytes) except NULL
 * 
 * cdef class _MBlockIter:             # <<<<<<<<<<<<<<
 *     cdef _MBlock current
 * 
 */
struct __pyx_obj_5galxe_5utils__MBlockIter {
  PyObject_HEAD
  struct __pyx_obj_5galxe_5utils__MBlock *current;
};


/* "utils.pxd":34
 *     cdef _MBlock current
 * 
 * cdef class MBlockAllocator:             # <<<<<<<<<<<<<<
 *     cdef:
 *         _MBlock head
 */
struct __pyx_obj_5galxe_5utils_MBlockAllocator {
  PyObject_HEAD
  struct __pyx_vtabstruct_5galxe_5utils_MBlockAllocator *__pyx_vtab;
  struct __pyx_obj_5galxe_5utils__MBlock *head;
  size_t block_size;
  size_t align;
};


/* "utils.pxd":43
 *         size_t   available(self, size_t bytes=*)
 * 
 * cdef class TextFileTokenizer:             # <<<<<<<<<<<<<<
 *     cdef object lines, tokens
 */
struct __pyx_obj_5galxe_5utils_TextFileTokenizer {
  PyObject_HEAD
  PyObject *lines;
  PyObject *tokens;
};


/* "core.pxd":134
 * from .utils cimport MBlockAllocator
 * 
 * cdef class VertexManager:             # <<<<<<<<<<<<<<
 *     cdef size_t v_size
 *     cdef vertex_list vertices
 */
struct __pyx_obj_5galxe_4core_VertexManager {
  PyObject_HEAD
  struct __pyx_vtabstruct_5galxe_4core_VertexManager *__pyx_vtab;
  size_t v_size;
  vertex_list vertices;
  struct __pyx_obj_5galxe_5utils_MBlockAllocator *allocator;
};


/* "core.pxd":141
 *     cdef void release(self, graph_vertex *v)
 * 
 * cdef class EdgeManager:             # <<<<<<<<<<<<<<
 *     cdef size_t e_size
 *     cdef arc_list arcs
 */
struct __pyx_obj_5galxe_4core_EdgeManager {
  PyObject_HEAD
  struct __pyx_vtabstruct_5galxe_4core_EdgeManager *__pyx_vtab;
  size_t e_size;
  arc_list arcs;
  struct __pyx_obj_5galxe_5utils_MBlockAllocator *allocator;
};


/* "graph.pxd":22
 * from .core cimport *
 * 
 * cdef class Graph:             # <<<<<<<<<<<<<<
 *     cdef:
 *         vertex_list vertices
 */
struct __pyx_obj_5galxe_5graph_Graph {
  PyObject_HEAD
  struct __pyx_vtabstruct_5galxe_5graph_Graph *__pyx_vtab;
  vertex_list vertices;
  PyObject *_name;
  PyObject *v_container;
  struct __pyx_obj_5galxe_4core_VertexManager *v_manager;
  struct __pyx_obj_5galxe_4core_EdgeManager *e_manager;
  struct graph_resources resources;
};



/* "utils.pxd":21
 * # distutils: language=c
 * 
 * cdef class _MBlock:             # <<<<<<<<<<<<<<
 *     cdef:
 *         (void*) start, end, ptr, _ptr
 */

struct __pyx_vtabstruct_5galxe_5utils__MBlock {
  size_t (*size)(struct __pyx_obj_5galxe_5utils__MBlock *);
  size_t (*remaining)(struct __pyx_obj_5galxe_5utils__MBlock *);
  int (*in_block)(struct __pyx_obj_5galxe_5utils__MBlock *, void *);
  void *(*request)(struct __pyx_obj_5galxe_5utils__MBlock *, size_t);
};
static struct __pyx_vtabstruct_5galxe_5utils__MBlock *__pyx_vtabptr_5galxe_5utils__MBlock;


/* "utils.pxd":34
 *     cdef _MBlock current
 * 
 * cdef class MBlockAllocator:             # <<<<<<<<<<<<<<
 *     cdef:
 *         _MBlock head
 */

struct __pyx_vtabstruct_5galxe_5utils_MBlockAllocator {
  void *(*request)(struct __pyx_obj_5galxe_5utils_MBlockAllocator *, size_t);
  size_t (*available)(struct __pyx_obj_5galxe_5utils_MBlockAllocator *, struct __pyx_opt_args_5galxe_5utils_15MBlockAllocator_available *__pyx_optional_args);
};
static struct __pyx_vtabstruct_5galxe_5utils_MBlockAllocator *__pyx_vtabptr_5galxe_5utils_MBlockAllocator;


/* "core.pxd":134
 * from .utils cimport MBlockAllocator
 * 
 * cdef class VertexManager:             # <<<<<<<<<<<<<<
 *     cdef size_t v_size
 *     cdef vertex_list vertices
 */

struct __pyx_vtabstruct_5galxe_4core_VertexManager {
  struct graph_vertex *(*request)(struct __pyx_obj_5galxe_4core_VertexManager *);
  void (*release)(struct __pyx_obj_5galxe_4core_VertexManager *, struct graph_vertex *);
};
static struct __pyx_vtabstruct_5galxe_4core_VertexManager *__pyx_vtabptr_5galxe_4core_VertexManager;


/* "core.pxd":141
 *     cdef void release(self, graph_vertex *v)
 * 
 * cdef class EdgeManager:             # <<<<<<<<<<<<<<
 *     cdef size_t e_size
 *     cdef arc_list arcs
 */

struct __pyx_vtabstruct_5galxe_4core_EdgeManager {
  struct graph_arc *(*request)(struct __pyx_obj_5galxe_4core_EdgeManager *);
  void (*release)(struct __pyx_obj_5galxe_4core_EdgeManager *, struct graph_arc *);
};
static struct __pyx_vtabstruct_5galxe_4core_EdgeManager *__pyx_vtabptr_5galxe_4core_EdgeManager;


/* "graph.pxd":22
 * from .core cimport *
 * 
 * cdef class Graph:             # <<<<<<<<<<<<<<
 *     cdef:
 *         vertex_list vertices
 */

struct __pyx_vtabstruct_5galxe_5graph_Graph {
  size_t (*default_vertex_block_count)(struct __pyx_obj_5galxe_5graph_Graph *);
  size_t (*default_arc_block_count)(struct __pyx_obj_5galxe_5graph_Graph *);
  size_t (*vertex_size)(struct __pyx_obj_5galxe_5graph_Graph *);
  size_t (*edge_size)(struct __pyx_obj_5galxe_5graph_Graph *);
  size_t (*vb_count)(struct __pyx_obj_5galxe_5graph_Graph *);
  size_t (*eb_count)(struct __pyx_obj_5galxe_5graph_Graph *);
  struct graph_vertex *(*add_list)(struct __pyx_obj_5galxe_5graph_Graph *, PyObject *);
  size_t (*arc_count)(struct __pyx_obj_5galxe_5graph_Graph *, int __pyx_skip_dispatch);
  void (*parse_repr)(struct __pyx_obj_5galxe_5graph_Graph *, PyObject *, int __pyx_skip_dispatch);
  PyObject *(*make_repr)(struct __pyx_obj_5galxe_5graph_Graph *, int __pyx_skip_dispatch, struct __pyx_opt_args_5galxe_5graph_5Graph_make_repr *__pyx_optional_args);
  struct __pyx_obj_5galxe_5graph_Graph *(*ensure_edge)(struct __pyx_obj_5galxe_5graph_Graph *, size_t, size_t, int __pyx_skip_dispatch);
  struct __pyx_obj_5galxe_5graph_Graph *(*ensure_vertex)(struct __pyx_obj_5galxe_5graph_Graph *, size_t, int __pyx_skip_dispatch);
  struct __pyx_obj_5galxe_5graph_Graph *(*components)(struct __pyx_obj_5galxe_5graph_Graph *, int __pyx_skip_dispatch);
  int (*connected)(struct __pyx_obj_5galxe_5graph_Graph *, int __pyx_skip_dispatch);
};
static struct __pyx_vtabstruct_5galxe_5graph_Graph *__pyx_vtabptr_5galxe_5graph_Graph;

/* --- Runtime support code (head) --- */
/* Refnanny.proto */
#ifndef CYTHON_REFNANNY
  #define CYTHON_REFNANNY 0
#endif
#if CYTHON_REFNANNY
  typedef struct {
    void (*INCREF)(void*, PyObject*, int);
    void (*DECREF)(void*, PyObject*, int);
    void (*GOTREF)(void*, PyObject*, int);
    void (*GIVEREF)(void*, PyObject*, int);
    void* (*SetupContext)(const char*, int, const char*);
    void (*FinishContext)(void**);
  } __Pyx_RefNannyAPIStruct;
  static __Pyx_RefNannyAPIStruct *__Pyx_RefNanny = NULL;
  static __Pyx_RefNannyAPIStruct *__Pyx_RefNannyImportAPI(const char *modname);
  #define __Pyx_RefNannyDeclarations void *__pyx_refnanny = NULL;
#ifdef WITH_THREAD
  #define __Pyx_RefNannySetupContext(name, acquire_gil)\
          if (acquire_gil) {\
              PyGILState_STATE __pyx_gilstate_save = PyGILState_Ensure();\
              __pyx_refnanny = __Pyx_RefNanny->SetupContext((name), __LINE__, __FILE__);\
              PyGILState_Release(__pyx_gilstate_save);\
          } else {\
              __pyx_refnanny = __Pyx_RefNanny->SetupContext((name), __LINE__, __FILE__);\
          }
#else
  #define __Pyx_RefNannySetupContext(name, acquire_gil)\
          __pyx_refnanny = __Pyx_RefNanny->SetupContext((name), __LINE__, __FILE__)
#endif
  #define __Pyx_RefNannyFinishContext()\
          __Pyx_RefNanny->FinishContext(&__pyx_refnanny)
  #define __Pyx_INCREF(r)  __Pyx_RefNanny->INCREF(__pyx_refnanny, (PyObject *)(r), __LINE__)
  #define __Pyx_DECREF(r)  __Pyx_RefNanny->DECREF(__pyx_refnanny, (PyObject *)(r), __LINE__)
  #define __Pyx_GOTREF(r)  __Pyx_RefNanny->GOTREF(__pyx_refnanny, (PyObject *)(r), __LINE__)
  #define __Pyx_GIVEREF(r) __Pyx_RefNanny->GIVEREF(__pyx_refnanny, (PyObject *)(r), __LINE__)
  #define __Pyx_XINCREF(r)  do { if((r) != NULL) {__Pyx_INCREF(r); }} while(0)
  #define __Pyx_XDECREF(r)  do { if((r) != NULL) {__Pyx_DECREF(r); }} while(0)
  #define __Pyx_XGOTREF(r)  do { if((r) != NULL) {__Pyx_GOTREF(r); }} while(0)
  #define __Pyx_XGIVEREF(r) do { if((r) != NULL) {__Pyx_GIVEREF(r);}} while(0)
#else
  #define __Pyx_RefNannyDeclarations
  #define __Pyx_RefNannySetupContext(name, acquire_gil)
  #define __Pyx_RefNannyFinishContext()
  #define __Pyx_INCREF(r) Py_INCREF(r)
  #define __Pyx_DECREF(r) Py_DECREF(r)
  #define __Pyx_GOTREF(r)
  #define __Pyx_GIVEREF(r)
  #define __Pyx_XINCREF(r) Py_XINCREF(r)
  #define __Pyx_XDECREF(r) Py_XDECREF(r)
  #define __Pyx_XGOTREF(r)
  #define __Pyx_XGIVEREF(r)
#endif
#define __Pyx_XDECREF_SET(r, v) do {\
        PyObject *tmp = (PyObject *) r;\
        r = v; __Pyx_XDECREF(tmp);\
    } while (0)
#define __Pyx_DECREF_SET(r, v) do {\
        PyObject *tmp = (PyObject *) r;\
        r = v; __Pyx_DECREF(tmp);\
    } while (0)
#define __Pyx_CLEAR(r)    do { PyObject* tmp = ((PyObject*)(r)); r = NULL; __Pyx_DECREF(tmp);} while(0)
#define __Pyx_XCLEAR(r)   do { if((r) != NULL) {PyObject* tmp = ((PyObject*)(r)); r = NULL; __Pyx_DECREF(tmp);}} while(0)

/* PyObjectGetAttrStr.proto */
#if CYTHON_USE_TYPE_SLOTS
static CYTHON_INLINE PyObject* __Pyx_PyObject_GetAttrStr(PyObject* obj, PyObject* attr_name) {
    PyTypeObject* tp = Py_TYPE(obj);
    if (likely(tp->tp_getattro))
        return tp->tp_getattro(obj, attr_name);
#if PY_MAJOR_VERSION < 3
    if (likely(tp->tp_getattr))
        return tp->tp_getattr(obj, PyString_AS_STRING(attr_name));
#endif
    return PyObject_GetAttr(obj, attr_name);
}
#else
#define __Pyx_PyObject_GetAttrStr(o,n) PyObject_GetAttr(o,n)
#endif

/* GetBuiltinName.proto */
static PyObject *__Pyx_GetBuiltinName(PyObject *name);

/* PyObjectCall.proto */
#if CYTHON_COMPILING_IN_CPYTHON
static CYTHON_INLINE PyObject* __Pyx_PyObject_Call(PyObject *func, PyObject *arg, PyObject *kw);
#else
#define __Pyx_PyObject_Call(func, arg, kw) PyObject_Call(func, arg, kw)
#endif

/* Import.proto */
static PyObject *__Pyx_Import(PyObject *name, PyObject *from_list, int level);

/* ArgTypeTest.proto */
static CYTHON_INLINE int __Pyx_ArgTypeTest(PyObject *obj, PyTypeObject *type, int none_allowed,
    const char *name, int exact);

/* GetVTable.proto */
static void* __Pyx_GetVtable(PyObject *dict);

/* CodeObjectCache.proto */
typedef struct {
    PyCodeObject* code_object;
    int code_line;
} __Pyx_CodeObjectCacheEntry;
struct __Pyx_CodeObjectCache {
    int count;
    int max_count;
    __Pyx_CodeObjectCacheEntry* entries;
};
static struct __Pyx_CodeObjectCache __pyx_code_cache = {0,0,NULL};
static int __pyx_bisect_code_objects(__Pyx_CodeObjectCacheEntry* entries, int count, int code_line);
static PyCodeObject *__pyx_find_code_object(int code_line);
static void __pyx_insert_code_object(int code_line, PyCodeObject* code_object);

/* AddTraceback.proto */
static void __Pyx_AddTraceback(const char *funcname, int c_line,
                               int py_line, const char *filename);

/* Print.proto */
static int __Pyx_Print(PyObject*, PyObject *, int);
#if CYTHON_COMPILING_IN_PYPY || PY_MAJOR_VERSION >= 3
static PyObject* __pyx_print = 0;
static PyObject* __pyx_print_kwargs = 0;
#endif

/* CIntFromPy.proto */
static CYTHON_INLINE size_t __Pyx_PyInt_As_size_t(PyObject *);

/* PrintOne.proto */
static int __Pyx_PrintOne(PyObject* stream, PyObject *o);

/* CIntToPy.proto */
static CYTHON_INLINE PyObject* __Pyx_PyInt_From_long(long value);

/* CIntFromPy.proto */
static CYTHON_INLINE long __Pyx_PyInt_As_long(PyObject *);

/* CIntFromPy.proto */
static CYTHON_INLINE int __Pyx_PyInt_As_int(PyObject *);

/* CheckBinaryVersion.proto */
static int __Pyx_check_binary_version(void);

/* PyIdentifierFromString.proto */
#if !defined(__Pyx_PyIdentifier_FromString)
#if PY_MAJOR_VERSION < 3
  #define __Pyx_PyIdentifier_FromString(s) PyString_FromString(s)
#else
  #define __Pyx_PyIdentifier_FromString(s) PyUnicode_FromString(s)
#endif
#endif

/* ModuleImport.proto */
static PyObject *__Pyx_ImportModule(const char *name);

/* TypeImport.proto */
static PyTypeObject *__Pyx_ImportType(const char *module_name, const char *class_name, size_t size, int strict);

/* InitStrings.proto */
static int __Pyx_InitStrings(__Pyx_StringTabEntry *t);


/* Module declarations from 'cython' */

/* Module declarations from 'galxe.utils' */
static PyTypeObject *__pyx_ptype_5galxe_5utils__MBlock = 0;
static PyTypeObject *__pyx_ptype_5galxe_5utils__MBlockIter = 0;
static PyTypeObject *__pyx_ptype_5galxe_5utils_MBlockAllocator = 0;
static PyTypeObject *__pyx_ptype_5galxe_5utils_TextFileTokenizer = 0;

/* Module declarations from 'galxe.core' */
static PyTypeObject *__pyx_ptype_5galxe_4core_VertexManager = 0;
static PyTypeObject *__pyx_ptype_5galxe_4core_EdgeManager = 0;

/* Module declarations from 'galxe.graph' */
static PyTypeObject *__pyx_ptype_5galxe_5graph_Graph = 0;

/* Module declarations from 'galxe.hamcycle' */
static CYTHON_INLINE void __pyx_f_5galxe_8hamcycle_copy_marker(struct __pyx_t_5galxe_8hamcycle_hc_marker *, struct __pyx_t_5galxe_8hamcycle_hc_marker *); /*proto*/
static CYTHON_INLINE struct __pyx_t_5galxe_8hamcycle_hc_marker *__pyx_f_5galxe_8hamcycle_push_marker(struct __pyx_t_5galxe_8hamcycle_hc_marker *, struct __pyx_t_5galxe_8hamcycle_hc_marker **); /*proto*/
static CYTHON_INLINE void __pyx_f_5galxe_8hamcycle_push_v(struct __pyx_t_5galxe_8hamcycle_hc_marker *, struct graph_vertex *); /*proto*/
static CYTHON_INLINE void __pyx_f_5galxe_8hamcycle_push_a(struct __pyx_t_5galxe_8hamcycle_hc_marker *, struct graph_arc *); /*proto*/
static CYTHON_INLINE void __pyx_f_5galxe_8hamcycle_push_e(struct __pyx_t_5galxe_8hamcycle_hc_marker *, struct graph_arc *); /*proto*/
static CYTHON_INLINE void __pyx_f_5galxe_8hamcycle_push_m(struct __pyx_t_5galxe_8hamcycle_hc_marker *, struct graph_arc *); /*proto*/
static CYTHON_INLINE struct graph_arc *__pyx_f_5galxe_8hamcycle_second_arc(struct graph_vertex *); /*proto*/
static CYTHON_INLINE int __pyx_f_5galxe_8hamcycle_no_second_arc(struct graph_vertex *); /*proto*/
static CYTHON_INLINE void __pyx_f_5galxe_8hamcycle_move_v(vertex_list *, struct graph_vertex *); /*proto*/
static CYTHON_INLINE struct __pyx_t_5galxe_8hamcycle_hc_marker *__pyx_f_5galxe_8hamcycle_rewind(vertex_list *, struct __pyx_t_5galxe_8hamcycle_hc_marker *, struct graph_arc **, struct __pyx_t_5galxe_8hamcycle_hc_marker **); /*proto*/
static CYTHON_INLINE struct graph_arc *__pyx_f_5galxe_8hamcycle_find_endpoint(vertex_list *, vertex_list *, struct __pyx_t_5galxe_8hamcycle_hc_marker *, struct graph_arc *, struct graph_arc *); /*proto*/
static CYTHON_INLINE int __pyx_f_5galxe_8hamcycle_path_contraction(struct graph_arc *, struct graph_arc *, vertex_list *, vertex_list *, struct __pyx_t_5galxe_8hamcycle_hc_marker *, struct graph_arc **); /*proto*/
static CYTHON_INLINE int __pyx_f_5galxe_8hamcycle__prep(vertex_list *, vertex_list *); /*proto*/
static void __pyx_f_5galxe_8hamcycle__allocate(struct __pyx_obj_5galxe_5utils_MBlockAllocator *, struct __pyx_obj_5galxe_4core_EdgeManager *, size_t, struct __pyx_t_5galxe_8hamcycle_hc_marker **, struct graph_arc **); /*proto*/
static void __pyx_f_5galxe_8hamcycle__deallocate(struct __pyx_obj_5galxe_4core_EdgeManager *, struct graph_arc *); /*proto*/
static size_t __pyx_f_5galxe_8hamcycle_hc_count(struct __pyx_obj_5galxe_5graph_Graph *, int __pyx_skip_dispatch); /*proto*/
#define __Pyx_MODULE_NAME "galxe.hamcycle"
int __pyx_module_is_main_galxe__hamcycle = 0;

/* Implementation of 'galxe.hamcycle' */
static PyObject *__pyx_builtin_xrange;
static const char __pyx_k_[] = "";
static const char __pyx_k_end[] = "end";
static const char __pyx_k_sys[] = "sys";
static const char __pyx_k_file[] = "file";
static const char __pyx_k_main[] = "__main__";
static const char __pyx_k_test[] = "__test__";
static const char __pyx_k_print[] = "print";
static const char __pyx_k_range[] = "range";
static const char __pyx_k_import[] = "__import__";
static const char __pyx_k_xrange[] = "xrange";
static const char __pyx_k_pyx_vtable[] = "__pyx_vtable__";
static PyObject *__pyx_kp_s_;
static PyObject *__pyx_n_s_end;
static PyObject *__pyx_n_s_file;
static PyObject *__pyx_n_s_import;
static PyObject *__pyx_n_s_main;
static PyObject *__pyx_n_s_print;
static PyObject *__pyx_n_s_pyx_vtable;
static PyObject *__pyx_n_s_range;
static PyObject *__pyx_n_s_sys;
static PyObject *__pyx_n_s_test;
static PyObject *__pyx_n_s_xrange;
static PyObject *__pyx_pf_5galxe_8hamcycle_hc_count(CYTHON_UNUSED PyObject *__pyx_self, struct __pyx_obj_5galxe_5graph_Graph *__pyx_v_graph); /* proto */

/* "galxe/hamcycle.pyx":37
 *     graph_arc    *g_detached
 * 
 * cdef inline void copy_marker(hc_marker *d, hc_marker *s) nogil:             # <<<<<<<<<<<<<<
 *     d.v = s.v
 *     d.m_detached = s.m_detached
 */

static CYTHON_INLINE void __pyx_f_5galxe_8hamcycle_copy_marker(struct __pyx_t_5galxe_8hamcycle_hc_marker *__pyx_v_d, struct __pyx_t_5galxe_8hamcycle_hc_marker *__pyx_v_s) {
  struct graph_vertex *__pyx_t_1;
  struct graph_arc *__pyx_t_2;

  /* "galxe/hamcycle.pyx":38
 * 
 * cdef inline void copy_marker(hc_marker *d, hc_marker *s) nogil:
 *     d.v = s.v             # <<<<<<<<<<<<<<
 *     d.m_detached = s.m_detached
 *     d.m_created  = s.m_created
 */
  __pyx_t_1 = __pyx_v_s->v;
  __pyx_v_d->v = __pyx_t_1;

  /* "galxe/hamcycle.pyx":39
 * cdef inline void copy_marker(hc_marker *d, hc_marker *s) nogil:
 *     d.v = s.v
 *     d.m_detached = s.m_detached             # <<<<<<<<<<<<<<
 *     d.m_created  = s.m_created
 *     d.g_detached = s.g_detached
 */
  __pyx_t_2 = __pyx_v_s->m_detached;
  __pyx_v_d->m_detached = __pyx_t_2;

  /* "galxe/hamcycle.pyx":40
 *     d.v = s.v
 *     d.m_detached = s.m_detached
 *     d.m_created  = s.m_created             # <<<<<<<<<<<<<<
 *     d.g_detached = s.g_detached
 * 
 */
  __pyx_t_2 = __pyx_v_s->m_created;
  __pyx_v_d->m_created = __pyx_t_2;

  /* "galxe/hamcycle.pyx":41
 *     d.m_detached = s.m_detached
 *     d.m_created  = s.m_created
 *     d.g_detached = s.g_detached             # <<<<<<<<<<<<<<
 * 
 * cdef inline hc_marker *push_marker(hc_marker *s, hc_marker **f_markers) nogil:
 */
  __pyx_t_2 = __pyx_v_s->g_detached;
  __pyx_v_d->g_detached = __pyx_t_2;

  /* "galxe/hamcycle.pyx":37
 *     graph_arc    *g_detached
 * 
 * cdef inline void copy_marker(hc_marker *d, hc_marker *s) nogil:             # <<<<<<<<<<<<<<
 *     d.v = s.v
 *     d.m_detached = s.m_detached
 */

  /* function exit code */
}

/* "galxe/hamcycle.pyx":43
 *     d.g_detached = s.g_detached
 * 
 * cdef inline hc_marker *push_marker(hc_marker *s, hc_marker **f_markers) nogil:             # <<<<<<<<<<<<<<
 *     cdef hc_marker *d = f_markers[0]
 *     f_markers[0] = d.next
 */

static CYTHON_INLINE struct __pyx_t_5galxe_8hamcycle_hc_marker *__pyx_f_5galxe_8hamcycle_push_marker(struct __pyx_t_5galxe_8hamcycle_hc_marker *__pyx_v_s, struct __pyx_t_5galxe_8hamcycle_hc_marker **__pyx_v_f_markers) {
  struct __pyx_t_5galxe_8hamcycle_hc_marker *__pyx_v_d;
  struct __pyx_t_5galxe_8hamcycle_hc_marker *__pyx_r;
  struct __pyx_t_5galxe_8hamcycle_hc_marker *__pyx_t_1;

  /* "galxe/hamcycle.pyx":44
 * 
 * cdef inline hc_marker *push_marker(hc_marker *s, hc_marker **f_markers) nogil:
 *     cdef hc_marker *d = f_markers[0]             # <<<<<<<<<<<<<<
 *     f_markers[0] = d.next
 *     d.next = s
 */
  __pyx_v_d = (__pyx_v_f_markers[0]);

  /* "galxe/hamcycle.pyx":45
 * cdef inline hc_marker *push_marker(hc_marker *s, hc_marker **f_markers) nogil:
 *     cdef hc_marker *d = f_markers[0]
 *     f_markers[0] = d.next             # <<<<<<<<<<<<<<
 *     d.next = s
 *     copy_marker(d, s)
 */
  __pyx_t_1 = __pyx_v_d->next;
  (__pyx_v_f_markers[0]) = __pyx_t_1;

  /* "galxe/hamcycle.pyx":46
 *     cdef hc_marker *d = f_markers[0]
 *     f_markers[0] = d.next
 *     d.next = s             # <<<<<<<<<<<<<<
 *     copy_marker(d, s)
 *     return d
 */
  __pyx_v_d->next = __pyx_v_s;

  /* "galxe/hamcycle.pyx":47
 *     f_markers[0] = d.next
 *     d.next = s
 *     copy_marker(d, s)             # <<<<<<<<<<<<<<
 *     return d
 * 
 */
  __pyx_f_5galxe_8hamcycle_copy_marker(__pyx_v_d, __pyx_v_s);

  /* "galxe/hamcycle.pyx":48
 *     d.next = s
 *     copy_marker(d, s)
 *     return d             # <<<<<<<<<<<<<<
 * 
 * cdef inline void push_v(hc_marker *h, graph_vertex *v) nogil:
 */
  __pyx_r = __pyx_v_d;
  goto __pyx_L0;

  /* "galxe/hamcycle.pyx":43
 *     d.g_detached = s.g_detached
 * 
 * cdef inline hc_marker *push_marker(hc_marker *s, hc_marker **f_markers) nogil:             # <<<<<<<<<<<<<<
 *     cdef hc_marker *d = f_markers[0]
 *     f_markers[0] = d.next
 */

  /* function exit code */
  __pyx_L0:;
  return __pyx_r;
}

/* "galxe/hamcycle.pyx":50
 *     return d
 * 
 * cdef inline void push_v(hc_marker *h, graph_vertex *v) nogil:             # <<<<<<<<<<<<<<
 *     v_detach(v)
 *     v_attach(v, v_after(h.v))
 */

static CYTHON_INLINE void __pyx_f_5galxe_8hamcycle_push_v(struct __pyx_t_5galxe_8hamcycle_hc_marker *__pyx_v_h, struct graph_vertex *__pyx_v_v) {

  /* "galxe/hamcycle.pyx":51
 * 
 * cdef inline void push_v(hc_marker *h, graph_vertex *v) nogil:
 *     v_detach(v)             # <<<<<<<<<<<<<<
 *     v_attach(v, v_after(h.v))
 *     h.v = v
 */
  v_detach(__pyx_v_v);

  /* "galxe/hamcycle.pyx":52
 * cdef inline void push_v(hc_marker *h, graph_vertex *v) nogil:
 *     v_detach(v)
 *     v_attach(v, v_after(h.v))             # <<<<<<<<<<<<<<
 *     h.v = v
 * 
 */
  v_attach(__pyx_v_v, v_after(__pyx_v_h->v));

  /* "galxe/hamcycle.pyx":53
 *     v_detach(v)
 *     v_attach(v, v_after(h.v))
 *     h.v = v             # <<<<<<<<<<<<<<
 * 
 * cdef inline void push_a(hc_marker *h, graph_arc *a) nogil:
 */
  __pyx_v_h->v = __pyx_v_v;

  /* "galxe/hamcycle.pyx":50
 *     return d
 * 
 * cdef inline void push_v(hc_marker *h, graph_vertex *v) nogil:             # <<<<<<<<<<<<<<
 *     v_detach(v)
 *     v_attach(v, v_after(h.v))
 */

  /* function exit code */
}

/* "galxe/hamcycle.pyx":55
 *     h.v = v
 * 
 * cdef inline void push_a(hc_marker *h, graph_arc *a) nogil:             # <<<<<<<<<<<<<<
 *     a_detach(a)
 *     h.g_detached = a_set_next(a, h.g_detached)
 */

static CYTHON_INLINE void __pyx_f_5galxe_8hamcycle_push_a(struct __pyx_t_5galxe_8hamcycle_hc_marker *__pyx_v_h, struct graph_arc *__pyx_v_a) {

  /* "galxe/hamcycle.pyx":56
 * 
 * cdef inline void push_a(hc_marker *h, graph_arc *a) nogil:
 *     a_detach(a)             # <<<<<<<<<<<<<<
 *     h.g_detached = a_set_next(a, h.g_detached)
 * 
 */
  a_detach(__pyx_v_a);

  /* "galxe/hamcycle.pyx":57
 * cdef inline void push_a(hc_marker *h, graph_arc *a) nogil:
 *     a_detach(a)
 *     h.g_detached = a_set_next(a, h.g_detached)             # <<<<<<<<<<<<<<
 * 
 * cdef inline void push_e(hc_marker *h, graph_arc *a) nogil:
 */
  __pyx_v_h->g_detached = a_set_next(__pyx_v_a, __pyx_v_h->g_detached);

  /* "galxe/hamcycle.pyx":55
 *     h.v = v
 * 
 * cdef inline void push_a(hc_marker *h, graph_arc *a) nogil:             # <<<<<<<<<<<<<<
 *     a_detach(a)
 *     h.g_detached = a_set_next(a, h.g_detached)
 */

  /* function exit code */
}

/* "galxe/hamcycle.pyx":59
 *     h.g_detached = a_set_next(a, h.g_detached)
 * 
 * cdef inline void push_e(hc_marker *h, graph_arc *a) nogil:             # <<<<<<<<<<<<<<
 *     push_a(h, a)
 *     push_a(h, a_cross(a))
 */

static CYTHON_INLINE void __pyx_f_5galxe_8hamcycle_push_e(struct __pyx_t_5galxe_8hamcycle_hc_marker *__pyx_v_h, struct graph_arc *__pyx_v_a) {

  /* "galxe/hamcycle.pyx":60
 * 
 * cdef inline void push_e(hc_marker *h, graph_arc *a) nogil:
 *     push_a(h, a)             # <<<<<<<<<<<<<<
 *     push_a(h, a_cross(a))
 * 
 */
  __pyx_f_5galxe_8hamcycle_push_a(__pyx_v_h, __pyx_v_a);

  /* "galxe/hamcycle.pyx":61
 * cdef inline void push_e(hc_marker *h, graph_arc *a) nogil:
 *     push_a(h, a)
 *     push_a(h, a_cross(a))             # <<<<<<<<<<<<<<
 * 
 * cdef inline void push_m(hc_marker *h, graph_arc *a) nogil:
 */
  __pyx_f_5galxe_8hamcycle_push_a(__pyx_v_h, a_cross(__pyx_v_a));

  /* "galxe/hamcycle.pyx":59
 *     h.g_detached = a_set_next(a, h.g_detached)
 * 
 * cdef inline void push_e(hc_marker *h, graph_arc *a) nogil:             # <<<<<<<<<<<<<<
 *     push_a(h, a)
 *     push_a(h, a_cross(a))
 */

  /* function exit code */
}

/* "galxe/hamcycle.pyx":63
 *     push_a(h, a_cross(a))
 * 
 * cdef inline void push_m(hc_marker *h, graph_arc *a) nogil:             # <<<<<<<<<<<<<<
 *     a_detach(a)
 *     h.m_detached = a_set_next(a, h.m_detached)
 */

static CYTHON_INLINE void __pyx_f_5galxe_8hamcycle_push_m(struct __pyx_t_5galxe_8hamcycle_hc_marker *__pyx_v_h, struct graph_arc *__pyx_v_a) {

  /* "galxe/hamcycle.pyx":64
 * 
 * cdef inline void push_m(hc_marker *h, graph_arc *a) nogil:
 *     a_detach(a)             # <<<<<<<<<<<<<<
 *     h.m_detached = a_set_next(a, h.m_detached)
 * 
 */
  a_detach(__pyx_v_a);

  /* "galxe/hamcycle.pyx":65
 * cdef inline void push_m(hc_marker *h, graph_arc *a) nogil:
 *     a_detach(a)
 *     h.m_detached = a_set_next(a, h.m_detached)             # <<<<<<<<<<<<<<
 * 
 * cdef inline graph_arc *second_arc(graph_vertex *v) nogil:
 */
  __pyx_v_h->m_detached = a_set_next(__pyx_v_a, __pyx_v_h->m_detached);

  /* "galxe/hamcycle.pyx":63
 *     push_a(h, a_cross(a))
 * 
 * cdef inline void push_m(hc_marker *h, graph_arc *a) nogil:             # <<<<<<<<<<<<<<
 *     a_detach(a)
 *     h.m_detached = a_set_next(a, h.m_detached)
 */

  /* function exit code */
}

/* "galxe/hamcycle.pyx":67
 *     h.m_detached = a_set_next(a, h.m_detached)
 * 
 * cdef inline graph_arc *second_arc(graph_vertex *v) nogil:             # <<<<<<<<<<<<<<
 *     return a_next(v_arcs_first(v))
 * 
 */

static CYTHON_INLINE struct graph_arc *__pyx_f_5galxe_8hamcycle_second_arc(struct graph_vertex *__pyx_v_v) {
  struct graph_arc *__pyx_r;

  /* "galxe/hamcycle.pyx":68
 * 
 * cdef inline graph_arc *second_arc(graph_vertex *v) nogil:
 *     return a_next(v_arcs_first(v))             # <<<<<<<<<<<<<<
 * 
 * cdef inline bint no_second_arc(graph_vertex *v) nogil:
 */
  __pyx_r = a_next(v_arcs_first(__pyx_v_v));
  goto __pyx_L0;

  /* "galxe/hamcycle.pyx":67
 *     h.m_detached = a_set_next(a, h.m_detached)
 * 
 * cdef inline graph_arc *second_arc(graph_vertex *v) nogil:             # <<<<<<<<<<<<<<
 *     return a_next(v_arcs_first(v))
 * 
 */

  /* function exit code */
  __pyx_L0:;
  return __pyx_r;
}

/* "galxe/hamcycle.pyx":70
 *     return a_next(v_arcs_first(v))
 * 
 * cdef inline bint no_second_arc(graph_vertex *v) nogil:             # <<<<<<<<<<<<<<
 *     return v_arcs_is_done(second_arc(v),v)
 * 
 */

static CYTHON_INLINE int __pyx_f_5galxe_8hamcycle_no_second_arc(struct graph_vertex *__pyx_v_v) {
  int __pyx_r;

  /* "galxe/hamcycle.pyx":71
 * 
 * cdef inline bint no_second_arc(graph_vertex *v) nogil:
 *     return v_arcs_is_done(second_arc(v),v)             # <<<<<<<<<<<<<<
 * 
 * cdef inline void move_v(vertex_list *k, graph_vertex *v) nogil:
 */
  __pyx_r = v_arcs_is_done(__pyx_f_5galxe_8hamcycle_second_arc(__pyx_v_v), __pyx_v_v);
  goto __pyx_L0;

  /* "galxe/hamcycle.pyx":70
 *     return a_next(v_arcs_first(v))
 * 
 * cdef inline bint no_second_arc(graph_vertex *v) nogil:             # <<<<<<<<<<<<<<
 *     return v_arcs_is_done(second_arc(v),v)
 * 
 */

  /* function exit code */
  __pyx_L0:;
  return __pyx_r;
}

/* "galxe/hamcycle.pyx":73
 *     return v_arcs_is_done(second_arc(v),v)
 * 
 * cdef inline void move_v(vertex_list *k, graph_vertex *v) nogil:             # <<<<<<<<<<<<<<
 *     v_detach(v)
 *     v_attach(v, vlist_bottom(k))
 */

static CYTHON_INLINE void __pyx_f_5galxe_8hamcycle_move_v(vertex_list *__pyx_v_k, struct graph_vertex *__pyx_v_v) {

  /* "galxe/hamcycle.pyx":74
 * 
 * cdef inline void move_v(vertex_list *k, graph_vertex *v) nogil:
 *     v_detach(v)             # <<<<<<<<<<<<<<
 *     v_attach(v, vlist_bottom(k))
 * 
 */
  v_detach(__pyx_v_v);

  /* "galxe/hamcycle.pyx":75
 * cdef inline void move_v(vertex_list *k, graph_vertex *v) nogil:
 *     v_detach(v)
 *     v_attach(v, vlist_bottom(k))             # <<<<<<<<<<<<<<
 * 
 * cdef inline hc_marker *rewind(
 */
  v_attach(__pyx_v_v, vlist_bottom(__pyx_v_k));

  /* "galxe/hamcycle.pyx":73
 *     return v_arcs_is_done(second_arc(v),v)
 * 
 * cdef inline void move_v(vertex_list *k, graph_vertex *v) nogil:             # <<<<<<<<<<<<<<
 *     v_detach(v)
 *     v_attach(v, vlist_bottom(k))
 */

  /* function exit code */
}

/* "galxe/hamcycle.pyx":77
 *     v_attach(v, vlist_bottom(k))
 * 
 * cdef inline hc_marker *rewind(             # <<<<<<<<<<<<<<
 *     vertex_list *g,
 *     hc_marker *h,
 */

static CYTHON_INLINE struct __pyx_t_5galxe_8hamcycle_hc_marker *__pyx_f_5galxe_8hamcycle_rewind(vertex_list *__pyx_v_g, struct __pyx_t_5galxe_8hamcycle_hc_marker *__pyx_v_h, struct graph_arc **__pyx_v_f_edges, struct __pyx_t_5galxe_8hamcycle_hc_marker **__pyx_v_f_markers) {
  struct graph_arc *__pyx_v_a;
  struct graph_arc *__pyx_v_na;
  struct __pyx_t_5galxe_8hamcycle_hc_marker *__pyx_v_n;
  struct __pyx_t_5galxe_8hamcycle_hc_marker *__pyx_r;
  struct __pyx_t_5galxe_8hamcycle_hc_marker *__pyx_t_1;
  int __pyx_t_2;
  struct graph_arc *__pyx_t_3;

  /* "galxe/hamcycle.pyx":85
 *     cdef:
 *         (graph_arc *) a, na
 *         hc_marker *n = h.next             # <<<<<<<<<<<<<<
 * 
 *     h.next = f_markers[0]
 */
  __pyx_t_1 = __pyx_v_h->next;
  __pyx_v_n = __pyx_t_1;

  /* "galxe/hamcycle.pyx":87
 *         hc_marker *n = h.next
 * 
 *     h.next = f_markers[0]             # <<<<<<<<<<<<<<
 *     f_markers[0] = h
 * 
 */
  __pyx_v_h->next = (__pyx_v_f_markers[0]);

  /* "galxe/hamcycle.pyx":88
 * 
 *     h.next = f_markers[0]
 *     f_markers[0] = h             # <<<<<<<<<<<<<<
 * 
 *     # restore vertices to g
 */
  (__pyx_v_f_markers[0]) = __pyx_v_h;

  /* "galxe/hamcycle.pyx":91
 * 
 *     # restore vertices to g
 *     if n.v != h.v:             # <<<<<<<<<<<<<<
 *         vlist_append_chunk_top(g, v_next(n.v), h.v)
 * 
 */
  __pyx_t_2 = ((__pyx_v_n->v != __pyx_v_h->v) != 0);
  if (__pyx_t_2) {

    /* "galxe/hamcycle.pyx":92
 *     # restore vertices to g
 *     if n.v != h.v:
 *         vlist_append_chunk_top(g, v_next(n.v), h.v)             # <<<<<<<<<<<<<<
 * 
 *     # restore graph minor edge endpoints (to top of arc lists)
 */
    vlist_append_chunk_top(__pyx_v_g, v_next(__pyx_v_n->v), __pyx_v_h->v);

    /* "galxe/hamcycle.pyx":91
 * 
 *     # restore vertices to g
 *     if n.v != h.v:             # <<<<<<<<<<<<<<
 *         vlist_append_chunk_top(g, v_next(n.v), h.v)
 * 
 */
  }

  /* "galxe/hamcycle.pyx":96
 *     # restore graph minor edge endpoints (to top of arc lists)
 *     # must be done before removing the minor edges at this level
 *     a = h.m_detached             # <<<<<<<<<<<<<<
 *     while a != n.m_detached:
 *         na = a_next(a)
 */
  __pyx_t_3 = __pyx_v_h->m_detached;
  __pyx_v_a = __pyx_t_3;

  /* "galxe/hamcycle.pyx":97
 *     # must be done before removing the minor edges at this level
 *     a = h.m_detached
 *     while a != n.m_detached:             # <<<<<<<<<<<<<<
 *         na = a_next(a)
 *         a_attach(a, v_arcs_top(a_cross(a).target))
 */
  while (1) {
    __pyx_t_2 = ((__pyx_v_a != __pyx_v_n->m_detached) != 0);
    if (!__pyx_t_2) break;

    /* "galxe/hamcycle.pyx":98
 *     a = h.m_detached
 *     while a != n.m_detached:
 *         na = a_next(a)             # <<<<<<<<<<<<<<
 *         a_attach(a, v_arcs_top(a_cross(a).target))
 *         a = na
 */
    __pyx_v_na = a_next(__pyx_v_a);

    /* "galxe/hamcycle.pyx":99
 *     while a != n.m_detached:
 *         na = a_next(a)
 *         a_attach(a, v_arcs_top(a_cross(a).target))             # <<<<<<<<<<<<<<
 *         a = na
 * 
 */
    a_attach(__pyx_v_a, v_arcs_top(a_cross(__pyx_v_a)->target));

    /* "galxe/hamcycle.pyx":100
 *         na = a_next(a)
 *         a_attach(a, v_arcs_top(a_cross(a).target))
 *         a = na             # <<<<<<<<<<<<<<
 * 
 *     # remove graph minor edges created during path contraction
 */
    __pyx_v_a = __pyx_v_na;
  }

  /* "galxe/hamcycle.pyx":103
 * 
 *     # remove graph minor edges created during path contraction
 *     a = h.m_created             # <<<<<<<<<<<<<<
 *     while a != n.m_created:
 *         a_detach(a)
 */
  __pyx_t_3 = __pyx_v_h->m_created;
  __pyx_v_a = __pyx_t_3;

  /* "galxe/hamcycle.pyx":104
 *     # remove graph minor edges created during path contraction
 *     a = h.m_created
 *     while a != n.m_created:             # <<<<<<<<<<<<<<
 *         a_detach(a)
 *         a_detach(a_cross(a))
 */
  while (1) {
    __pyx_t_2 = ((__pyx_v_a != __pyx_v_n->m_created) != 0);
    if (!__pyx_t_2) break;

    /* "galxe/hamcycle.pyx":105
 *     a = h.m_created
 *     while a != n.m_created:
 *         a_detach(a)             # <<<<<<<<<<<<<<
 *         a_detach(a_cross(a))
 *         f_edges[0] = a_set_next(a, f_edges[0])
 */
    a_detach(__pyx_v_a);

    /* "galxe/hamcycle.pyx":106
 *     while a != n.m_created:
 *         a_detach(a)
 *         a_detach(a_cross(a))             # <<<<<<<<<<<<<<
 *         f_edges[0] = a_set_next(a, f_edges[0])
 *         a = a.w0.arcs
 */
    a_detach(a_cross(__pyx_v_a));

    /* "galxe/hamcycle.pyx":107
 *         a_detach(a)
 *         a_detach(a_cross(a))
 *         f_edges[0] = a_set_next(a, f_edges[0])             # <<<<<<<<<<<<<<
 *         a = a.w0.arcs
 * 
 */
    (__pyx_v_f_edges[0]) = a_set_next(__pyx_v_a, (__pyx_v_f_edges[0]));

    /* "galxe/hamcycle.pyx":108
 *         a_detach(a_cross(a))
 *         f_edges[0] = a_set_next(a, f_edges[0])
 *         a = a.w0.arcs             # <<<<<<<<<<<<<<
 * 
 *     # restore arcs (to the bottom of arc lists)
 */
    __pyx_t_3 = __pyx_v_a->w0.arcs;
    __pyx_v_a = __pyx_t_3;
  }

  /* "galxe/hamcycle.pyx":111
 * 
 *     # restore arcs (to the bottom of arc lists)
 *     a = h.g_detached             # <<<<<<<<<<<<<<
 *     while a != n.g_detached:
 *         na = a_next(a)
 */
  __pyx_t_3 = __pyx_v_h->g_detached;
  __pyx_v_a = __pyx_t_3;

  /* "galxe/hamcycle.pyx":112
 *     # restore arcs (to the bottom of arc lists)
 *     a = h.g_detached
 *     while a != n.g_detached:             # <<<<<<<<<<<<<<
 *         na = a_next(a)
 *         a_attach(a, v_arcs_bottom(a_cross(a).target))
 */
  while (1) {
    __pyx_t_2 = ((__pyx_v_a != __pyx_v_n->g_detached) != 0);
    if (!__pyx_t_2) break;

    /* "galxe/hamcycle.pyx":113
 *     a = h.g_detached
 *     while a != n.g_detached:
 *         na = a_next(a)             # <<<<<<<<<<<<<<
 *         a_attach(a, v_arcs_bottom(a_cross(a).target))
 *         a = na
 */
    __pyx_v_na = a_next(__pyx_v_a);

    /* "galxe/hamcycle.pyx":114
 *     while a != n.g_detached:
 *         na = a_next(a)
 *         a_attach(a, v_arcs_bottom(a_cross(a).target))             # <<<<<<<<<<<<<<
 *         a = na
 *     return n
 */
    a_attach(__pyx_v_a, v_arcs_bottom(a_cross(__pyx_v_a)->target));

    /* "galxe/hamcycle.pyx":115
 *         na = a_next(a)
 *         a_attach(a, v_arcs_bottom(a_cross(a).target))
 *         a = na             # <<<<<<<<<<<<<<
 *     return n
 * 
 */
    __pyx_v_a = __pyx_v_na;
  }

  /* "galxe/hamcycle.pyx":116
 *         a_attach(a, v_arcs_bottom(a_cross(a).target))
 *         a = na
 *     return n             # <<<<<<<<<<<<<<
 * 
 * cdef inline graph_arc *find_endpoint(
 */
  __pyx_r = __pyx_v_n;
  goto __pyx_L0;

  /* "galxe/hamcycle.pyx":77
 *     v_attach(v, vlist_bottom(k))
 * 
 * cdef inline hc_marker *rewind(             # <<<<<<<<<<<<<<
 *     vertex_list *g,
 *     hc_marker *h,
 */

  /* function exit code */
  __pyx_L0:;
  return __pyx_r;
}

/* "galxe/hamcycle.pyx":118
 *     return n
 * 
 * cdef inline graph_arc *find_endpoint(             # <<<<<<<<<<<<<<
 *     vertex_list *g,
 *     vertex_list *k,
 */

static CYTHON_INLINE struct graph_arc *__pyx_f_5galxe_8hamcycle_find_endpoint(CYTHON_UNUSED vertex_list *__pyx_v_g, vertex_list *__pyx_v_k, struct __pyx_t_5galxe_8hamcycle_hc_marker *__pyx_v_h, struct graph_arc *__pyx_v_c, struct graph_arc *__pyx_v_o) {
  struct graph_vertex *__pyx_v_v;
  struct graph_vertex *__pyx_v_w;
  struct graph_vertex *__pyx_v_ov;
  struct graph_arc *__pyx_v_a1;
  struct graph_arc *__pyx_v_ac;
  struct graph_arc *__pyx_v_a;
  struct graph_arc *__pyx_v_z;
  struct graph_arc *__pyx_r;
  struct graph_vertex *__pyx_t_1;
  int __pyx_t_2;
  struct graph_arc *__pyx_t_3;

  /* "galxe/hamcycle.pyx":126
 * ) nogil:
 *     cdef:
 *         (graph_vertex *) v, w, ov = o.target             # <<<<<<<<<<<<<<
 *         (graph_arc *)    a1, ac, a, z
 *     while 1:
 */
  __pyx_t_1 = __pyx_v_o->target;
  __pyx_v_ov = __pyx_t_1;

  /* "galxe/hamcycle.pyx":128
 *         (graph_vertex *) v, w, ov = o.target
 *         (graph_arc *)    a1, ac, a, z
 *     while 1:             # <<<<<<<<<<<<<<
 *         v  = c.target
 *         a1 = v_arcs_first(v)
 */
  while (1) {

    /* "galxe/hamcycle.pyx":129
 *         (graph_arc *)    a1, ac, a, z
 *     while 1:
 *         v  = c.target             # <<<<<<<<<<<<<<
 *         a1 = v_arcs_first(v)
 *         a  = a_next(a1)
 */
    __pyx_t_1 = __pyx_v_c->target;
    __pyx_v_v = __pyx_t_1;

    /* "galxe/hamcycle.pyx":130
 *     while 1:
 *         v  = c.target
 *         a1 = v_arcs_first(v)             # <<<<<<<<<<<<<<
 *         a  = a_next(a1)
 *         ac = a_cross(c)
 */
    __pyx_v_a1 = v_arcs_first(__pyx_v_v);

    /* "galxe/hamcycle.pyx":131
 *         v  = c.target
 *         a1 = v_arcs_first(v)
 *         a  = a_next(a1)             # <<<<<<<<<<<<<<
 *         ac = a_cross(c)
 * 
 */
    __pyx_v_a = a_next(__pyx_v_a1);

    /* "galxe/hamcycle.pyx":132
 *         a1 = v_arcs_first(v)
 *         a  = a_next(a1)
 *         ac = a_cross(c)             # <<<<<<<<<<<<<<
 * 
 *         if v_arcs_is_done(a_next(a), v):
 */
    __pyx_v_ac = a_cross(__pyx_v_c);

    /* "galxe/hamcycle.pyx":134
 *         ac = a_cross(c)
 * 
 *         if v_arcs_is_done(a_next(a), v):             # <<<<<<<<<<<<<<
 *             push_v(h, v) # degree 2
 *             c = a if a1 == ac else a1
 */
    __pyx_t_2 = (v_arcs_is_done(a_next(__pyx_v_a), __pyx_v_v) != 0);
    if (__pyx_t_2) {

      /* "galxe/hamcycle.pyx":135
 * 
 *         if v_arcs_is_done(a_next(a), v):
 *             push_v(h, v) # degree 2             # <<<<<<<<<<<<<<
 *             c = a if a1 == ac else a1
 *             if c.target == ov:
 */
      __pyx_f_5galxe_8hamcycle_push_v(__pyx_v_h, __pyx_v_v);

      /* "galxe/hamcycle.pyx":136
 *         if v_arcs_is_done(a_next(a), v):
 *             push_v(h, v) # degree 2
 *             c = a if a1 == ac else a1             # <<<<<<<<<<<<<<
 *             if c.target == ov:
 *                 push_v(h, ov)
 */
      if (((__pyx_v_a1 == __pyx_v_ac) != 0)) {
        __pyx_t_3 = __pyx_v_a;
      } else {
        __pyx_t_3 = __pyx_v_a1;
      }
      __pyx_v_c = __pyx_t_3;

      /* "galxe/hamcycle.pyx":137
 *             push_v(h, v) # degree 2
 *             c = a if a1 == ac else a1
 *             if c.target == ov:             # <<<<<<<<<<<<<<
 *                 push_v(h, ov)
 *                 return o
 */
      __pyx_t_2 = ((__pyx_v_c->target == __pyx_v_ov) != 0);
      if (__pyx_t_2) {

        /* "galxe/hamcycle.pyx":138
 *             c = a if a1 == ac else a1
 *             if c.target == ov:
 *                 push_v(h, ov)             # <<<<<<<<<<<<<<
 *                 return o
 *             continue
 */
        __pyx_f_5galxe_8hamcycle_push_v(__pyx_v_h, __pyx_v_ov);

        /* "galxe/hamcycle.pyx":139
 *             if c.target == ov:
 *                 push_v(h, ov)
 *                 return o             # <<<<<<<<<<<<<<
 *             continue
 * 
 */
        __pyx_r = __pyx_v_o;
        goto __pyx_L0;

        /* "galxe/hamcycle.pyx":137
 *             push_v(h, v) # degree 2
 *             c = a if a1 == ac else a1
 *             if c.target == ov:             # <<<<<<<<<<<<<<
 *                 push_v(h, ov)
 *                 return o
 */
      }

      /* "galxe/hamcycle.pyx":140
 *                 push_v(h, ov)
 *                 return o
 *             continue             # <<<<<<<<<<<<<<
 * 
 *         if a1.w0.arcs == NULL: return c
 */
      goto __pyx_L3_continue;

      /* "galxe/hamcycle.pyx":134
 *         ac = a_cross(c)
 * 
 *         if v_arcs_is_done(a_next(a), v):             # <<<<<<<<<<<<<<
 *             push_v(h, v) # degree 2
 *             c = a if a1 == ac else a1
 */
    }

    /* "galxe/hamcycle.pyx":142
 *             continue
 * 
 *         if a1.w0.arcs == NULL: return c             # <<<<<<<<<<<<<<
 *         if a1 == ac:           return c
 * 
 */
    __pyx_t_2 = ((__pyx_v_a1->w0.arcs == NULL) != 0);
    if (__pyx_t_2) {
      __pyx_r = __pyx_v_c;
      goto __pyx_L0;
    }

    /* "galxe/hamcycle.pyx":143
 * 
 *         if a1.w0.arcs == NULL: return c
 *         if a1 == ac:           return c             # <<<<<<<<<<<<<<
 * 
 *         # force join of two graph minor edges
 */
    __pyx_t_2 = ((__pyx_v_a1 == __pyx_v_ac) != 0);
    if (__pyx_t_2) {
      __pyx_r = __pyx_v_c;
      goto __pyx_L0;
    }

    /* "galxe/hamcycle.pyx":147
 *         # force join of two graph minor edges
 * 
 *         push_v(h, v)             # <<<<<<<<<<<<<<
 * 
 *         if a1.target == ov:
 */
    __pyx_f_5galxe_8hamcycle_push_v(__pyx_v_h, __pyx_v_v);

    /* "galxe/hamcycle.pyx":149
 *         push_v(h, v)
 * 
 *         if a1.target == ov:             # <<<<<<<<<<<<<<
 *             push_v(h, ov)
 *             return o
 */
    __pyx_t_2 = ((__pyx_v_a1->target == __pyx_v_ov) != 0);
    if (__pyx_t_2) {

      /* "galxe/hamcycle.pyx":150
 * 
 *         if a1.target == ov:
 *             push_v(h, ov)             # <<<<<<<<<<<<<<
 *             return o
 * 
 */
      __pyx_f_5galxe_8hamcycle_push_v(__pyx_v_h, __pyx_v_ov);

      /* "galxe/hamcycle.pyx":151
 *         if a1.target == ov:
 *             push_v(h, ov)
 *             return o             # <<<<<<<<<<<<<<
 * 
 *         if a != ac:
 */
      __pyx_r = __pyx_v_o;
      goto __pyx_L0;

      /* "galxe/hamcycle.pyx":149
 *         push_v(h, v)
 * 
 *         if a1.target == ov:             # <<<<<<<<<<<<<<
 *             push_v(h, ov)
 *             return o
 */
    }

    /* "galxe/hamcycle.pyx":153
 *             return o
 * 
 *         if a != ac:             # <<<<<<<<<<<<<<
 *             a_detach(ac)
 *             a_attach(ac, a_after(a1))
 */
    __pyx_t_2 = ((__pyx_v_a != __pyx_v_ac) != 0);
    if (__pyx_t_2) {

      /* "galxe/hamcycle.pyx":154
 * 
 *         if a != ac:
 *             a_detach(ac)             # <<<<<<<<<<<<<<
 *             a_attach(ac, a_after(a1))
 * 
 */
      a_detach(__pyx_v_ac);

      /* "galxe/hamcycle.pyx":155
 *         if a != ac:
 *             a_detach(ac)
 *             a_attach(ac, a_after(a1))             # <<<<<<<<<<<<<<
 * 
 *         a = a_next(ac)
 */
      a_attach(__pyx_v_ac, a_after(__pyx_v_a1));

      /* "galxe/hamcycle.pyx":153
 *             return o
 * 
 *         if a != ac:             # <<<<<<<<<<<<<<
 *             a_detach(ac)
 *             a_attach(ac, a_after(a1))
 */
    }

    /* "galxe/hamcycle.pyx":157
 *             a_attach(ac, a_after(a1))
 * 
 *         a = a_next(ac)             # <<<<<<<<<<<<<<
 *         while not v_arcs_is_done(a, v):
 *             push_a(h, a_cross(a))
 */
    __pyx_v_a = a_next(__pyx_v_ac);

    /* "galxe/hamcycle.pyx":158
 * 
 *         a = a_next(ac)
 *         while not v_arcs_is_done(a, v):             # <<<<<<<<<<<<<<
 *             push_a(h, a_cross(a))
 *             w = a.target
 */
    while (1) {
      __pyx_t_2 = ((!(v_arcs_is_done(__pyx_v_a, __pyx_v_v) != 0)) != 0);
      if (!__pyx_t_2) break;

      /* "galxe/hamcycle.pyx":159
 *         a = a_next(ac)
 *         while not v_arcs_is_done(a, v):
 *             push_a(h, a_cross(a))             # <<<<<<<<<<<<<<
 *             w = a.target
 *             z = second_arc(w)
 */
      __pyx_f_5galxe_8hamcycle_push_a(__pyx_v_h, a_cross(__pyx_v_a));

      /* "galxe/hamcycle.pyx":160
 *         while not v_arcs_is_done(a, v):
 *             push_a(h, a_cross(a))
 *             w = a.target             # <<<<<<<<<<<<<<
 *             z = second_arc(w)
 *             if v_arcs_is_done(z, w):          return NULL   # degree 1
 */
      __pyx_t_1 = __pyx_v_a->target;
      __pyx_v_w = __pyx_t_1;

      /* "galxe/hamcycle.pyx":161
 *             push_a(h, a_cross(a))
 *             w = a.target
 *             z = second_arc(w)             # <<<<<<<<<<<<<<
 *             if v_arcs_is_done(z, w):          return NULL   # degree 1
 *             if v_arcs_is_done(a_next(z), w):  move_v(k, w)  # degree 2
 */
      __pyx_v_z = __pyx_f_5galxe_8hamcycle_second_arc(__pyx_v_w);

      /* "galxe/hamcycle.pyx":162
 *             w = a.target
 *             z = second_arc(w)
 *             if v_arcs_is_done(z, w):          return NULL   # degree 1             # <<<<<<<<<<<<<<
 *             if v_arcs_is_done(a_next(z), w):  move_v(k, w)  # degree 2
 *             a = a_next(a)
 */
      __pyx_t_2 = (v_arcs_is_done(__pyx_v_z, __pyx_v_w) != 0);
      if (__pyx_t_2) {
        __pyx_r = NULL;
        goto __pyx_L0;
      }

      /* "galxe/hamcycle.pyx":163
 *             z = second_arc(w)
 *             if v_arcs_is_done(z, w):          return NULL   # degree 1
 *             if v_arcs_is_done(a_next(z), w):  move_v(k, w)  # degree 2             # <<<<<<<<<<<<<<
 *             a = a_next(a)
 *         c = a1
 */
      __pyx_t_2 = (v_arcs_is_done(a_next(__pyx_v_z), __pyx_v_w) != 0);
      if (__pyx_t_2) {
        __pyx_f_5galxe_8hamcycle_move_v(__pyx_v_k, __pyx_v_w);
      }

      /* "galxe/hamcycle.pyx":164
 *             if v_arcs_is_done(z, w):          return NULL   # degree 1
 *             if v_arcs_is_done(a_next(z), w):  move_v(k, w)  # degree 2
 *             a = a_next(a)             # <<<<<<<<<<<<<<
 *         c = a1
 * 
 */
      __pyx_v_a = a_next(__pyx_v_a);
    }

    /* "galxe/hamcycle.pyx":165
 *             if v_arcs_is_done(a_next(z), w):  move_v(k, w)  # degree 2
 *             a = a_next(a)
 *         c = a1             # <<<<<<<<<<<<<<
 * 
 * cdef inline int path_contraction(
 */
    __pyx_v_c = __pyx_v_a1;
    __pyx_L3_continue:;
  }

  /* "galxe/hamcycle.pyx":118
 *     return n
 * 
 * cdef inline graph_arc *find_endpoint(             # <<<<<<<<<<<<<<
 *     vertex_list *g,
 *     vertex_list *k,
 */

  /* function exit code */
  __pyx_r = 0;
  __pyx_L0:;
  return __pyx_r;
}

/* "galxe/hamcycle.pyx":167
 *         c = a1
 * 
 * cdef inline int path_contraction(             # <<<<<<<<<<<<<<
 *     graph_arc    *c,
 *     graph_arc    *o,
 */

static CYTHON_INLINE int __pyx_f_5galxe_8hamcycle_path_contraction(struct graph_arc *__pyx_v_c, struct graph_arc *__pyx_v_o, vertex_list *__pyx_v_g, vertex_list *__pyx_v_k, struct __pyx_t_5galxe_8hamcycle_hc_marker *__pyx_v_h, struct graph_arc **__pyx_v_f_edges) {
  struct graph_vertex *__pyx_v_ot;
  struct graph_vertex *__pyx_v_ct;
  struct graph_arc *__pyx_v_a;
  int __pyx_v_z;
  int __pyx_r;
  int __pyx_t_1;
  struct graph_vertex *__pyx_t_2;
  struct graph_arc *__pyx_t_3;

  /* "galxe/hamcycle.pyx":178
 *        (graph_vertex *) ot, ct
 *        (graph_arc *) a
 *        bint z = False             # <<<<<<<<<<<<<<
 * 
 *     while 1:
 */
  __pyx_v_z = 0;

  /* "galxe/hamcycle.pyx":180
 *        bint z = False
 * 
 *     while 1:             # <<<<<<<<<<<<<<
 *         # contract path in two directions along arcs c and o
 *         # until no more contractions possible
 */
  while (1) {

    /* "galxe/hamcycle.pyx":184
 *         # until no more contractions possible
 * 
 *         z = False             # <<<<<<<<<<<<<<
 *         a = find_endpoint(g, k, h, c, o)
 *         if a == NULL: return -1
 */
    __pyx_v_z = 0;

    /* "galxe/hamcycle.pyx":185
 * 
 *         z = False
 *         a = find_endpoint(g, k, h, c, o)             # <<<<<<<<<<<<<<
 *         if a == NULL: return -1
 *         if a == o:    return 1
 */
    __pyx_v_a = __pyx_f_5galxe_8hamcycle_find_endpoint(__pyx_v_g, __pyx_v_k, __pyx_v_h, __pyx_v_c, __pyx_v_o);

    /* "galxe/hamcycle.pyx":186
 *         z = False
 *         a = find_endpoint(g, k, h, c, o)
 *         if a == NULL: return -1             # <<<<<<<<<<<<<<
 *         if a == o:    return 1
 *         if a != c:
 */
    __pyx_t_1 = ((__pyx_v_a == NULL) != 0);
    if (__pyx_t_1) {
      __pyx_r = -1;
      goto __pyx_L0;
    }

    /* "galxe/hamcycle.pyx":187
 *         a = find_endpoint(g, k, h, c, o)
 *         if a == NULL: return -1
 *         if a == o:    return 1             # <<<<<<<<<<<<<<
 *         if a != c:
 *             c = a
 */
    __pyx_t_1 = ((__pyx_v_a == __pyx_v_o) != 0);
    if (__pyx_t_1) {
      __pyx_r = 1;
      goto __pyx_L0;
    }

    /* "galxe/hamcycle.pyx":188
 *         if a == NULL: return -1
 *         if a == o:    return 1
 *         if a != c:             # <<<<<<<<<<<<<<
 *             c = a
 *             z = True
 */
    __pyx_t_1 = ((__pyx_v_a != __pyx_v_c) != 0);
    if (__pyx_t_1) {

      /* "galxe/hamcycle.pyx":189
 *         if a == o:    return 1
 *         if a != c:
 *             c = a             # <<<<<<<<<<<<<<
 *             z = True
 * 
 */
      __pyx_v_c = __pyx_v_a;

      /* "galxe/hamcycle.pyx":190
 *         if a != c:
 *             c = a
 *             z = True             # <<<<<<<<<<<<<<
 * 
 *         a = find_endpoint(g, k, h, o, c)
 */
      __pyx_v_z = 1;

      /* "galxe/hamcycle.pyx":188
 *         if a == NULL: return -1
 *         if a == o:    return 1
 *         if a != c:             # <<<<<<<<<<<<<<
 *             c = a
 *             z = True
 */
    }

    /* "galxe/hamcycle.pyx":192
 *             z = True
 * 
 *         a = find_endpoint(g, k, h, o, c)             # <<<<<<<<<<<<<<
 *         if a == NULL: return -1
 *         if a == c:    return 1
 */
    __pyx_v_a = __pyx_f_5galxe_8hamcycle_find_endpoint(__pyx_v_g, __pyx_v_k, __pyx_v_h, __pyx_v_o, __pyx_v_c);

    /* "galxe/hamcycle.pyx":193
 * 
 *         a = find_endpoint(g, k, h, o, c)
 *         if a == NULL: return -1             # <<<<<<<<<<<<<<
 *         if a == c:    return 1
 *         if a != o:
 */
    __pyx_t_1 = ((__pyx_v_a == NULL) != 0);
    if (__pyx_t_1) {
      __pyx_r = -1;
      goto __pyx_L0;
    }

    /* "galxe/hamcycle.pyx":194
 *         a = find_endpoint(g, k, h, o, c)
 *         if a == NULL: return -1
 *         if a == c:    return 1             # <<<<<<<<<<<<<<
 *         if a != o:
 *             o = a
 */
    __pyx_t_1 = ((__pyx_v_a == __pyx_v_c) != 0);
    if (__pyx_t_1) {
      __pyx_r = 1;
      goto __pyx_L0;
    }

    /* "galxe/hamcycle.pyx":195
 *         if a == NULL: return -1
 *         if a == c:    return 1
 *         if a != o:             # <<<<<<<<<<<<<<
 *             o = a
 *             z = True
 */
    __pyx_t_1 = ((__pyx_v_a != __pyx_v_o) != 0);
    if (__pyx_t_1) {

      /* "galxe/hamcycle.pyx":196
 *         if a == c:    return 1
 *         if a != o:
 *             o = a             # <<<<<<<<<<<<<<
 *             z = True
 * 
 */
      __pyx_v_o = __pyx_v_a;

      /* "galxe/hamcycle.pyx":197
 *         if a != o:
 *             o = a
 *             z = True             # <<<<<<<<<<<<<<
 * 
 *         while z:
 */
      __pyx_v_z = 1;

      /* "galxe/hamcycle.pyx":195
 *         if a == NULL: return -1
 *         if a == c:    return 1
 *         if a != o:             # <<<<<<<<<<<<<<
 *             o = a
 *             z = True
 */
    }

    /* "galxe/hamcycle.pyx":199
 *             z = True
 * 
 *         while z:             # <<<<<<<<<<<<<<
 *             a = find_endpoint(g, k, h, c, o)
 *             if a == NULL: return -1
 */
    while (1) {
      __pyx_t_1 = (__pyx_v_z != 0);
      if (!__pyx_t_1) break;

      /* "galxe/hamcycle.pyx":200
 * 
 *         while z:
 *             a = find_endpoint(g, k, h, c, o)             # <<<<<<<<<<<<<<
 *             if a == NULL: return -1
 *             if a == o:    return 1
 */
      __pyx_v_a = __pyx_f_5galxe_8hamcycle_find_endpoint(__pyx_v_g, __pyx_v_k, __pyx_v_h, __pyx_v_c, __pyx_v_o);

      /* "galxe/hamcycle.pyx":201
 *         while z:
 *             a = find_endpoint(g, k, h, c, o)
 *             if a == NULL: return -1             # <<<<<<<<<<<<<<
 *             if a == o:    return 1
 *             if a == c:    break
 */
      __pyx_t_1 = ((__pyx_v_a == NULL) != 0);
      if (__pyx_t_1) {
        __pyx_r = -1;
        goto __pyx_L0;
      }

      /* "galxe/hamcycle.pyx":202
 *             a = find_endpoint(g, k, h, c, o)
 *             if a == NULL: return -1
 *             if a == o:    return 1             # <<<<<<<<<<<<<<
 *             if a == c:    break
 *             c = o
 */
      __pyx_t_1 = ((__pyx_v_a == __pyx_v_o) != 0);
      if (__pyx_t_1) {
        __pyx_r = 1;
        goto __pyx_L0;
      }

      /* "galxe/hamcycle.pyx":203
 *             if a == NULL: return -1
 *             if a == o:    return 1
 *             if a == c:    break             # <<<<<<<<<<<<<<
 *             c = o
 *             o = a
 */
      __pyx_t_1 = ((__pyx_v_a == __pyx_v_c) != 0);
      if (__pyx_t_1) {
        goto __pyx_L12_break;
      }

      /* "galxe/hamcycle.pyx":204
 *             if a == o:    return 1
 *             if a == c:    break
 *             c = o             # <<<<<<<<<<<<<<
 *             o = a
 * 
 */
      __pyx_v_c = __pyx_v_o;

      /* "galxe/hamcycle.pyx":205
 *             if a == c:    break
 *             c = o
 *             o = a             # <<<<<<<<<<<<<<
 * 
 *         # detach path endpoints from graph
 */
      __pyx_v_o = __pyx_v_a;
    }
    __pyx_L12_break:;

    /* "galxe/hamcycle.pyx":209
 *         # detach path endpoints from graph
 * 
 *         if c.w0.arcs != NULL:  push_m(h, a_cross(c))             # <<<<<<<<<<<<<<
 *         else:                  push_a(h, a_cross(c))
 *         if o.w0.arcs != NULL:  push_m(h, a_cross(o))
 */
    __pyx_t_1 = ((__pyx_v_c->w0.arcs != NULL) != 0);
    if (__pyx_t_1) {
      __pyx_f_5galxe_8hamcycle_push_m(__pyx_v_h, a_cross(__pyx_v_c));
      goto __pyx_L16;
    }

    /* "galxe/hamcycle.pyx":210
 * 
 *         if c.w0.arcs != NULL:  push_m(h, a_cross(c))
 *         else:                  push_a(h, a_cross(c))             # <<<<<<<<<<<<<<
 *         if o.w0.arcs != NULL:  push_m(h, a_cross(o))
 *         else:                  push_a(h, a_cross(o))
 */
    /*else*/ {
      __pyx_f_5galxe_8hamcycle_push_a(__pyx_v_h, a_cross(__pyx_v_c));
    }
    __pyx_L16:;

    /* "galxe/hamcycle.pyx":211
 *         if c.w0.arcs != NULL:  push_m(h, a_cross(c))
 *         else:                  push_a(h, a_cross(c))
 *         if o.w0.arcs != NULL:  push_m(h, a_cross(o))             # <<<<<<<<<<<<<<
 *         else:                  push_a(h, a_cross(o))
 * 
 */
    __pyx_t_1 = ((__pyx_v_o->w0.arcs != NULL) != 0);
    if (__pyx_t_1) {
      __pyx_f_5galxe_8hamcycle_push_m(__pyx_v_h, a_cross(__pyx_v_o));
      goto __pyx_L17;
    }

    /* "galxe/hamcycle.pyx":212
 *         else:                  push_a(h, a_cross(c))
 *         if o.w0.arcs != NULL:  push_m(h, a_cross(o))
 *         else:                  push_a(h, a_cross(o))             # <<<<<<<<<<<<<<
 * 
 *         ct = c.target
 */
    /*else*/ {
      __pyx_f_5galxe_8hamcycle_push_a(__pyx_v_h, a_cross(__pyx_v_o));
    }
    __pyx_L17:;

    /* "galxe/hamcycle.pyx":214
 *         else:                  push_a(h, a_cross(o))
 * 
 *         ct = c.target             # <<<<<<<<<<<<<<
 *         ot = o.target
 *         a  = v_arcs_first(ct)
 */
    __pyx_t_2 = __pyx_v_c->target;
    __pyx_v_ct = __pyx_t_2;

    /* "galxe/hamcycle.pyx":215
 * 
 *         ct = c.target
 *         ot = o.target             # <<<<<<<<<<<<<<
 *         a  = v_arcs_first(ct)
 * 
 */
    __pyx_t_2 = __pyx_v_o->target;
    __pyx_v_ot = __pyx_t_2;

    /* "galxe/hamcycle.pyx":216
 *         ct = c.target
 *         ot = o.target
 *         a  = v_arcs_first(ct)             # <<<<<<<<<<<<<<
 * 
 *         # pull new endpoints to top of graph so
 */
    __pyx_v_a = v_arcs_first(__pyx_v_ct);

    /* "galxe/hamcycle.pyx":224
 *         # the vertices before starting search
 * 
 *         v_detach(ct)             # <<<<<<<<<<<<<<
 *         v_detach(ot)
 *         v_attach(ot, vlist_top(g))
 */
    v_detach(__pyx_v_ct);

    /* "galxe/hamcycle.pyx":225
 * 
 *         v_detach(ct)
 *         v_detach(ot)             # <<<<<<<<<<<<<<
 *         v_attach(ot, vlist_top(g))
 *         v_attach(ct, vlist_top(g))
 */
    v_detach(__pyx_v_ot);

    /* "galxe/hamcycle.pyx":226
 *         v_detach(ct)
 *         v_detach(ot)
 *         v_attach(ot, vlist_top(g))             # <<<<<<<<<<<<<<
 *         v_attach(ct, vlist_top(g))
 * 
 */
    v_attach(__pyx_v_ot, vlist_top(__pyx_v_g));

    /* "galxe/hamcycle.pyx":227
 *         v_detach(ot)
 *         v_attach(ot, vlist_top(g))
 *         v_attach(ct, vlist_top(g))             # <<<<<<<<<<<<<<
 * 
 *         # find and remove pre-existing edge between ot / ct
 */
    v_attach(__pyx_v_ct, vlist_top(__pyx_v_g));

    /* "galxe/hamcycle.pyx":231
 *         # find and remove pre-existing edge between ot / ct
 * 
 *         while not v_arcs_is_done(a, ct):             # <<<<<<<<<<<<<<
 *             if a.target == ot:
 *                 # remove pre-existing edge
 */
    while (1) {
      __pyx_t_1 = ((!(v_arcs_is_done(__pyx_v_a, __pyx_v_ct) != 0)) != 0);
      if (!__pyx_t_1) break;

      /* "galxe/hamcycle.pyx":232
 * 
 *         while not v_arcs_is_done(a, ct):
 *             if a.target == ot:             # <<<<<<<<<<<<<<
 *                 # remove pre-existing edge
 *                 push_e(h, a)
 */
      __pyx_t_1 = ((__pyx_v_a->target == __pyx_v_ot) != 0);
      if (__pyx_t_1) {

        /* "galxe/hamcycle.pyx":234
 *             if a.target == ot:
 *                 # remove pre-existing edge
 *                 push_e(h, a)             # <<<<<<<<<<<<<<
 *                 if a_cross(c) != o:
 *                     #change in degree only when not replacing an edge
 */
        __pyx_f_5galxe_8hamcycle_push_e(__pyx_v_h, __pyx_v_a);

        /* "galxe/hamcycle.pyx":235
 *                 # remove pre-existing edge
 *                 push_e(h, a)
 *                 if a_cross(c) != o:             # <<<<<<<<<<<<<<
 *                     #change in degree only when not replacing an edge
 *                     if no_second_arc(ot): move_v(k, ot)
 */
        __pyx_t_1 = ((a_cross(__pyx_v_c) != __pyx_v_o) != 0);
        if (__pyx_t_1) {

          /* "galxe/hamcycle.pyx":237
 *                 if a_cross(c) != o:
 *                     #change in degree only when not replacing an edge
 *                     if no_second_arc(ot): move_v(k, ot)             # <<<<<<<<<<<<<<
 *                     if no_second_arc(ct): move_v(k, ct)
 *                 break
 */
          __pyx_t_1 = (__pyx_f_5galxe_8hamcycle_no_second_arc(__pyx_v_ot) != 0);
          if (__pyx_t_1) {
            __pyx_f_5galxe_8hamcycle_move_v(__pyx_v_k, __pyx_v_ot);
          }

          /* "galxe/hamcycle.pyx":238
 *                     #change in degree only when not replacing an edge
 *                     if no_second_arc(ot): move_v(k, ot)
 *                     if no_second_arc(ct): move_v(k, ct)             # <<<<<<<<<<<<<<
 *                 break
 *             a = a_next(a)
 */
          __pyx_t_1 = (__pyx_f_5galxe_8hamcycle_no_second_arc(__pyx_v_ct) != 0);
          if (__pyx_t_1) {
            __pyx_f_5galxe_8hamcycle_move_v(__pyx_v_k, __pyx_v_ct);
          }

          /* "galxe/hamcycle.pyx":235
 *                 # remove pre-existing edge
 *                 push_e(h, a)
 *                 if a_cross(c) != o:             # <<<<<<<<<<<<<<
 *                     #change in degree only when not replacing an edge
 *                     if no_second_arc(ot): move_v(k, ot)
 */
        }

        /* "galxe/hamcycle.pyx":239
 *                     if no_second_arc(ot): move_v(k, ot)
 *                     if no_second_arc(ct): move_v(k, ct)
 *                 break             # <<<<<<<<<<<<<<
 *             a = a_next(a)
 * 
 */
        goto __pyx_L19_break;

        /* "galxe/hamcycle.pyx":232
 * 
 *         while not v_arcs_is_done(a, ct):
 *             if a.target == ot:             # <<<<<<<<<<<<<<
 *                 # remove pre-existing edge
 *                 push_e(h, a)
 */
      }

      /* "galxe/hamcycle.pyx":240
 *                     if no_second_arc(ct): move_v(k, ct)
 *                 break
 *             a = a_next(a)             # <<<<<<<<<<<<<<
 * 
 *         # place graph minor edge between c.target and o.target
 */
      __pyx_v_a = a_next(__pyx_v_a);
    }
    __pyx_L19_break:;

    /* "galxe/hamcycle.pyx":244
 *         # place graph minor edge between c.target and o.target
 * 
 *         a = f_edges[0]             # <<<<<<<<<<<<<<
 *         f_edges[0] = a_next(a)
 *         a.target = ct
 */
    __pyx_v_a = (__pyx_v_f_edges[0]);

    /* "galxe/hamcycle.pyx":245
 * 
 *         a = f_edges[0]
 *         f_edges[0] = a_next(a)             # <<<<<<<<<<<<<<
 *         a.target = ct
 *         a_cross(a).target = ot
 */
    (__pyx_v_f_edges[0]) = a_next(__pyx_v_a);

    /* "galxe/hamcycle.pyx":246
 *         a = f_edges[0]
 *         f_edges[0] = a_next(a)
 *         a.target = ct             # <<<<<<<<<<<<<<
 *         a_cross(a).target = ot
 *         a.w0.arcs = h.m_created
 */
    __pyx_v_a->target = __pyx_v_ct;

    /* "galxe/hamcycle.pyx":247
 *         f_edges[0] = a_next(a)
 *         a.target = ct
 *         a_cross(a).target = ot             # <<<<<<<<<<<<<<
 *         a.w0.arcs = h.m_created
 *         a_cross(a).w0.arcs = h.m_created
 */
    a_cross(__pyx_v_a)->target = __pyx_v_ot;

    /* "galxe/hamcycle.pyx":248
 *         a.target = ct
 *         a_cross(a).target = ot
 *         a.w0.arcs = h.m_created             # <<<<<<<<<<<<<<
 *         a_cross(a).w0.arcs = h.m_created
 *         h.m_created = a
 */
    __pyx_t_3 = __pyx_v_h->m_created;
    __pyx_v_a->w0.arcs = __pyx_t_3;

    /* "galxe/hamcycle.pyx":249
 *         a_cross(a).target = ot
 *         a.w0.arcs = h.m_created
 *         a_cross(a).w0.arcs = h.m_created             # <<<<<<<<<<<<<<
 *         h.m_created = a
 * 
 */
    __pyx_t_3 = __pyx_v_h->m_created;
    a_cross(__pyx_v_a)->w0.arcs = __pyx_t_3;

    /* "galxe/hamcycle.pyx":250
 *         a.w0.arcs = h.m_created
 *         a_cross(a).w0.arcs = h.m_created
 *         h.m_created = a             # <<<<<<<<<<<<<<
 * 
 *         # ensure edge is the first arc in each list
 */
    __pyx_v_h->m_created = __pyx_v_a;

    /* "galxe/hamcycle.pyx":254
 *         # ensure edge is the first arc in each list
 * 
 *         a_attach(a, v_arcs_top(ot))             # <<<<<<<<<<<<<<
 *         a_attach(a_cross(a), v_arcs_top(ct))
 * 
 */
    a_attach(__pyx_v_a, v_arcs_top(__pyx_v_ot));

    /* "galxe/hamcycle.pyx":255
 * 
 *         a_attach(a, v_arcs_top(ot))
 *         a_attach(a_cross(a), v_arcs_top(ct))             # <<<<<<<<<<<<<<
 * 
 * 
 */
    a_attach(a_cross(__pyx_v_a), v_arcs_top(__pyx_v_ct));

    /* "galxe/hamcycle.pyx":258
 * 
 * 
 *         ct = vlist_first(k)             # <<<<<<<<<<<<<<
 *         if vlist_is_done(ct, k): break     # all possible paths contracted
 *         c = v_arcs_first(ct)
 */
    __pyx_v_ct = vlist_first(__pyx_v_k);

    /* "galxe/hamcycle.pyx":259
 * 
 *         ct = vlist_first(k)
 *         if vlist_is_done(ct, k): break     # all possible paths contracted             # <<<<<<<<<<<<<<
 *         c = v_arcs_first(ct)
 *         o = a_next(c)
 */
    __pyx_t_1 = (vlist_is_done(__pyx_v_ct, __pyx_v_k) != 0);
    if (__pyx_t_1) {
      goto __pyx_L4_break;
    }

    /* "galxe/hamcycle.pyx":260
 *         ct = vlist_first(k)
 *         if vlist_is_done(ct, k): break     # all possible paths contracted
 *         c = v_arcs_first(ct)             # <<<<<<<<<<<<<<
 *         o = a_next(c)
 *         push_v(h, ct)
 */
    __pyx_v_c = v_arcs_first(__pyx_v_ct);

    /* "galxe/hamcycle.pyx":261
 *         if vlist_is_done(ct, k): break     # all possible paths contracted
 *         c = v_arcs_first(ct)
 *         o = a_next(c)             # <<<<<<<<<<<<<<
 *         push_v(h, ct)
 *     return 0
 */
    __pyx_v_o = a_next(__pyx_v_c);

    /* "galxe/hamcycle.pyx":262
 *         c = v_arcs_first(ct)
 *         o = a_next(c)
 *         push_v(h, ct)             # <<<<<<<<<<<<<<
 *     return 0
 * 
 */
    __pyx_f_5galxe_8hamcycle_push_v(__pyx_v_h, __pyx_v_ct);
  }
  __pyx_L4_break:;

  /* "galxe/hamcycle.pyx":263
 *         o = a_next(c)
 *         push_v(h, ct)
 *     return 0             # <<<<<<<<<<<<<<
 * 
 * cdef inline bint _prep(vertex_list *g, vertex_list *k) nogil:
 */
  __pyx_r = 0;
  goto __pyx_L0;

  /* "galxe/hamcycle.pyx":167
 *         c = a1
 * 
 * cdef inline int path_contraction(             # <<<<<<<<<<<<<<
 *     graph_arc    *c,
 *     graph_arc    *o,
 */

  /* function exit code */
  __pyx_L0:;
  return __pyx_r;
}

/* "galxe/hamcycle.pyx":265
 *     return 0
 * 
 * cdef inline bint _prep(vertex_list *g, vertex_list *k) nogil:             # <<<<<<<<<<<<<<
 *     cdef:
 *         (graph_vertex *) n, max_v ,v = vlist_first(g)
 */

static CYTHON_INLINE int __pyx_f_5galxe_8hamcycle__prep(vertex_list *__pyx_v_g, vertex_list *__pyx_v_k) {
  struct graph_vertex *__pyx_v_n;
  struct graph_vertex *__pyx_v_v;
  struct graph_arc *__pyx_v_a;
  size_t __pyx_v_c;
  CYTHON_UNUSED size_t __pyx_v_max_c;
  int __pyx_r;
  int __pyx_t_1;

  /* "galxe/hamcycle.pyx":267
 * cdef inline bint _prep(vertex_list *g, vertex_list *k) nogil:
 *     cdef:
 *         (graph_vertex *) n, max_v ,v = vlist_first(g)             # <<<<<<<<<<<<<<
 *         graph_arc *a
 *         size_t     c = 0, max_c = 0
 */
  __pyx_v_v = vlist_first(__pyx_v_g);

  /* "galxe/hamcycle.pyx":269
 *         (graph_vertex *) n, max_v ,v = vlist_first(g)
 *         graph_arc *a
 *         size_t     c = 0, max_c = 0             # <<<<<<<<<<<<<<
 * 
 *     # TODO: enable sorting with an option
 */
  __pyx_v_c = 0;
  __pyx_v_max_c = 0;

  /* "galxe/hamcycle.pyx":292
 *     #vlist_combine_bottom(g, k)
 * 
 *     v = vlist_first(g)             # <<<<<<<<<<<<<<
 *     while not vlist_is_done(v, g):
 *         a = v_arcs_first(v)
 */
  __pyx_v_v = vlist_first(__pyx_v_g);

  /* "galxe/hamcycle.pyx":293
 * 
 *     v = vlist_first(g)
 *     while not vlist_is_done(v, g):             # <<<<<<<<<<<<<<
 *         a = v_arcs_first(v)
 *         c = 0
 */
  while (1) {
    __pyx_t_1 = ((!(vlist_is_done(__pyx_v_v, __pyx_v_g) != 0)) != 0);
    if (!__pyx_t_1) break;

    /* "galxe/hamcycle.pyx":294
 *     v = vlist_first(g)
 *     while not vlist_is_done(v, g):
 *         a = v_arcs_first(v)             # <<<<<<<<<<<<<<
 *         c = 0
 *         while not v_arcs_is_done(a, v):
 */
    __pyx_v_a = v_arcs_first(__pyx_v_v);

    /* "galxe/hamcycle.pyx":295
 *     while not vlist_is_done(v, g):
 *         a = v_arcs_first(v)
 *         c = 0             # <<<<<<<<<<<<<<
 *         while not v_arcs_is_done(a, v):
 *             a.w0.arcs = NULL
 */
    __pyx_v_c = 0;

    /* "galxe/hamcycle.pyx":296
 *         a = v_arcs_first(v)
 *         c = 0
 *         while not v_arcs_is_done(a, v):             # <<<<<<<<<<<<<<
 *             a.w0.arcs = NULL
 *             c += 1
 */
    while (1) {
      __pyx_t_1 = ((!(v_arcs_is_done(__pyx_v_a, __pyx_v_v) != 0)) != 0);
      if (!__pyx_t_1) break;

      /* "galxe/hamcycle.pyx":297
 *         c = 0
 *         while not v_arcs_is_done(a, v):
 *             a.w0.arcs = NULL             # <<<<<<<<<<<<<<
 *             c += 1
 *             a = a_next(a)
 */
      __pyx_v_a->w0.arcs = NULL;

      /* "galxe/hamcycle.pyx":298
 *         while not v_arcs_is_done(a, v):
 *             a.w0.arcs = NULL
 *             c += 1             # <<<<<<<<<<<<<<
 *             a = a_next(a)
 *         n = v_next(v)
 */
      __pyx_v_c = (__pyx_v_c + 1);

      /* "galxe/hamcycle.pyx":299
 *             a.w0.arcs = NULL
 *             c += 1
 *             a = a_next(a)             # <<<<<<<<<<<<<<
 *         n = v_next(v)
 *         if c == 2: move_v(k, v)
 */
      __pyx_v_a = a_next(__pyx_v_a);
    }

    /* "galxe/hamcycle.pyx":300
 *             c += 1
 *             a = a_next(a)
 *         n = v_next(v)             # <<<<<<<<<<<<<<
 *         if c == 2: move_v(k, v)
 *         elif c == 1: return True
 */
    __pyx_v_n = v_next(__pyx_v_v);

    /* "galxe/hamcycle.pyx":301
 *             a = a_next(a)
 *         n = v_next(v)
 *         if c == 2: move_v(k, v)             # <<<<<<<<<<<<<<
 *         elif c == 1: return True
 *         v = n
 */
    switch (__pyx_v_c) {
      case 2:
      __pyx_f_5galxe_8hamcycle_move_v(__pyx_v_k, __pyx_v_v);
      break;

      /* "galxe/hamcycle.pyx":302
 *         n = v_next(v)
 *         if c == 2: move_v(k, v)
 *         elif c == 1: return True             # <<<<<<<<<<<<<<
 *         v = n
 *     return False
 */
      case 1:
      __pyx_r = 1;
      goto __pyx_L0;
      break;
      default: break;
    }

    /* "galxe/hamcycle.pyx":303
 *         if c == 2: move_v(k, v)
 *         elif c == 1: return True
 *         v = n             # <<<<<<<<<<<<<<
 *     return False
 * 
 */
    __pyx_v_v = __pyx_v_n;
  }

  /* "galxe/hamcycle.pyx":304
 *         elif c == 1: return True
 *         v = n
 *     return False             # <<<<<<<<<<<<<<
 * 
 * cdef void _allocate(
 */
  __pyx_r = 0;
  goto __pyx_L0;

  /* "galxe/hamcycle.pyx":265
 *     return 0
 * 
 * cdef inline bint _prep(vertex_list *g, vertex_list *k) nogil:             # <<<<<<<<<<<<<<
 *     cdef:
 *         (graph_vertex *) n, max_v ,v = vlist_first(g)
 */

  /* function exit code */
  __pyx_L0:;
  return __pyx_r;
}

/* "galxe/hamcycle.pyx":306
 *     return False
 * 
 * cdef void _allocate(             # <<<<<<<<<<<<<<
 *     MBlockAllocator m,
 *     EdgeManager em,
 */

static void __pyx_f_5galxe_8hamcycle__allocate(struct __pyx_obj_5galxe_5utils_MBlockAllocator *__pyx_v_m, struct __pyx_obj_5galxe_4core_EdgeManager *__pyx_v_em, size_t __pyx_v_count, struct __pyx_t_5galxe_8hamcycle_hc_marker **__pyx_v_f_markers, struct graph_arc **__pyx_v_f_edges) {
  struct __pyx_t_5galxe_8hamcycle_hc_marker *__pyx_v_h;
  struct graph_arc *__pyx_v_a;
  CYTHON_UNUSED size_t __pyx_v__;
  __Pyx_RefNannyDeclarations
  size_t __pyx_t_1;
  size_t __pyx_t_2;
  void *__pyx_t_3;
  struct graph_arc *__pyx_t_4;
  __Pyx_RefNannySetupContext("_allocate", 0);

  /* "galxe/hamcycle.pyx":316
 *         hc_marker *h
 *         graph_arc *a
 *     for _ in xrange(count):             # <<<<<<<<<<<<<<
 *         h = <hc_marker*>m.request(sizeof(hc_marker))
 *         h.next = f_markers[0]
 */
  __pyx_t_1 = __pyx_v_count;
  for (__pyx_t_2 = 0; __pyx_t_2 < __pyx_t_1; __pyx_t_2+=1) {
    __pyx_v__ = __pyx_t_2;

    /* "galxe/hamcycle.pyx":317
 *         graph_arc *a
 *     for _ in xrange(count):
 *         h = <hc_marker*>m.request(sizeof(hc_marker))             # <<<<<<<<<<<<<<
 *         h.next = f_markers[0]
 *         f_markers[0] = h
 */
    __pyx_t_3 = ((struct __pyx_vtabstruct_5galxe_5utils_MBlockAllocator *)__pyx_v_m->__pyx_vtab)->request(__pyx_v_m, (sizeof(struct __pyx_t_5galxe_8hamcycle_hc_marker))); if (unlikely(__pyx_t_3 == NULL)) __PYX_ERR(0, 317, __pyx_L1_error)
    __pyx_v_h = ((struct __pyx_t_5galxe_8hamcycle_hc_marker *)__pyx_t_3);

    /* "galxe/hamcycle.pyx":318
 *     for _ in xrange(count):
 *         h = <hc_marker*>m.request(sizeof(hc_marker))
 *         h.next = f_markers[0]             # <<<<<<<<<<<<<<
 *         f_markers[0] = h
 *         a  = em.request()
 */
    __pyx_v_h->next = (__pyx_v_f_markers[0]);

    /* "galxe/hamcycle.pyx":319
 *         h = <hc_marker*>m.request(sizeof(hc_marker))
 *         h.next = f_markers[0]
 *         f_markers[0] = h             # <<<<<<<<<<<<<<
 *         a  = em.request()
 *         f_edges[0] = a_set_next(a, f_edges[0])
 */
    (__pyx_v_f_markers[0]) = __pyx_v_h;

    /* "galxe/hamcycle.pyx":320
 *         h.next = f_markers[0]
 *         f_markers[0] = h
 *         a  = em.request()             # <<<<<<<<<<<<<<
 *         f_edges[0] = a_set_next(a, f_edges[0])
 * 
 */
    __pyx_t_4 = ((struct __pyx_vtabstruct_5galxe_4core_EdgeManager *)__pyx_v_em->__pyx_vtab)->request(__pyx_v_em); if (unlikely(__pyx_t_4 == NULL)) __PYX_ERR(0, 320, __pyx_L1_error)
    __pyx_v_a = __pyx_t_4;

    /* "galxe/hamcycle.pyx":321
 *         f_markers[0] = h
 *         a  = em.request()
 *         f_edges[0] = a_set_next(a, f_edges[0])             # <<<<<<<<<<<<<<
 * 
 * cdef void _deallocate(EdgeManager em, graph_arc *f_edges):
 */
    (__pyx_v_f_edges[0]) = a_set_next(__pyx_v_a, (__pyx_v_f_edges[0]));
  }

  /* "galxe/hamcycle.pyx":306
 *     return False
 * 
 * cdef void _allocate(             # <<<<<<<<<<<<<<
 *     MBlockAllocator m,
 *     EdgeManager em,
 */

  /* function exit code */
  goto __pyx_L0;
  __pyx_L1_error:;
  __Pyx_AddTraceback("galxe.hamcycle._allocate", __pyx_clineno, __pyx_lineno, __pyx_filename);
  __pyx_L0:;
  __Pyx_RefNannyFinishContext();
}

/* "galxe/hamcycle.pyx":323
 *         f_edges[0] = a_set_next(a, f_edges[0])
 * 
 * cdef void _deallocate(EdgeManager em, graph_arc *f_edges):             # <<<<<<<<<<<<<<
 *     cdef graph_arc *a
 *     while f_edges != NULL:
 */

static void __pyx_f_5galxe_8hamcycle__deallocate(struct __pyx_obj_5galxe_4core_EdgeManager *__pyx_v_em, struct graph_arc *__pyx_v_f_edges) {
  struct graph_arc *__pyx_v_a;
  __Pyx_RefNannyDeclarations
  int __pyx_t_1;
  __Pyx_RefNannySetupContext("_deallocate", 0);

  /* "galxe/hamcycle.pyx":325
 * cdef void _deallocate(EdgeManager em, graph_arc *f_edges):
 *     cdef graph_arc *a
 *     while f_edges != NULL:             # <<<<<<<<<<<<<<
 *         a = a_next(f_edges)
 *         em.release(f_edges)
 */
  while (1) {
    __pyx_t_1 = ((__pyx_v_f_edges != NULL) != 0);
    if (!__pyx_t_1) break;

    /* "galxe/hamcycle.pyx":326
 *     cdef graph_arc *a
 *     while f_edges != NULL:
 *         a = a_next(f_edges)             # <<<<<<<<<<<<<<
 *         em.release(f_edges)
 *         f_edges = a
 */
    __pyx_v_a = a_next(__pyx_v_f_edges);

    /* "galxe/hamcycle.pyx":327
 *     while f_edges != NULL:
 *         a = a_next(f_edges)
 *         em.release(f_edges)             # <<<<<<<<<<<<<<
 *         f_edges = a
 * 
 */
    ((struct __pyx_vtabstruct_5galxe_4core_EdgeManager *)__pyx_v_em->__pyx_vtab)->release(__pyx_v_em, __pyx_v_f_edges);

    /* "galxe/hamcycle.pyx":328
 *         a = a_next(f_edges)
 *         em.release(f_edges)
 *         f_edges = a             # <<<<<<<<<<<<<<
 * 
 * @cython.embedsignature(True)
 */
    __pyx_v_f_edges = __pyx_v_a;
  }

  /* "galxe/hamcycle.pyx":323
 *         f_edges[0] = a_set_next(a, f_edges[0])
 * 
 * cdef void _deallocate(EdgeManager em, graph_arc *f_edges):             # <<<<<<<<<<<<<<
 *     cdef graph_arc *a
 *     while f_edges != NULL:
 */

  /* function exit code */
  __Pyx_RefNannyFinishContext();
}

/* "galxe/hamcycle.pyx":331
 * 
 * @cython.embedsignature(True)
 * cpdef size_t hc_count(Graph graph) except *:             # <<<<<<<<<<<<<<
 *     if graph is None: return 0  # guard against segfaults...
 *     cdef:
 */

static PyObject *__pyx_pw_5galxe_8hamcycle_1hc_count(PyObject *__pyx_self, PyObject *__pyx_v_graph); /*proto*/
static size_t __pyx_f_5galxe_8hamcycle_hc_count(struct __pyx_obj_5galxe_5graph_Graph *__pyx_v_graph, CYTHON_UNUSED int __pyx_skip_dispatch) {
  struct graph_arc __pyx_v_dummy_arc;
  vertex_list __pyx_v_d2_vertices;
  vertex_list __pyx_v_hamcycle;
  vertex_list *__pyx_v_g;
  vertex_list *__pyx_v_k;
  struct graph_arc *__pyx_v_a;
  struct graph_arc *__pyx_v_a1;
  struct graph_arc *__pyx_v_a2;
  struct graph_arc *__pyx_v_f_edges;
  struct __pyx_t_5galxe_8hamcycle_hc_marker __pyx_v_base;
  struct __pyx_t_5galxe_8hamcycle_hc_marker __pyx_v_stop;
  struct __pyx_t_5galxe_8hamcycle_hc_marker *__pyx_v_h;
  struct __pyx_t_5galxe_8hamcycle_hc_marker *__pyx_v_f_markers;
  struct __pyx_obj_5galxe_5utils_MBlockAllocator *__pyx_v_m = 0;
  struct graph_vertex *__pyx_v_v;
  size_t __pyx_v_count;
  int __pyx_v_x;
  CYTHON_UNUSED PyObject *__pyx_v_sys = NULL;
  size_t __pyx_r;
  __Pyx_RefNannyDeclarations
  int __pyx_t_1;
  int __pyx_t_2;
  PyObject *__pyx_t_3 = NULL;
  PyObject *__pyx_t_4 = NULL;
  struct graph_arc *__pyx_t_5;
  struct graph_vertex *__pyx_t_6;
  __Pyx_RefNannySetupContext("hc_count", 0);

  /* "galxe/hamcycle.pyx":332
 * @cython.embedsignature(True)
 * cpdef size_t hc_count(Graph graph) except *:
 *     if graph is None: return 0  # guard against segfaults...             # <<<<<<<<<<<<<<
 *     cdef:
 *         graph_arc        dummy_arc
 */
  __pyx_t_1 = (((PyObject *)__pyx_v_graph) == Py_None);
  __pyx_t_2 = (__pyx_t_1 != 0);
  if (__pyx_t_2) {
    __pyx_r = 0;
    goto __pyx_L0;
  }

  /* "galxe/hamcycle.pyx":336
 *         graph_arc        dummy_arc
 *         vertex_list      d2_vertices, hamcycle
 *         (vertex_list *)  g = &graph.vertices, k = &d2_vertices             # <<<<<<<<<<<<<<
 *         (graph_arc *)    a, a1, a2
 *         graph_arc       *f_edges = NULL
 */
  __pyx_v_g = (&__pyx_v_graph->vertices);
  __pyx_v_k = (&__pyx_v_d2_vertices);

  /* "galxe/hamcycle.pyx":338
 *         (vertex_list *)  g = &graph.vertices, k = &d2_vertices
 *         (graph_arc *)    a, a1, a2
 *         graph_arc       *f_edges = NULL             # <<<<<<<<<<<<<<
 *         hc_marker        base, stop
 *         (hc_marker *)    h = &base, f_markers = NULL
 */
  __pyx_v_f_edges = NULL;

  /* "galxe/hamcycle.pyx":340
 *         graph_arc       *f_edges = NULL
 *         hc_marker        base, stop
 *         (hc_marker *)    h = &base, f_markers = NULL             # <<<<<<<<<<<<<<
 *         MBlockAllocator  m
 *         (graph_vertex *) v
 */
  __pyx_v_h = (&__pyx_v_base);
  __pyx_v_f_markers = NULL;

  /* "galxe/hamcycle.pyx":343
 *         MBlockAllocator  m
 *         (graph_vertex *) v
 *         size_t           count = 0             # <<<<<<<<<<<<<<
 *         int              x     = 0
 * 
 */
  __pyx_v_count = 0;

  /* "galxe/hamcycle.pyx":344
 *         (graph_vertex *) v
 *         size_t           count = 0
 *         int              x     = 0             # <<<<<<<<<<<<<<
 * 
 *     count = vlist_length(g)
 */
  __pyx_v_x = 0;

  /* "galxe/hamcycle.pyx":346
 *         int              x     = 0
 * 
 *     count = vlist_length(g)             # <<<<<<<<<<<<<<
 *     if count < 3 or not graph.connected(): return 0
 *     m = MBlockAllocator(graph.vb_count()*sizeof(hc_marker))
 */
  __pyx_v_count = vlist_length(__pyx_v_g);

  /* "galxe/hamcycle.pyx":347
 * 
 *     count = vlist_length(g)
 *     if count < 3 or not graph.connected(): return 0             # <<<<<<<<<<<<<<
 *     m = MBlockAllocator(graph.vb_count()*sizeof(hc_marker))
 * 
 */
  __pyx_t_1 = ((__pyx_v_count < 3) != 0);
  if (!__pyx_t_1) {
  } else {
    __pyx_t_2 = __pyx_t_1;
    goto __pyx_L5_bool_binop_done;
  }
  __pyx_t_1 = ((!(((struct __pyx_vtabstruct_5galxe_5graph_Graph *)__pyx_v_graph->__pyx_vtab)->connected(__pyx_v_graph, 0) != 0)) != 0);
  __pyx_t_2 = __pyx_t_1;
  __pyx_L5_bool_binop_done:;
  if (__pyx_t_2) {
    __pyx_r = 0;
    goto __pyx_L0;
  }

  /* "galxe/hamcycle.pyx":348
 *     count = vlist_length(g)
 *     if count < 3 or not graph.connected(): return 0
 *     m = MBlockAllocator(graph.vb_count()*sizeof(hc_marker))             # <<<<<<<<<<<<<<
 * 
 *     _allocate(m, graph.e_manager, count - 1 , &f_markers, &f_edges)
 */
  __pyx_t_3 = __Pyx_PyInt_FromSize_t((((struct __pyx_vtabstruct_5galxe_5graph_Graph *)__pyx_v_graph->__pyx_vtab)->vb_count(__pyx_v_graph) * (sizeof(struct __pyx_t_5galxe_8hamcycle_hc_marker)))); if (unlikely(!__pyx_t_3)) __PYX_ERR(0, 348, __pyx_L1_error)
  __Pyx_GOTREF(__pyx_t_3);
  __pyx_t_4 = PyTuple_New(1); if (unlikely(!__pyx_t_4)) __PYX_ERR(0, 348, __pyx_L1_error)
  __Pyx_GOTREF(__pyx_t_4);
  __Pyx_GIVEREF(__pyx_t_3);
  PyTuple_SET_ITEM(__pyx_t_4, 0, __pyx_t_3);
  __pyx_t_3 = 0;
  __pyx_t_3 = __Pyx_PyObject_Call(((PyObject *)__pyx_ptype_5galxe_5utils_MBlockAllocator), __pyx_t_4, NULL); if (unlikely(!__pyx_t_3)) __PYX_ERR(0, 348, __pyx_L1_error)
  __Pyx_GOTREF(__pyx_t_3);
  __Pyx_DECREF(__pyx_t_4); __pyx_t_4 = 0;
  __pyx_v_m = ((struct __pyx_obj_5galxe_5utils_MBlockAllocator *)__pyx_t_3);
  __pyx_t_3 = 0;

  /* "galxe/hamcycle.pyx":350
 *     m = MBlockAllocator(graph.vb_count()*sizeof(hc_marker))
 * 
 *     _allocate(m, graph.e_manager, count - 1 , &f_markers, &f_edges)             # <<<<<<<<<<<<<<
 * 
 *     vlist_reset(k)
 */
  __pyx_t_3 = ((PyObject *)__pyx_v_graph->e_manager);
  __Pyx_INCREF(__pyx_t_3);
  __pyx_f_5galxe_8hamcycle__allocate(__pyx_v_m, ((struct __pyx_obj_5galxe_4core_EdgeManager *)__pyx_t_3), (__pyx_v_count - 1), (&__pyx_v_f_markers), (&__pyx_v_f_edges)); if (unlikely(PyErr_Occurred())) __PYX_ERR(0, 350, __pyx_L1_error)
  __Pyx_DECREF(__pyx_t_3); __pyx_t_3 = 0;

  /* "galxe/hamcycle.pyx":352
 *     _allocate(m, graph.e_manager, count - 1 , &f_markers, &f_edges)
 * 
 *     vlist_reset(k)             # <<<<<<<<<<<<<<
 *     vlist_reset(&hamcycle)
 * 
 */
  vlist_reset(__pyx_v_k);

  /* "galxe/hamcycle.pyx":353
 * 
 *     vlist_reset(k)
 *     vlist_reset(&hamcycle)             # <<<<<<<<<<<<<<
 * 
 *     # prep first marker (so rewind can restore graph)
 */
  vlist_reset((&__pyx_v_hamcycle));

  /* "galxe/hamcycle.pyx":356
 * 
 *     # prep first marker (so rewind can restore graph)
 *     h.next = NULL             # <<<<<<<<<<<<<<
 *     h.g_detached = &dummy_arc  # first choice for edge contraction
 *     h.v = <graph_vertex*>&hamcycle
 */
  __pyx_v_h->next = NULL;

  /* "galxe/hamcycle.pyx":357
 *     # prep first marker (so rewind can restore graph)
 *     h.next = NULL
 *     h.g_detached = &dummy_arc  # first choice for edge contraction             # <<<<<<<<<<<<<<
 *     h.v = <graph_vertex*>&hamcycle
 *     h.m_detached = NULL
 */
  __pyx_v_h->g_detached = (&__pyx_v_dummy_arc);

  /* "galxe/hamcycle.pyx":358
 *     h.next = NULL
 *     h.g_detached = &dummy_arc  # first choice for edge contraction
 *     h.v = <graph_vertex*>&hamcycle             # <<<<<<<<<<<<<<
 *     h.m_detached = NULL
 *     h.m_created = v_arcs_first(vlist_first(g))
 */
  __pyx_v_h->v = ((struct graph_vertex *)(&__pyx_v_hamcycle));

  /* "galxe/hamcycle.pyx":359
 *     h.g_detached = &dummy_arc  # first choice for edge contraction
 *     h.v = <graph_vertex*>&hamcycle
 *     h.m_detached = NULL             # <<<<<<<<<<<<<<
 *     h.m_created = v_arcs_first(vlist_first(g))
 * 
 */
  __pyx_v_h->m_detached = NULL;

  /* "galxe/hamcycle.pyx":360
 *     h.v = <graph_vertex*>&hamcycle
 *     h.m_detached = NULL
 *     h.m_created = v_arcs_first(vlist_first(g))             # <<<<<<<<<<<<<<
 * 
 *     h = &stop
 */
  __pyx_v_h->m_created = v_arcs_first(vlist_first(__pyx_v_g));

  /* "galxe/hamcycle.pyx":362
 *     h.m_created = v_arcs_first(vlist_first(g))
 * 
 *     h = &stop             # <<<<<<<<<<<<<<
 *     h.next = &base
 *     copy_marker(h, &base)
 */
  __pyx_v_h = (&__pyx_v_stop);

  /* "galxe/hamcycle.pyx":363
 * 
 *     h = &stop
 *     h.next = &base             # <<<<<<<<<<<<<<
 *     copy_marker(h, &base)
 * 
 */
  __pyx_v_h->next = (&__pyx_v_base);

  /* "galxe/hamcycle.pyx":364
 *     h = &stop
 *     h.next = &base
 *     copy_marker(h, &base)             # <<<<<<<<<<<<<<
 * 
 *     if _prep(g, k):
 */
  __pyx_f_5galxe_8hamcycle_copy_marker(__pyx_v_h, (&__pyx_v_base));

  /* "galxe/hamcycle.pyx":366
 *     copy_marker(h, &base)
 * 
 *     if _prep(g, k):             # <<<<<<<<<<<<<<
 *         _deallocate(graph.e_manager, f_edges)
 *         return 0
 */
  __pyx_t_2 = (__pyx_f_5galxe_8hamcycle__prep(__pyx_v_g, __pyx_v_k) != 0);
  if (__pyx_t_2) {

    /* "galxe/hamcycle.pyx":367
 * 
 *     if _prep(g, k):
 *         _deallocate(graph.e_manager, f_edges)             # <<<<<<<<<<<<<<
 *         return 0
 * 
 */
    __pyx_t_3 = ((PyObject *)__pyx_v_graph->e_manager);
    __Pyx_INCREF(__pyx_t_3);
    __pyx_f_5galxe_8hamcycle__deallocate(((struct __pyx_obj_5galxe_4core_EdgeManager *)__pyx_t_3), __pyx_v_f_edges);
    __Pyx_DECREF(__pyx_t_3); __pyx_t_3 = 0;

    /* "galxe/hamcycle.pyx":368
 *     if _prep(g, k):
 *         _deallocate(graph.e_manager, f_edges)
 *         return 0             # <<<<<<<<<<<<<<
 * 
 *     import sys
 */
    __pyx_r = 0;
    goto __pyx_L0;

    /* "galxe/hamcycle.pyx":366
 *     copy_marker(h, &base)
 * 
 *     if _prep(g, k):             # <<<<<<<<<<<<<<
 *         _deallocate(graph.e_manager, f_edges)
 *         return 0
 */
  }

  /* "galxe/hamcycle.pyx":370
 *         return 0
 * 
 *     import sys             # <<<<<<<<<<<<<<
 *     print ""
 *     count = 0
 */
  __pyx_t_3 = __Pyx_Import(__pyx_n_s_sys, 0, -1); if (unlikely(!__pyx_t_3)) __PYX_ERR(0, 370, __pyx_L1_error)
  __Pyx_GOTREF(__pyx_t_3);
  __pyx_v_sys = __pyx_t_3;
  __pyx_t_3 = 0;

  /* "galxe/hamcycle.pyx":371
 * 
 *     import sys
 *     print ""             # <<<<<<<<<<<<<<
 *     count = 0
 *     if not vlist_is_empty(k):
 */
  if (__Pyx_PrintOne(0, __pyx_kp_s_) < 0) __PYX_ERR(0, 371, __pyx_L1_error)

  /* "galxe/hamcycle.pyx":372
 *     import sys
 *     print ""
 *     count = 0             # <<<<<<<<<<<<<<
 *     if not vlist_is_empty(k):
 *         v = vlist_first(k)
 */
  __pyx_v_count = 0;

  /* "galxe/hamcycle.pyx":373
 *     print ""
 *     count = 0
 *     if not vlist_is_empty(k):             # <<<<<<<<<<<<<<
 *         v = vlist_first(k)
 *         push_v(h, v)
 */
  __pyx_t_2 = ((!(vlist_is_empty(__pyx_v_k) != 0)) != 0);
  if (__pyx_t_2) {

    /* "galxe/hamcycle.pyx":374
 *     count = 0
 *     if not vlist_is_empty(k):
 *         v = vlist_first(k)             # <<<<<<<<<<<<<<
 *         push_v(h, v)
 *         a = v_arcs_first(v)
 */
    __pyx_v_v = vlist_first(__pyx_v_k);

    /* "galxe/hamcycle.pyx":375
 *     if not vlist_is_empty(k):
 *         v = vlist_first(k)
 *         push_v(h, v)             # <<<<<<<<<<<<<<
 *         a = v_arcs_first(v)
 *         x = path_contraction(a, a_next(a), g, k, h, &f_edges)
 */
    __pyx_f_5galxe_8hamcycle_push_v(__pyx_v_h, __pyx_v_v);

    /* "galxe/hamcycle.pyx":376
 *         v = vlist_first(k)
 *         push_v(h, v)
 *         a = v_arcs_first(v)             # <<<<<<<<<<<<<<
 *         x = path_contraction(a, a_next(a), g, k, h, &f_edges)
 *         if x:
 */
    __pyx_v_a = v_arcs_first(__pyx_v_v);

    /* "galxe/hamcycle.pyx":377
 *         push_v(h, v)
 *         a = v_arcs_first(v)
 *         x = path_contraction(a, a_next(a), g, k, h, &f_edges)             # <<<<<<<<<<<<<<
 *         if x:
 *             vlist_combine_bottom(g, k)
 */
    __pyx_v_x = __pyx_f_5galxe_8hamcycle_path_contraction(__pyx_v_a, a_next(__pyx_v_a), __pyx_v_g, __pyx_v_k, __pyx_v_h, (&__pyx_v_f_edges));

    /* "galxe/hamcycle.pyx":378
 *         a = v_arcs_first(v)
 *         x = path_contraction(a, a_next(a), g, k, h, &f_edges)
 *         if x:             # <<<<<<<<<<<<<<
 *             vlist_combine_bottom(g, k)
 *             if x>0 and vlist_is_empty(g): count += 1
 */
    __pyx_t_2 = (__pyx_v_x != 0);
    if (__pyx_t_2) {

      /* "galxe/hamcycle.pyx":379
 *         x = path_contraction(a, a_next(a), g, k, h, &f_edges)
 *         if x:
 *             vlist_combine_bottom(g, k)             # <<<<<<<<<<<<<<
 *             if x>0 and vlist_is_empty(g): count += 1
 *             while h != &base: h = rewind(g, h, &f_edges, &f_markers)
 */
      vlist_combine_bottom(__pyx_v_g, __pyx_v_k);

      /* "galxe/hamcycle.pyx":380
 *         if x:
 *             vlist_combine_bottom(g, k)
 *             if x>0 and vlist_is_empty(g): count += 1             # <<<<<<<<<<<<<<
 *             while h != &base: h = rewind(g, h, &f_edges, &f_markers)
 *             _deallocate(graph.e_manager, f_edges)
 */
      __pyx_t_1 = ((__pyx_v_x > 0) != 0);
      if (__pyx_t_1) {
      } else {
        __pyx_t_2 = __pyx_t_1;
        goto __pyx_L11_bool_binop_done;
      }
      __pyx_t_1 = (vlist_is_empty(__pyx_v_g) != 0);
      __pyx_t_2 = __pyx_t_1;
      __pyx_L11_bool_binop_done:;
      if (__pyx_t_2) {
        __pyx_v_count = (__pyx_v_count + 1);
      }

      /* "galxe/hamcycle.pyx":381
 *             vlist_combine_bottom(g, k)
 *             if x>0 and vlist_is_empty(g): count += 1
 *             while h != &base: h = rewind(g, h, &f_edges, &f_markers)             # <<<<<<<<<<<<<<
 *             _deallocate(graph.e_manager, f_edges)
 *             return count
 */
      while (1) {
        __pyx_t_2 = ((__pyx_v_h != (&__pyx_v_base)) != 0);
        if (!__pyx_t_2) break;
        __pyx_v_h = __pyx_f_5galxe_8hamcycle_rewind(__pyx_v_g, __pyx_v_h, (&__pyx_v_f_edges), (&__pyx_v_f_markers));
      }

      /* "galxe/hamcycle.pyx":382
 *             if x>0 and vlist_is_empty(g): count += 1
 *             while h != &base: h = rewind(g, h, &f_edges, &f_markers)
 *             _deallocate(graph.e_manager, f_edges)             # <<<<<<<<<<<<<<
 *             return count
 *         if not graph.connected():
 */
      __pyx_t_3 = ((PyObject *)__pyx_v_graph->e_manager);
      __Pyx_INCREF(__pyx_t_3);
      __pyx_f_5galxe_8hamcycle__deallocate(((struct __pyx_obj_5galxe_4core_EdgeManager *)__pyx_t_3), __pyx_v_f_edges);
      __Pyx_DECREF(__pyx_t_3); __pyx_t_3 = 0;

      /* "galxe/hamcycle.pyx":383
 *             while h != &base: h = rewind(g, h, &f_edges, &f_markers)
 *             _deallocate(graph.e_manager, f_edges)
 *             return count             # <<<<<<<<<<<<<<
 *         if not graph.connected():
 *             while h != &base: h = rewind(g, h, &f_edges, &f_markers)
 */
      __pyx_r = __pyx_v_count;
      goto __pyx_L0;

      /* "galxe/hamcycle.pyx":378
 *         a = v_arcs_first(v)
 *         x = path_contraction(a, a_next(a), g, k, h, &f_edges)
 *         if x:             # <<<<<<<<<<<<<<
 *             vlist_combine_bottom(g, k)
 *             if x>0 and vlist_is_empty(g): count += 1
 */
    }

    /* "galxe/hamcycle.pyx":384
 *             _deallocate(graph.e_manager, f_edges)
 *             return count
 *         if not graph.connected():             # <<<<<<<<<<<<<<
 *             while h != &base: h = rewind(g, h, &f_edges, &f_markers)
 *             _deallocate(graph.e_manager, f_edges)
 */
    __pyx_t_2 = ((!(((struct __pyx_vtabstruct_5galxe_5graph_Graph *)__pyx_v_graph->__pyx_vtab)->connected(__pyx_v_graph, 0) != 0)) != 0);
    if (__pyx_t_2) {

      /* "galxe/hamcycle.pyx":385
 *             return count
 *         if not graph.connected():
 *             while h != &base: h = rewind(g, h, &f_edges, &f_markers)             # <<<<<<<<<<<<<<
 *             _deallocate(graph.e_manager, f_edges)
 *             return count
 */
      while (1) {
        __pyx_t_2 = ((__pyx_v_h != (&__pyx_v_base)) != 0);
        if (!__pyx_t_2) break;
        __pyx_v_h = __pyx_f_5galxe_8hamcycle_rewind(__pyx_v_g, __pyx_v_h, (&__pyx_v_f_edges), (&__pyx_v_f_markers));
      }

      /* "galxe/hamcycle.pyx":386
 *         if not graph.connected():
 *             while h != &base: h = rewind(g, h, &f_edges, &f_markers)
 *             _deallocate(graph.e_manager, f_edges)             # <<<<<<<<<<<<<<
 *             return count
 * 
 */
      __pyx_t_3 = ((PyObject *)__pyx_v_graph->e_manager);
      __Pyx_INCREF(__pyx_t_3);
      __pyx_f_5galxe_8hamcycle__deallocate(((struct __pyx_obj_5galxe_4core_EdgeManager *)__pyx_t_3), __pyx_v_f_edges);
      __Pyx_DECREF(__pyx_t_3); __pyx_t_3 = 0;

      /* "galxe/hamcycle.pyx":387
 *             while h != &base: h = rewind(g, h, &f_edges, &f_markers)
 *             _deallocate(graph.e_manager, f_edges)
 *             return count             # <<<<<<<<<<<<<<
 * 
 *     while 1:
 */
      __pyx_r = __pyx_v_count;
      goto __pyx_L0;

      /* "galxe/hamcycle.pyx":384
 *             _deallocate(graph.e_manager, f_edges)
 *             return count
 *         if not graph.connected():             # <<<<<<<<<<<<<<
 *             while h != &base: h = rewind(g, h, &f_edges, &f_markers)
 *             _deallocate(graph.e_manager, f_edges)
 */
    }

    /* "galxe/hamcycle.pyx":373
 *     print ""
 *     count = 0
 *     if not vlist_is_empty(k):             # <<<<<<<<<<<<<<
 *         v = vlist_first(k)
 *         push_v(h, v)
 */
  }

  /* "galxe/hamcycle.pyx":389
 *             return count
 * 
 *     while 1:             # <<<<<<<<<<<<<<
 *         while not x:
 *             a = v_arcs_first(vlist_first(g))
 */
  while (1) {

    /* "galxe/hamcycle.pyx":390
 * 
 *     while 1:
 *         while not x:             # <<<<<<<<<<<<<<
 *             a = v_arcs_first(vlist_first(g))
 *             if a.w0.arcs != NULL: a = a_next(a)
 */
    while (1) {
      __pyx_t_2 = ((!(__pyx_v_x != 0)) != 0);
      if (!__pyx_t_2) break;

      /* "galxe/hamcycle.pyx":391
 *     while 1:
 *         while not x:
 *             a = v_arcs_first(vlist_first(g))             # <<<<<<<<<<<<<<
 *             if a.w0.arcs != NULL: a = a_next(a)
 *             h.g_detached.w0.arcs = a
 */
      __pyx_v_a = v_arcs_first(vlist_first(__pyx_v_g));

      /* "galxe/hamcycle.pyx":392
 *         while not x:
 *             a = v_arcs_first(vlist_first(g))
 *             if a.w0.arcs != NULL: a = a_next(a)             # <<<<<<<<<<<<<<
 *             h.g_detached.w0.arcs = a
 *             h = push_marker(h, &f_markers)
 */
      __pyx_t_2 = ((__pyx_v_a->w0.arcs != NULL) != 0);
      if (__pyx_t_2) {
        __pyx_v_a = a_next(__pyx_v_a);
      }

      /* "galxe/hamcycle.pyx":393
 *             a = v_arcs_first(vlist_first(g))
 *             if a.w0.arcs != NULL: a = a_next(a)
 *             h.g_detached.w0.arcs = a             # <<<<<<<<<<<<<<
 *             h = push_marker(h, &f_markers)
 *             x = path_contraction(a, a_cross(a), g, k, h, &f_edges)
 */
      __pyx_v_h->g_detached->w0.arcs = __pyx_v_a;

      /* "galxe/hamcycle.pyx":394
 *             if a.w0.arcs != NULL: a = a_next(a)
 *             h.g_detached.w0.arcs = a
 *             h = push_marker(h, &f_markers)             # <<<<<<<<<<<<<<
 *             x = path_contraction(a, a_cross(a), g, k, h, &f_edges)
 *         while x:
 */
      __pyx_v_h = __pyx_f_5galxe_8hamcycle_push_marker(__pyx_v_h, (&__pyx_v_f_markers));

      /* "galxe/hamcycle.pyx":395
 *             h.g_detached.w0.arcs = a
 *             h = push_marker(h, &f_markers)
 *             x = path_contraction(a, a_cross(a), g, k, h, &f_edges)             # <<<<<<<<<<<<<<
 *         while x:
 *             vlist_combine_bottom(g, k)
 */
      __pyx_v_x = __pyx_f_5galxe_8hamcycle_path_contraction(__pyx_v_a, a_cross(__pyx_v_a), __pyx_v_g, __pyx_v_k, __pyx_v_h, (&__pyx_v_f_edges));
    }

    /* "galxe/hamcycle.pyx":396
 *             h = push_marker(h, &f_markers)
 *             x = path_contraction(a, a_cross(a), g, k, h, &f_edges)
 *         while x:             # <<<<<<<<<<<<<<
 *             vlist_combine_bottom(g, k)
 *             if x>0 and vlist_is_empty(g): count += 1
 */
    while (1) {
      __pyx_t_2 = (__pyx_v_x != 0);
      if (!__pyx_t_2) break;

      /* "galxe/hamcycle.pyx":397
 *             x = path_contraction(a, a_cross(a), g, k, h, &f_edges)
 *         while x:
 *             vlist_combine_bottom(g, k)             # <<<<<<<<<<<<<<
 *             if x>0 and vlist_is_empty(g): count += 1
 *             if h == &stop: break
 */
      vlist_combine_bottom(__pyx_v_g, __pyx_v_k);

      /* "galxe/hamcycle.pyx":398
 *         while x:
 *             vlist_combine_bottom(g, k)
 *             if x>0 and vlist_is_empty(g): count += 1             # <<<<<<<<<<<<<<
 *             if h == &stop: break
 *             x = 0
 */
      __pyx_t_1 = ((__pyx_v_x > 0) != 0);
      if (__pyx_t_1) {
      } else {
        __pyx_t_2 = __pyx_t_1;
        goto __pyx_L26_bool_binop_done;
      }
      __pyx_t_1 = (vlist_is_empty(__pyx_v_g) != 0);
      __pyx_t_2 = __pyx_t_1;
      __pyx_L26_bool_binop_done:;
      if (__pyx_t_2) {
        __pyx_v_count = (__pyx_v_count + 1);
      }

      /* "galxe/hamcycle.pyx":399
 *             vlist_combine_bottom(g, k)
 *             if x>0 and vlist_is_empty(g): count += 1
 *             if h == &stop: break             # <<<<<<<<<<<<<<
 *             x = 0
 *             h = rewind(g, h, &f_edges, &f_markers)
 */
      __pyx_t_2 = ((__pyx_v_h == (&__pyx_v_stop)) != 0);
      if (__pyx_t_2) {
        goto __pyx_L24_break;
      }

      /* "galxe/hamcycle.pyx":400
 *             if x>0 and vlist_is_empty(g): count += 1
 *             if h == &stop: break
 *             x = 0             # <<<<<<<<<<<<<<
 *             h = rewind(g, h, &f_edges, &f_markers)
 *             a = h.g_detached.w0.arcs
 */
      __pyx_v_x = 0;

      /* "galxe/hamcycle.pyx":401
 *             if h == &stop: break
 *             x = 0
 *             h = rewind(g, h, &f_edges, &f_markers)             # <<<<<<<<<<<<<<
 *             a = h.g_detached.w0.arcs
 *             h.g_detached.w0.arcs = NULL
 */
      __pyx_v_h = __pyx_f_5galxe_8hamcycle_rewind(__pyx_v_g, __pyx_v_h, (&__pyx_v_f_edges), (&__pyx_v_f_markers));

      /* "galxe/hamcycle.pyx":402
 *             x = 0
 *             h = rewind(g, h, &f_edges, &f_markers)
 *             a = h.g_detached.w0.arcs             # <<<<<<<<<<<<<<
 *             h.g_detached.w0.arcs = NULL
 *             push_e(h, a)  # search exhausted for a at this level
 */
      __pyx_t_5 = __pyx_v_h->g_detached->w0.arcs;
      __pyx_v_a = __pyx_t_5;

      /* "galxe/hamcycle.pyx":403
 *             h = rewind(g, h, &f_edges, &f_markers)
 *             a = h.g_detached.w0.arcs
 *             h.g_detached.w0.arcs = NULL             # <<<<<<<<<<<<<<
 *             push_e(h, a)  # search exhausted for a at this level
 *             v  = a.target
 */
      __pyx_v_h->g_detached->w0.arcs = NULL;

      /* "galxe/hamcycle.pyx":404
 *             a = h.g_detached.w0.arcs
 *             h.g_detached.w0.arcs = NULL
 *             push_e(h, a)  # search exhausted for a at this level             # <<<<<<<<<<<<<<
 *             v  = a.target
 *             a1 = v_arcs_first(v)
 */
      __pyx_f_5galxe_8hamcycle_push_e(__pyx_v_h, __pyx_v_a);

      /* "galxe/hamcycle.pyx":405
 *             h.g_detached.w0.arcs = NULL
 *             push_e(h, a)  # search exhausted for a at this level
 *             v  = a.target             # <<<<<<<<<<<<<<
 *             a1 = v_arcs_first(v)
 *             a2 = a_next(a1)
 */
      __pyx_t_6 = __pyx_v_a->target;
      __pyx_v_v = __pyx_t_6;

      /* "galxe/hamcycle.pyx":406
 *             push_e(h, a)  # search exhausted for a at this level
 *             v  = a.target
 *             a1 = v_arcs_first(v)             # <<<<<<<<<<<<<<
 *             a2 = a_next(a1)
 *             if v_arcs_is_done(a_next(a2), v):
 */
      __pyx_v_a1 = v_arcs_first(__pyx_v_v);

      /* "galxe/hamcycle.pyx":407
 *             v  = a.target
 *             a1 = v_arcs_first(v)
 *             a2 = a_next(a1)             # <<<<<<<<<<<<<<
 *             if v_arcs_is_done(a_next(a2), v):
 *                 push_v(h, v)
 */
      __pyx_v_a2 = a_next(__pyx_v_a1);

      /* "galxe/hamcycle.pyx":408
 *             a1 = v_arcs_first(v)
 *             a2 = a_next(a1)
 *             if v_arcs_is_done(a_next(a2), v):             # <<<<<<<<<<<<<<
 *                 push_v(h, v)
 *                 v = a_cross(a).target
 */
      __pyx_t_2 = (v_arcs_is_done(a_next(__pyx_v_a2), __pyx_v_v) != 0);
      if (__pyx_t_2) {

        /* "galxe/hamcycle.pyx":409
 *             a2 = a_next(a1)
 *             if v_arcs_is_done(a_next(a2), v):
 *                 push_v(h, v)             # <<<<<<<<<<<<<<
 *                 v = a_cross(a).target
 *                 a = a_next(a_next(v_arcs_first(v)))
 */
        __pyx_f_5galxe_8hamcycle_push_v(__pyx_v_h, __pyx_v_v);

        /* "galxe/hamcycle.pyx":410
 *             if v_arcs_is_done(a_next(a2), v):
 *                 push_v(h, v)
 *                 v = a_cross(a).target             # <<<<<<<<<<<<<<
 *                 a = a_next(a_next(v_arcs_first(v)))
 *                 if v_arcs_is_done(a, v): move_v(k, v)
 */
        __pyx_t_6 = a_cross(__pyx_v_a)->target;
        __pyx_v_v = __pyx_t_6;

        /* "galxe/hamcycle.pyx":411
 *                 push_v(h, v)
 *                 v = a_cross(a).target
 *                 a = a_next(a_next(v_arcs_first(v)))             # <<<<<<<<<<<<<<
 *                 if v_arcs_is_done(a, v): move_v(k, v)
 *                 x = path_contraction(a1, a2, g, k, h, &f_edges)
 */
        __pyx_v_a = a_next(a_next(v_arcs_first(__pyx_v_v)));

        /* "galxe/hamcycle.pyx":412
 *                 v = a_cross(a).target
 *                 a = a_next(a_next(v_arcs_first(v)))
 *                 if v_arcs_is_done(a, v): move_v(k, v)             # <<<<<<<<<<<<<<
 *                 x = path_contraction(a1, a2, g, k, h, &f_edges)
 *             else:
 */
        __pyx_t_2 = (v_arcs_is_done(__pyx_v_a, __pyx_v_v) != 0);
        if (__pyx_t_2) {
          __pyx_f_5galxe_8hamcycle_move_v(__pyx_v_k, __pyx_v_v);
        }

        /* "galxe/hamcycle.pyx":413
 *                 a = a_next(a_next(v_arcs_first(v)))
 *                 if v_arcs_is_done(a, v): move_v(k, v)
 *                 x = path_contraction(a1, a2, g, k, h, &f_edges)             # <<<<<<<<<<<<<<
 *             else:
 *                 v  = a_cross(a).target
 */
        __pyx_v_x = __pyx_f_5galxe_8hamcycle_path_contraction(__pyx_v_a1, __pyx_v_a2, __pyx_v_g, __pyx_v_k, __pyx_v_h, (&__pyx_v_f_edges));

        /* "galxe/hamcycle.pyx":408
 *             a1 = v_arcs_first(v)
 *             a2 = a_next(a1)
 *             if v_arcs_is_done(a_next(a2), v):             # <<<<<<<<<<<<<<
 *                 push_v(h, v)
 *                 v = a_cross(a).target
 */
        goto __pyx_L29;
      }

      /* "galxe/hamcycle.pyx":415
 *                 x = path_contraction(a1, a2, g, k, h, &f_edges)
 *             else:
 *                 v  = a_cross(a).target             # <<<<<<<<<<<<<<
 *                 a1 = v_arcs_first(v)
 *                 a2 = a_next(a1)
 */
      /*else*/ {
        __pyx_t_6 = a_cross(__pyx_v_a)->target;
        __pyx_v_v = __pyx_t_6;

        /* "galxe/hamcycle.pyx":416
 *             else:
 *                 v  = a_cross(a).target
 *                 a1 = v_arcs_first(v)             # <<<<<<<<<<<<<<
 *                 a2 = a_next(a1)
 *                 if v_arcs_is_done(a_next(a2), v):
 */
        __pyx_v_a1 = v_arcs_first(__pyx_v_v);

        /* "galxe/hamcycle.pyx":417
 *                 v  = a_cross(a).target
 *                 a1 = v_arcs_first(v)
 *                 a2 = a_next(a1)             # <<<<<<<<<<<<<<
 *                 if v_arcs_is_done(a_next(a2), v):
 *                     push_v(h, v)
 */
        __pyx_v_a2 = a_next(__pyx_v_a1);

        /* "galxe/hamcycle.pyx":418
 *                 a1 = v_arcs_first(v)
 *                 a2 = a_next(a1)
 *                 if v_arcs_is_done(a_next(a2), v):             # <<<<<<<<<<<<<<
 *                     push_v(h, v)
 *                     x = path_contraction(a1, a2, g, k, h, &f_edges)
 */
        __pyx_t_2 = (v_arcs_is_done(a_next(__pyx_v_a2), __pyx_v_v) != 0);
        if (__pyx_t_2) {

          /* "galxe/hamcycle.pyx":419
 *                 a2 = a_next(a1)
 *                 if v_arcs_is_done(a_next(a2), v):
 *                     push_v(h, v)             # <<<<<<<<<<<<<<
 *                     x = path_contraction(a1, a2, g, k, h, &f_edges)
 *         else: continue
 */
          __pyx_f_5galxe_8hamcycle_push_v(__pyx_v_h, __pyx_v_v);

          /* "galxe/hamcycle.pyx":420
 *                 if v_arcs_is_done(a_next(a2), v):
 *                     push_v(h, v)
 *                     x = path_contraction(a1, a2, g, k, h, &f_edges)             # <<<<<<<<<<<<<<
 *         else: continue
 *         break
 */
          __pyx_v_x = __pyx_f_5galxe_8hamcycle_path_contraction(__pyx_v_a1, __pyx_v_a2, __pyx_v_g, __pyx_v_k, __pyx_v_h, (&__pyx_v_f_edges));

          /* "galxe/hamcycle.pyx":418
 *                 a1 = v_arcs_first(v)
 *                 a2 = a_next(a1)
 *                 if v_arcs_is_done(a_next(a2), v):             # <<<<<<<<<<<<<<
 *                     push_v(h, v)
 *                     x = path_contraction(a1, a2, g, k, h, &f_edges)
 */
        }
      }
      __pyx_L29:;
    }

    /* "galxe/hamcycle.pyx":421
 *                     push_v(h, v)
 *                     x = path_contraction(a1, a2, g, k, h, &f_edges)
 *         else: continue             # <<<<<<<<<<<<<<
 *         break
 * 
 */
    /*else*/ {
      goto __pyx_L18_continue;
    }
    __pyx_L24_break:;

    /* "galxe/hamcycle.pyx":422
 *                     x = path_contraction(a1, a2, g, k, h, &f_edges)
 *         else: continue
 *         break             # <<<<<<<<<<<<<<
 * 
 *     while h != &base: h = rewind(g, h, &f_edges, &f_markers)
 */
    goto __pyx_L19_break;
    __pyx_L18_continue:;
  }
  __pyx_L19_break:;

  /* "galxe/hamcycle.pyx":424
 *         break
 * 
 *     while h != &base: h = rewind(g, h, &f_edges, &f_markers)             # <<<<<<<<<<<<<<
 *     _deallocate(graph.e_manager, f_edges)
 *     return count
 */
  while (1) {
    __pyx_t_2 = ((__pyx_v_h != (&__pyx_v_base)) != 0);
    if (!__pyx_t_2) break;
    __pyx_v_h = __pyx_f_5galxe_8hamcycle_rewind(__pyx_v_g, __pyx_v_h, (&__pyx_v_f_edges), (&__pyx_v_f_markers));
  }

  /* "galxe/hamcycle.pyx":425
 * 
 *     while h != &base: h = rewind(g, h, &f_edges, &f_markers)
 *     _deallocate(graph.e_manager, f_edges)             # <<<<<<<<<<<<<<
 *     return count
 */
  __pyx_t_3 = ((PyObject *)__pyx_v_graph->e_manager);
  __Pyx_INCREF(__pyx_t_3);
  __pyx_f_5galxe_8hamcycle__deallocate(((struct __pyx_obj_5galxe_4core_EdgeManager *)__pyx_t_3), __pyx_v_f_edges);
  __Pyx_DECREF(__pyx_t_3); __pyx_t_3 = 0;

  /* "galxe/hamcycle.pyx":426
 *     while h != &base: h = rewind(g, h, &f_edges, &f_markers)
 *     _deallocate(graph.e_manager, f_edges)
 *     return count             # <<<<<<<<<<<<<<
 */
  __pyx_r = __pyx_v_count;
  goto __pyx_L0;

  /* "galxe/hamcycle.pyx":331
 * 
 * @cython.embedsignature(True)
 * cpdef size_t hc_count(Graph graph) except *:             # <<<<<<<<<<<<<<
 *     if graph is None: return 0  # guard against segfaults...
 *     cdef:
 */

  /* function exit code */
  __pyx_L1_error:;
  __Pyx_XDECREF(__pyx_t_3);
  __Pyx_XDECREF(__pyx_t_4);
  __Pyx_AddTraceback("galxe.hamcycle.hc_count", __pyx_clineno, __pyx_lineno, __pyx_filename);
  __pyx_r = 0;
  __pyx_L0:;
  __Pyx_XDECREF((PyObject *)__pyx_v_m);
  __Pyx_XDECREF(__pyx_v_sys);
  __Pyx_RefNannyFinishContext();
  return __pyx_r;
}

/* Python wrapper */
static PyObject *__pyx_pw_5galxe_8hamcycle_1hc_count(PyObject *__pyx_self, PyObject *__pyx_v_graph); /*proto*/
static char __pyx_doc_5galxe_8hamcycle_hc_count[] = "hc_count(Graph graph) -> size_t";
static PyObject *__pyx_pw_5galxe_8hamcycle_1hc_count(PyObject *__pyx_self, PyObject *__pyx_v_graph) {
  PyObject *__pyx_r = 0;
  __Pyx_RefNannyDeclarations
  __Pyx_RefNannySetupContext("hc_count (wrapper)", 0);
  if (unlikely(!__Pyx_ArgTypeTest(((PyObject *)__pyx_v_graph), __pyx_ptype_5galxe_5graph_Graph, 1, "graph", 0))) __PYX_ERR(0, 331, __pyx_L1_error)
  __pyx_r = __pyx_pf_5galxe_8hamcycle_hc_count(__pyx_self, ((struct __pyx_obj_5galxe_5graph_Graph *)__pyx_v_graph));

  /* function exit code */
  goto __pyx_L0;
  __pyx_L1_error:;
  __pyx_r = NULL;
  __pyx_L0:;
  __Pyx_RefNannyFinishContext();
  return __pyx_r;
}

static PyObject *__pyx_pf_5galxe_8hamcycle_hc_count(CYTHON_UNUSED PyObject *__pyx_self, struct __pyx_obj_5galxe_5graph_Graph *__pyx_v_graph) {
  PyObject *__pyx_r = NULL;
  __Pyx_RefNannyDeclarations
  size_t __pyx_t_1;
  PyObject *__pyx_t_2 = NULL;
  __Pyx_RefNannySetupContext("hc_count", 0);
  __Pyx_XDECREF(__pyx_r);
  __pyx_t_1 = __pyx_f_5galxe_8hamcycle_hc_count(__pyx_v_graph, 0); if (unlikely(PyErr_Occurred())) __PYX_ERR(0, 331, __pyx_L1_error)
  __pyx_t_2 = __Pyx_PyInt_FromSize_t(__pyx_t_1); if (unlikely(!__pyx_t_2)) __PYX_ERR(0, 331, __pyx_L1_error)
  __Pyx_GOTREF(__pyx_t_2);
  __pyx_r = __pyx_t_2;
  __pyx_t_2 = 0;
  goto __pyx_L0;

  /* function exit code */
  __pyx_L1_error:;
  __Pyx_XDECREF(__pyx_t_2);
  __Pyx_AddTraceback("galxe.hamcycle.hc_count", __pyx_clineno, __pyx_lineno, __pyx_filename);
  __pyx_r = NULL;
  __pyx_L0:;
  __Pyx_XGIVEREF(__pyx_r);
  __Pyx_RefNannyFinishContext();
  return __pyx_r;
}

static PyMethodDef __pyx_methods[] = {
  {"hc_count", (PyCFunction)__pyx_pw_5galxe_8hamcycle_1hc_count, METH_O, __pyx_doc_5galxe_8hamcycle_hc_count},
  {0, 0, 0, 0}
};

#if PY_MAJOR_VERSION >= 3
static struct PyModuleDef __pyx_moduledef = {
  #if PY_VERSION_HEX < 0x03020000
    { PyObject_HEAD_INIT(NULL) NULL, 0, NULL },
  #else
    PyModuleDef_HEAD_INIT,
  #endif
    "hamcycle",
    0, /* m_doc */
    -1, /* m_size */
    __pyx_methods /* m_methods */,
    NULL, /* m_reload */
    NULL, /* m_traverse */
    NULL, /* m_clear */
    NULL /* m_free */
};
#endif

static __Pyx_StringTabEntry __pyx_string_tab[] = {
  {&__pyx_kp_s_, __pyx_k_, sizeof(__pyx_k_), 0, 0, 1, 0},
  {&__pyx_n_s_end, __pyx_k_end, sizeof(__pyx_k_end), 0, 0, 1, 1},
  {&__pyx_n_s_file, __pyx_k_file, sizeof(__pyx_k_file), 0, 0, 1, 1},
  {&__pyx_n_s_import, __pyx_k_import, sizeof(__pyx_k_import), 0, 0, 1, 1},
  {&__pyx_n_s_main, __pyx_k_main, sizeof(__pyx_k_main), 0, 0, 1, 1},
  {&__pyx_n_s_print, __pyx_k_print, sizeof(__pyx_k_print), 0, 0, 1, 1},
  {&__pyx_n_s_pyx_vtable, __pyx_k_pyx_vtable, sizeof(__pyx_k_pyx_vtable), 0, 0, 1, 1},
  {&__pyx_n_s_range, __pyx_k_range, sizeof(__pyx_k_range), 0, 0, 1, 1},
  {&__pyx_n_s_sys, __pyx_k_sys, sizeof(__pyx_k_sys), 0, 0, 1, 1},
  {&__pyx_n_s_test, __pyx_k_test, sizeof(__pyx_k_test), 0, 0, 1, 1},
  {&__pyx_n_s_xrange, __pyx_k_xrange, sizeof(__pyx_k_xrange), 0, 0, 1, 1},
  {0, 0, 0, 0, 0, 0, 0}
};
static int __Pyx_InitCachedBuiltins(void) {
  #if PY_MAJOR_VERSION >= 3
  __pyx_builtin_xrange = __Pyx_GetBuiltinName(__pyx_n_s_range); if (!__pyx_builtin_xrange) __PYX_ERR(0, 316, __pyx_L1_error)
  #else
  __pyx_builtin_xrange = __Pyx_GetBuiltinName(__pyx_n_s_xrange); if (!__pyx_builtin_xrange) __PYX_ERR(0, 316, __pyx_L1_error)
  #endif
  return 0;
  __pyx_L1_error:;
  return -1;
}

static int __Pyx_InitCachedConstants(void) {
  __Pyx_RefNannyDeclarations
  __Pyx_RefNannySetupContext("__Pyx_InitCachedConstants", 0);
  __Pyx_RefNannyFinishContext();
  return 0;
}

static int __Pyx_InitGlobals(void) {
  if (__Pyx_InitStrings(__pyx_string_tab) < 0) __PYX_ERR(0, 2, __pyx_L1_error);
  return 0;
  __pyx_L1_error:;
  return -1;
}

#if PY_MAJOR_VERSION < 3
PyMODINIT_FUNC inithamcycle(void); /*proto*/
PyMODINIT_FUNC inithamcycle(void)
#else
PyMODINIT_FUNC PyInit_hamcycle(void); /*proto*/
PyMODINIT_FUNC PyInit_hamcycle(void)
#endif
{
  PyObject *__pyx_t_1 = NULL;
  __Pyx_RefNannyDeclarations
  #if CYTHON_REFNANNY
  __Pyx_RefNanny = __Pyx_RefNannyImportAPI("refnanny");
  if (!__Pyx_RefNanny) {
      PyErr_Clear();
      __Pyx_RefNanny = __Pyx_RefNannyImportAPI("Cython.Runtime.refnanny");
      if (!__Pyx_RefNanny)
          Py_FatalError("failed to import 'refnanny' module");
  }
  #endif
  __Pyx_RefNannySetupContext("PyMODINIT_FUNC PyInit_hamcycle(void)", 0);
  if (__Pyx_check_binary_version() < 0) __PYX_ERR(0, 2, __pyx_L1_error)
  __pyx_empty_tuple = PyTuple_New(0); if (unlikely(!__pyx_empty_tuple)) __PYX_ERR(0, 2, __pyx_L1_error)
  __pyx_empty_bytes = PyBytes_FromStringAndSize("", 0); if (unlikely(!__pyx_empty_bytes)) __PYX_ERR(0, 2, __pyx_L1_error)
  __pyx_empty_unicode = PyUnicode_FromStringAndSize("", 0); if (unlikely(!__pyx_empty_unicode)) __PYX_ERR(0, 2, __pyx_L1_error)
  #ifdef __Pyx_CyFunction_USED
  if (__pyx_CyFunction_init() < 0) __PYX_ERR(0, 2, __pyx_L1_error)
  #endif
  #ifdef __Pyx_FusedFunction_USED
  if (__pyx_FusedFunction_init() < 0) __PYX_ERR(0, 2, __pyx_L1_error)
  #endif
  #ifdef __Pyx_Coroutine_USED
  if (__pyx_Coroutine_init() < 0) __PYX_ERR(0, 2, __pyx_L1_error)
  #endif
  #ifdef __Pyx_Generator_USED
  if (__pyx_Generator_init() < 0) __PYX_ERR(0, 2, __pyx_L1_error)
  #endif
  #ifdef __Pyx_StopAsyncIteration_USED
  if (__pyx_StopAsyncIteration_init() < 0) __PYX_ERR(0, 2, __pyx_L1_error)
  #endif
  /*--- Library function declarations ---*/
  /*--- Threads initialization code ---*/
  #if defined(__PYX_FORCE_INIT_THREADS) && __PYX_FORCE_INIT_THREADS
  #ifdef WITH_THREAD /* Python build with threading support? */
  PyEval_InitThreads();
  #endif
  #endif
  /*--- Module creation code ---*/
  #if PY_MAJOR_VERSION < 3
  __pyx_m = Py_InitModule4("hamcycle", __pyx_methods, 0, 0, PYTHON_API_VERSION); Py_XINCREF(__pyx_m);
  #else
  __pyx_m = PyModule_Create(&__pyx_moduledef);
  #endif
  if (unlikely(!__pyx_m)) __PYX_ERR(0, 2, __pyx_L1_error)
  __pyx_d = PyModule_GetDict(__pyx_m); if (unlikely(!__pyx_d)) __PYX_ERR(0, 2, __pyx_L1_error)
  Py_INCREF(__pyx_d);
  __pyx_b = PyImport_AddModule(__Pyx_BUILTIN_MODULE_NAME); if (unlikely(!__pyx_b)) __PYX_ERR(0, 2, __pyx_L1_error)
  #if CYTHON_COMPILING_IN_PYPY
  Py_INCREF(__pyx_b);
  #endif
  if (PyObject_SetAttrString(__pyx_m, "__builtins__", __pyx_b) < 0) __PYX_ERR(0, 2, __pyx_L1_error);
  /*--- Initialize various global constants etc. ---*/
  if (__Pyx_InitGlobals() < 0) __PYX_ERR(0, 2, __pyx_L1_error)
  #if PY_MAJOR_VERSION < 3 && (__PYX_DEFAULT_STRING_ENCODING_IS_ASCII || __PYX_DEFAULT_STRING_ENCODING_IS_DEFAULT)
  if (__Pyx_init_sys_getdefaultencoding_params() < 0) __PYX_ERR(0, 2, __pyx_L1_error)
  #endif
  if (__pyx_module_is_main_galxe__hamcycle) {
    if (PyObject_SetAttrString(__pyx_m, "__name__", __pyx_n_s_main) < 0) __PYX_ERR(0, 2, __pyx_L1_error)
  }
  #if PY_MAJOR_VERSION >= 3
  {
    PyObject *modules = PyImport_GetModuleDict(); if (unlikely(!modules)) __PYX_ERR(0, 2, __pyx_L1_error)
    if (!PyDict_GetItemString(modules, "galxe.hamcycle")) {
      if (unlikely(PyDict_SetItemString(modules, "galxe.hamcycle", __pyx_m) < 0)) __PYX_ERR(0, 2, __pyx_L1_error)
    }
  }
  #endif
  /*--- Builtin init code ---*/
  if (__Pyx_InitCachedBuiltins() < 0) __PYX_ERR(0, 2, __pyx_L1_error)
  /*--- Constants init code ---*/
  if (__Pyx_InitCachedConstants() < 0) __PYX_ERR(0, 2, __pyx_L1_error)
  /*--- Global init code ---*/
  /*--- Variable export code ---*/
  /*--- Function export code ---*/
  /*--- Type init code ---*/
  /*--- Type import code ---*/
  __pyx_ptype_5galxe_5utils__MBlock = __Pyx_ImportType("galxe.utils", "_MBlock", sizeof(struct __pyx_obj_5galxe_5utils__MBlock), 1); if (unlikely(!__pyx_ptype_5galxe_5utils__MBlock)) __PYX_ERR(1, 21, __pyx_L1_error)
  __pyx_vtabptr_5galxe_5utils__MBlock = (struct __pyx_vtabstruct_5galxe_5utils__MBlock*)__Pyx_GetVtable(__pyx_ptype_5galxe_5utils__MBlock->tp_dict); if (unlikely(!__pyx_vtabptr_5galxe_5utils__MBlock)) __PYX_ERR(1, 21, __pyx_L1_error)
  __pyx_ptype_5galxe_5utils__MBlockIter = __Pyx_ImportType("galxe.utils", "_MBlockIter", sizeof(struct __pyx_obj_5galxe_5utils__MBlockIter), 1); if (unlikely(!__pyx_ptype_5galxe_5utils__MBlockIter)) __PYX_ERR(1, 31, __pyx_L1_error)
  __pyx_ptype_5galxe_5utils_MBlockAllocator = __Pyx_ImportType("galxe.utils", "MBlockAllocator", sizeof(struct __pyx_obj_5galxe_5utils_MBlockAllocator), 1); if (unlikely(!__pyx_ptype_5galxe_5utils_MBlockAllocator)) __PYX_ERR(1, 34, __pyx_L1_error)
  __pyx_vtabptr_5galxe_5utils_MBlockAllocator = (struct __pyx_vtabstruct_5galxe_5utils_MBlockAllocator*)__Pyx_GetVtable(__pyx_ptype_5galxe_5utils_MBlockAllocator->tp_dict); if (unlikely(!__pyx_vtabptr_5galxe_5utils_MBlockAllocator)) __PYX_ERR(1, 34, __pyx_L1_error)
  __pyx_ptype_5galxe_5utils_TextFileTokenizer = __Pyx_ImportType("galxe.utils", "TextFileTokenizer", sizeof(struct __pyx_obj_5galxe_5utils_TextFileTokenizer), 1); if (unlikely(!__pyx_ptype_5galxe_5utils_TextFileTokenizer)) __PYX_ERR(1, 43, __pyx_L1_error)
  __pyx_ptype_5galxe_4core_VertexManager = __Pyx_ImportType("galxe.core", "VertexManager", sizeof(struct __pyx_obj_5galxe_4core_VertexManager), 1); if (unlikely(!__pyx_ptype_5galxe_4core_VertexManager)) __PYX_ERR(2, 134, __pyx_L1_error)
  __pyx_vtabptr_5galxe_4core_VertexManager = (struct __pyx_vtabstruct_5galxe_4core_VertexManager*)__Pyx_GetVtable(__pyx_ptype_5galxe_4core_VertexManager->tp_dict); if (unlikely(!__pyx_vtabptr_5galxe_4core_VertexManager)) __PYX_ERR(2, 134, __pyx_L1_error)
  __pyx_ptype_5galxe_4core_EdgeManager = __Pyx_ImportType("galxe.core", "EdgeManager", sizeof(struct __pyx_obj_5galxe_4core_EdgeManager), 1); if (unlikely(!__pyx_ptype_5galxe_4core_EdgeManager)) __PYX_ERR(2, 141, __pyx_L1_error)
  __pyx_vtabptr_5galxe_4core_EdgeManager = (struct __pyx_vtabstruct_5galxe_4core_EdgeManager*)__Pyx_GetVtable(__pyx_ptype_5galxe_4core_EdgeManager->tp_dict); if (unlikely(!__pyx_vtabptr_5galxe_4core_EdgeManager)) __PYX_ERR(2, 141, __pyx_L1_error)
  __pyx_ptype_5galxe_5graph_Graph = __Pyx_ImportType("galxe.graph", "Graph", sizeof(struct __pyx_obj_5galxe_5graph_Graph), 1); if (unlikely(!__pyx_ptype_5galxe_5graph_Graph)) __PYX_ERR(3, 22, __pyx_L1_error)
  __pyx_vtabptr_5galxe_5graph_Graph = (struct __pyx_vtabstruct_5galxe_5graph_Graph*)__Pyx_GetVtable(__pyx_ptype_5galxe_5graph_Graph->tp_dict); if (unlikely(!__pyx_vtabptr_5galxe_5graph_Graph)) __PYX_ERR(3, 22, __pyx_L1_error)
  /*--- Variable import code ---*/
  /*--- Function import code ---*/
  /*--- Execution code ---*/
  #if defined(__Pyx_Generator_USED) || defined(__Pyx_Coroutine_USED)
  if (__Pyx_patch_abc() < 0) __PYX_ERR(0, 2, __pyx_L1_error)
  #endif

  /* "galxe/hamcycle.pyx":2
 * 
 * #  Copyright 2016 Andrew Chalaturnyk             # <<<<<<<<<<<<<<
 * #
 * #
 */
  __pyx_t_1 = PyDict_New(); if (unlikely(!__pyx_t_1)) __PYX_ERR(0, 2, __pyx_L1_error)
  __Pyx_GOTREF(__pyx_t_1);
  if (PyDict_SetItem(__pyx_d, __pyx_n_s_test, __pyx_t_1) < 0) __PYX_ERR(0, 2, __pyx_L1_error)
  __Pyx_DECREF(__pyx_t_1); __pyx_t_1 = 0;

  /*--- Wrapped vars code ---*/

  goto __pyx_L0;
  __pyx_L1_error:;
  __Pyx_XDECREF(__pyx_t_1);
  if (__pyx_m) {
    if (__pyx_d) {
      __Pyx_AddTraceback("init galxe.hamcycle", __pyx_clineno, __pyx_lineno, __pyx_filename);
    }
    Py_DECREF(__pyx_m); __pyx_m = 0;
  } else if (!PyErr_Occurred()) {
    PyErr_SetString(PyExc_ImportError, "init galxe.hamcycle");
  }
  __pyx_L0:;
  __Pyx_RefNannyFinishContext();
  #if PY_MAJOR_VERSION < 3
  return;
  #else
  return __pyx_m;
  #endif
}

/* --- Runtime support code --- */
/* Refnanny */
#if CYTHON_REFNANNY
static __Pyx_RefNannyAPIStruct *__Pyx_RefNannyImportAPI(const char *modname) {
    PyObject *m = NULL, *p = NULL;
    void *r = NULL;
    m = PyImport_ImportModule((char *)modname);
    if (!m) goto end;
    p = PyObject_GetAttrString(m, (char *)"RefNannyAPI");
    if (!p) goto end;
    r = PyLong_AsVoidPtr(p);
end:
    Py_XDECREF(p);
    Py_XDECREF(m);
    return (__Pyx_RefNannyAPIStruct *)r;
}
#endif

/* GetBuiltinName */
static PyObject *__Pyx_GetBuiltinName(PyObject *name) {
    PyObject* result = __Pyx_PyObject_GetAttrStr(__pyx_b, name);
    if (unlikely(!result)) {
        PyErr_Format(PyExc_NameError,
#if PY_MAJOR_VERSION >= 3
            "name '%U' is not defined", name);
#else
            "name '%.200s' is not defined", PyString_AS_STRING(name));
#endif
    }
    return result;
}

/* PyObjectCall */
#if CYTHON_COMPILING_IN_CPYTHON
static CYTHON_INLINE PyObject* __Pyx_PyObject_Call(PyObject *func, PyObject *arg, PyObject *kw) {
    PyObject *result;
    ternaryfunc call = func->ob_type->tp_call;
    if (unlikely(!call))
        return PyObject_Call(func, arg, kw);
    if (unlikely(Py_EnterRecursiveCall((char*)" while calling a Python object")))
        return NULL;
    result = (*call)(func, arg, kw);
    Py_LeaveRecursiveCall();
    if (unlikely(!result) && unlikely(!PyErr_Occurred())) {
        PyErr_SetString(
            PyExc_SystemError,
            "NULL result without error in PyObject_Call");
    }
    return result;
}
#endif

/* Import */
static PyObject *__Pyx_Import(PyObject *name, PyObject *from_list, int level) {
    PyObject *empty_list = 0;
    PyObject *module = 0;
    PyObject *global_dict = 0;
    PyObject *empty_dict = 0;
    PyObject *list;
    #if PY_VERSION_HEX < 0x03030000
    PyObject *py_import;
    py_import = __Pyx_PyObject_GetAttrStr(__pyx_b, __pyx_n_s_import);
    if (!py_import)
        goto bad;
    #endif
    if (from_list)
        list = from_list;
    else {
        empty_list = PyList_New(0);
        if (!empty_list)
            goto bad;
        list = empty_list;
    }
    global_dict = PyModule_GetDict(__pyx_m);
    if (!global_dict)
        goto bad;
    empty_dict = PyDict_New();
    if (!empty_dict)
        goto bad;
    {
        #if PY_MAJOR_VERSION >= 3
        if (level == -1) {
            if (strchr(__Pyx_MODULE_NAME, '.')) {
                #if PY_VERSION_HEX < 0x03030000
                PyObject *py_level = PyInt_FromLong(1);
                if (!py_level)
                    goto bad;
                module = PyObject_CallFunctionObjArgs(py_import,
                    name, global_dict, empty_dict, list, py_level, NULL);
                Py_DECREF(py_level);
                #else
                module = PyImport_ImportModuleLevelObject(
                    name, global_dict, empty_dict, list, 1);
                #endif
                if (!module) {
                    if (!PyErr_ExceptionMatches(PyExc_ImportError))
                        goto bad;
                    PyErr_Clear();
                }
            }
            level = 0;
        }
        #endif
        if (!module) {
            #if PY_VERSION_HEX < 0x03030000
            PyObject *py_level = PyInt_FromLong(level);
            if (!py_level)
                goto bad;
            module = PyObject_CallFunctionObjArgs(py_import,
                name, global_dict, empty_dict, list, py_level, NULL);
            Py_DECREF(py_level);
            #else
            module = PyImport_ImportModuleLevelObject(
                name, global_dict, empty_dict, list, level);
            #endif
        }
    }
bad:
    #if PY_VERSION_HEX < 0x03030000
    Py_XDECREF(py_import);
    #endif
    Py_XDECREF(empty_list);
    Py_XDECREF(empty_dict);
    return module;
}

/* ArgTypeTest */
static void __Pyx_RaiseArgumentTypeInvalid(const char* name, PyObject *obj, PyTypeObject *type) {
    PyErr_Format(PyExc_TypeError,
        "Argument '%.200s' has incorrect type (expected %.200s, got %.200s)",
        name, type->tp_name, Py_TYPE(obj)->tp_name);
}
static CYTHON_INLINE int __Pyx_ArgTypeTest(PyObject *obj, PyTypeObject *type, int none_allowed,
    const char *name, int exact)
{
    if (unlikely(!type)) {
        PyErr_SetString(PyExc_SystemError, "Missing type object");
        return 0;
    }
    if (none_allowed && obj == Py_None) return 1;
    else if (exact) {
        if (likely(Py_TYPE(obj) == type)) return 1;
        #if PY_MAJOR_VERSION == 2
        else if ((type == &PyBaseString_Type) && likely(__Pyx_PyBaseString_CheckExact(obj))) return 1;
        #endif
    }
    else {
        if (likely(PyObject_TypeCheck(obj, type))) return 1;
    }
    __Pyx_RaiseArgumentTypeInvalid(name, obj, type);
    return 0;
}

/* GetVTable */
static void* __Pyx_GetVtable(PyObject *dict) {
    void* ptr;
    PyObject *ob = PyObject_GetItem(dict, __pyx_n_s_pyx_vtable);
    if (!ob)
        goto bad;
#if PY_VERSION_HEX >= 0x02070000
    ptr = PyCapsule_GetPointer(ob, 0);
#else
    ptr = PyCObject_AsVoidPtr(ob);
#endif
    if (!ptr && !PyErr_Occurred())
        PyErr_SetString(PyExc_RuntimeError, "invalid vtable found for imported type");
    Py_DECREF(ob);
    return ptr;
bad:
    Py_XDECREF(ob);
    return NULL;
}

/* CodeObjectCache */
static int __pyx_bisect_code_objects(__Pyx_CodeObjectCacheEntry* entries, int count, int code_line) {
    int start = 0, mid = 0, end = count - 1;
    if (end >= 0 && code_line > entries[end].code_line) {
        return count;
    }
    while (start < end) {
        mid = start + (end - start) / 2;
        if (code_line < entries[mid].code_line) {
            end = mid;
        } else if (code_line > entries[mid].code_line) {
             start = mid + 1;
        } else {
            return mid;
        }
    }
    if (code_line <= entries[mid].code_line) {
        return mid;
    } else {
        return mid + 1;
    }
}
static PyCodeObject *__pyx_find_code_object(int code_line) {
    PyCodeObject* code_object;
    int pos;
    if (unlikely(!code_line) || unlikely(!__pyx_code_cache.entries)) {
        return NULL;
    }
    pos = __pyx_bisect_code_objects(__pyx_code_cache.entries, __pyx_code_cache.count, code_line);
    if (unlikely(pos >= __pyx_code_cache.count) || unlikely(__pyx_code_cache.entries[pos].code_line != code_line)) {
        return NULL;
    }
    code_object = __pyx_code_cache.entries[pos].code_object;
    Py_INCREF(code_object);
    return code_object;
}
static void __pyx_insert_code_object(int code_line, PyCodeObject* code_object) {
    int pos, i;
    __Pyx_CodeObjectCacheEntry* entries = __pyx_code_cache.entries;
    if (unlikely(!code_line)) {
        return;
    }
    if (unlikely(!entries)) {
        entries = (__Pyx_CodeObjectCacheEntry*)PyMem_Malloc(64*sizeof(__Pyx_CodeObjectCacheEntry));
        if (likely(entries)) {
            __pyx_code_cache.entries = entries;
            __pyx_code_cache.max_count = 64;
            __pyx_code_cache.count = 1;
            entries[0].code_line = code_line;
            entries[0].code_object = code_object;
            Py_INCREF(code_object);
        }
        return;
    }
    pos = __pyx_bisect_code_objects(__pyx_code_cache.entries, __pyx_code_cache.count, code_line);
    if ((pos < __pyx_code_cache.count) && unlikely(__pyx_code_cache.entries[pos].code_line == code_line)) {
        PyCodeObject* tmp = entries[pos].code_object;
        entries[pos].code_object = code_object;
        Py_DECREF(tmp);
        return;
    }
    if (__pyx_code_cache.count == __pyx_code_cache.max_count) {
        int new_max = __pyx_code_cache.max_count + 64;
        entries = (__Pyx_CodeObjectCacheEntry*)PyMem_Realloc(
            __pyx_code_cache.entries, (size_t)new_max*sizeof(__Pyx_CodeObjectCacheEntry));
        if (unlikely(!entries)) {
            return;
        }
        __pyx_code_cache.entries = entries;
        __pyx_code_cache.max_count = new_max;
    }
    for (i=__pyx_code_cache.count; i>pos; i--) {
        entries[i] = entries[i-1];
    }
    entries[pos].code_line = code_line;
    entries[pos].code_object = code_object;
    __pyx_code_cache.count++;
    Py_INCREF(code_object);
}

/* AddTraceback */
#include "compile.h"
#include "frameobject.h"
#include "traceback.h"
static PyCodeObject* __Pyx_CreateCodeObjectForTraceback(
            const char *funcname, int c_line,
            int py_line, const char *filename) {
    PyCodeObject *py_code = 0;
    PyObject *py_srcfile = 0;
    PyObject *py_funcname = 0;
    #if PY_MAJOR_VERSION < 3
    py_srcfile = PyString_FromString(filename);
    #else
    py_srcfile = PyUnicode_FromString(filename);
    #endif
    if (!py_srcfile) goto bad;
    if (c_line) {
        #if PY_MAJOR_VERSION < 3
        py_funcname = PyString_FromFormat( "%s (%s:%d)", funcname, __pyx_cfilenm, c_line);
        #else
        py_funcname = PyUnicode_FromFormat( "%s (%s:%d)", funcname, __pyx_cfilenm, c_line);
        #endif
    }
    else {
        #if PY_MAJOR_VERSION < 3
        py_funcname = PyString_FromString(funcname);
        #else
        py_funcname = PyUnicode_FromString(funcname);
        #endif
    }
    if (!py_funcname) goto bad;
    py_code = __Pyx_PyCode_New(
        0,
        0,
        0,
        0,
        0,
        __pyx_empty_bytes, /*PyObject *code,*/
        __pyx_empty_tuple, /*PyObject *consts,*/
        __pyx_empty_tuple, /*PyObject *names,*/
        __pyx_empty_tuple, /*PyObject *varnames,*/
        __pyx_empty_tuple, /*PyObject *freevars,*/
        __pyx_empty_tuple, /*PyObject *cellvars,*/
        py_srcfile,   /*PyObject *filename,*/
        py_funcname,  /*PyObject *name,*/
        py_line,
        __pyx_empty_bytes  /*PyObject *lnotab*/
    );
    Py_DECREF(py_srcfile);
    Py_DECREF(py_funcname);
    return py_code;
bad:
    Py_XDECREF(py_srcfile);
    Py_XDECREF(py_funcname);
    return NULL;
}
static void __Pyx_AddTraceback(const char *funcname, int c_line,
                               int py_line, const char *filename) {
    PyCodeObject *py_code = 0;
    PyFrameObject *py_frame = 0;
    py_code = __pyx_find_code_object(c_line ? c_line : py_line);
    if (!py_code) {
        py_code = __Pyx_CreateCodeObjectForTraceback(
            funcname, c_line, py_line, filename);
        if (!py_code) goto bad;
        __pyx_insert_code_object(c_line ? c_line : py_line, py_code);
    }
    py_frame = PyFrame_New(
        PyThreadState_GET(), /*PyThreadState *tstate,*/
        py_code,             /*PyCodeObject *code,*/
        __pyx_d,      /*PyObject *globals,*/
        0                    /*PyObject *locals*/
    );
    if (!py_frame) goto bad;
    __Pyx_PyFrame_SetLineNumber(py_frame, py_line);
    PyTraceBack_Here(py_frame);
bad:
    Py_XDECREF(py_code);
    Py_XDECREF(py_frame);
}

/* CIntFromPyVerify */
#define __PYX_VERIFY_RETURN_INT(target_type, func_type, func_value)\
    __PYX__VERIFY_RETURN_INT(target_type, func_type, func_value, 0)
#define __PYX_VERIFY_RETURN_INT_EXC(target_type, func_type, func_value)\
    __PYX__VERIFY_RETURN_INT(target_type, func_type, func_value, 1)
#define __PYX__VERIFY_RETURN_INT(target_type, func_type, func_value, exc)\
    {\
        func_type value = func_value;\
        if (sizeof(target_type) < sizeof(func_type)) {\
            if (unlikely(value != (func_type) (target_type) value)) {\
                func_type zero = 0;\
                if (exc && unlikely(value == (func_type)-1 && PyErr_Occurred()))\
                    return (target_type) -1;\
                if (is_unsigned && unlikely(value < zero))\
                    goto raise_neg_overflow;\
                else\
                    goto raise_overflow;\
            }\
        }\
        return (target_type) value;\
    }

/* Print */
#if !CYTHON_COMPILING_IN_PYPY && PY_MAJOR_VERSION < 3
static PyObject *__Pyx_GetStdout(void) {
    PyObject *f = PySys_GetObject((char *)"stdout");
    if (!f) {
        PyErr_SetString(PyExc_RuntimeError, "lost sys.stdout");
    }
    return f;
}
static int __Pyx_Print(PyObject* f, PyObject *arg_tuple, int newline) {
    int i;
    if (!f) {
        if (!(f = __Pyx_GetStdout()))
            return -1;
    }
    Py_INCREF(f);
    for (i=0; i < PyTuple_GET_SIZE(arg_tuple); i++) {
        PyObject* v;
        if (PyFile_SoftSpace(f, 1)) {
            if (PyFile_WriteString(" ", f) < 0)
                goto error;
        }
        v = PyTuple_GET_ITEM(arg_tuple, i);
        if (PyFile_WriteObject(v, f, Py_PRINT_RAW) < 0)
            goto error;
        if (PyString_Check(v)) {
            char *s = PyString_AsString(v);
            Py_ssize_t len = PyString_Size(v);
            if (len > 0) {
                switch (s[len-1]) {
                    case ' ': break;
                    case '\f': case '\r': case '\n': case '\t': case '\v':
                        PyFile_SoftSpace(f, 0);
                        break;
                    default:  break;
                }
            }
        }
    }
    if (newline) {
        if (PyFile_WriteString("\n", f) < 0)
            goto error;
        PyFile_SoftSpace(f, 0);
    }
    Py_DECREF(f);
    return 0;
error:
    Py_DECREF(f);
    return -1;
}
#else
static int __Pyx_Print(PyObject* stream, PyObject *arg_tuple, int newline) {
    PyObject* kwargs = 0;
    PyObject* result = 0;
    PyObject* end_string;
    if (unlikely(!__pyx_print)) {
        __pyx_print = PyObject_GetAttr(__pyx_b, __pyx_n_s_print);
        if (!__pyx_print)
            return -1;
    }
    if (stream) {
        kwargs = PyDict_New();
        if (unlikely(!kwargs))
            return -1;
        if (unlikely(PyDict_SetItem(kwargs, __pyx_n_s_file, stream) < 0))
            goto bad;
        if (!newline) {
            end_string = PyUnicode_FromStringAndSize(" ", 1);
            if (unlikely(!end_string))
                goto bad;
            if (PyDict_SetItem(kwargs, __pyx_n_s_end, end_string) < 0) {
                Py_DECREF(end_string);
                goto bad;
            }
            Py_DECREF(end_string);
        }
    } else if (!newline) {
        if (unlikely(!__pyx_print_kwargs)) {
            __pyx_print_kwargs = PyDict_New();
            if (unlikely(!__pyx_print_kwargs))
                return -1;
            end_string = PyUnicode_FromStringAndSize(" ", 1);
            if (unlikely(!end_string))
                return -1;
            if (PyDict_SetItem(__pyx_print_kwargs, __pyx_n_s_end, end_string) < 0) {
                Py_DECREF(end_string);
                return -1;
            }
            Py_DECREF(end_string);
        }
        kwargs = __pyx_print_kwargs;
    }
    result = PyObject_Call(__pyx_print, arg_tuple, kwargs);
    if (unlikely(kwargs) && (kwargs != __pyx_print_kwargs))
        Py_DECREF(kwargs);
    if (!result)
        return -1;
    Py_DECREF(result);
    return 0;
bad:
    if (kwargs != __pyx_print_kwargs)
        Py_XDECREF(kwargs);
    return -1;
}
#endif

/* CIntFromPy */
static CYTHON_INLINE size_t __Pyx_PyInt_As_size_t(PyObject *x) {
    const size_t neg_one = (size_t) -1, const_zero = (size_t) 0;
    const int is_unsigned = neg_one > const_zero;
#if PY_MAJOR_VERSION < 3
    if (likely(PyInt_Check(x))) {
        if (sizeof(size_t) < sizeof(long)) {
            __PYX_VERIFY_RETURN_INT(size_t, long, PyInt_AS_LONG(x))
        } else {
            long val = PyInt_AS_LONG(x);
            if (is_unsigned && unlikely(val < 0)) {
                goto raise_neg_overflow;
            }
            return (size_t) val;
        }
    } else
#endif
    if (likely(PyLong_Check(x))) {
        if (is_unsigned) {
#if CYTHON_USE_PYLONG_INTERNALS
            const digit* digits = ((PyLongObject*)x)->ob_digit;
            switch (Py_SIZE(x)) {
                case  0: return (size_t) 0;
                case  1: __PYX_VERIFY_RETURN_INT(size_t, digit, digits[0])
                case 2:
                    if (8 * sizeof(size_t) > 1 * PyLong_SHIFT) {
                        if (8 * sizeof(unsigned long) > 2 * PyLong_SHIFT) {
                            __PYX_VERIFY_RETURN_INT(size_t, unsigned long, (((((unsigned long)digits[1]) << PyLong_SHIFT) | (unsigned long)digits[0])))
                        } else if (8 * sizeof(size_t) >= 2 * PyLong_SHIFT) {
                            return (size_t) (((((size_t)digits[1]) << PyLong_SHIFT) | (size_t)digits[0]));
                        }
                    }
                    break;
                case 3:
                    if (8 * sizeof(size_t) > 2 * PyLong_SHIFT) {
                        if (8 * sizeof(unsigned long) > 3 * PyLong_SHIFT) {
                            __PYX_VERIFY_RETURN_INT(size_t, unsigned long, (((((((unsigned long)digits[2]) << PyLong_SHIFT) | (unsigned long)digits[1]) << PyLong_SHIFT) | (unsigned long)digits[0])))
                        } else if (8 * sizeof(size_t) >= 3 * PyLong_SHIFT) {
                            return (size_t) (((((((size_t)digits[2]) << PyLong_SHIFT) | (size_t)digits[1]) << PyLong_SHIFT) | (size_t)digits[0]));
                        }
                    }
                    break;
                case 4:
                    if (8 * sizeof(size_t) > 3 * PyLong_SHIFT) {
                        if (8 * sizeof(unsigned long) > 4 * PyLong_SHIFT) {
                            __PYX_VERIFY_RETURN_INT(size_t, unsigned long, (((((((((unsigned long)digits[3]) << PyLong_SHIFT) | (unsigned long)digits[2]) << PyLong_SHIFT) | (unsigned long)digits[1]) << PyLong_SHIFT) | (unsigned long)digits[0])))
                        } else if (8 * sizeof(size_t) >= 4 * PyLong_SHIFT) {
                            return (size_t) (((((((((size_t)digits[3]) << PyLong_SHIFT) | (size_t)digits[2]) << PyLong_SHIFT) | (size_t)digits[1]) << PyLong_SHIFT) | (size_t)digits[0]));
                        }
                    }
                    break;
            }
#endif
#if CYTHON_COMPILING_IN_CPYTHON
            if (unlikely(Py_SIZE(x) < 0)) {
                goto raise_neg_overflow;
            }
#else
            {
                int result = PyObject_RichCompareBool(x, Py_False, Py_LT);
                if (unlikely(result < 0))
                    return (size_t) -1;
                if (unlikely(result == 1))
                    goto raise_neg_overflow;
            }
#endif
            if (sizeof(size_t) <= sizeof(unsigned long)) {
                __PYX_VERIFY_RETURN_INT_EXC(size_t, unsigned long, PyLong_AsUnsignedLong(x))
            } else if (sizeof(size_t) <= sizeof(unsigned PY_LONG_LONG)) {
                __PYX_VERIFY_RETURN_INT_EXC(size_t, unsigned PY_LONG_LONG, PyLong_AsUnsignedLongLong(x))
            }
        } else {
#if CYTHON_USE_PYLONG_INTERNALS
            const digit* digits = ((PyLongObject*)x)->ob_digit;
            switch (Py_SIZE(x)) {
                case  0: return (size_t) 0;
                case -1: __PYX_VERIFY_RETURN_INT(size_t, sdigit, (sdigit) (-(sdigit)digits[0]))
                case  1: __PYX_VERIFY_RETURN_INT(size_t,  digit, +digits[0])
                case -2:
                    if (8 * sizeof(size_t) - 1 > 1 * PyLong_SHIFT) {
                        if (8 * sizeof(unsigned long) > 2 * PyLong_SHIFT) {
                            __PYX_VERIFY_RETURN_INT(size_t, long, -(long) (((((unsigned long)digits[1]) << PyLong_SHIFT) | (unsigned long)digits[0])))
                        } else if (8 * sizeof(size_t) - 1 > 2 * PyLong_SHIFT) {
                            return (size_t) (((size_t)-1)*(((((size_t)digits[1]) << PyLong_SHIFT) | (size_t)digits[0])));
                        }
                    }
                    break;
                case 2:
                    if (8 * sizeof(size_t) > 1 * PyLong_SHIFT) {
                        if (8 * sizeof(unsigned long) > 2 * PyLong_SHIFT) {
                            __PYX_VERIFY_RETURN_INT(size_t, unsigned long, (((((unsigned long)digits[1]) << PyLong_SHIFT) | (unsigned long)digits[0])))
                        } else if (8 * sizeof(size_t) - 1 > 2 * PyLong_SHIFT) {
                            return (size_t) ((((((size_t)digits[1]) << PyLong_SHIFT) | (size_t)digits[0])));
                        }
                    }
                    break;
                case -3:
                    if (8 * sizeof(size_t) - 1 > 2 * PyLong_SHIFT) {
                        if (8 * sizeof(unsigned long) > 3 * PyLong_SHIFT) {
                            __PYX_VERIFY_RETURN_INT(size_t, long, -(long) (((((((unsigned long)digits[2]) << PyLong_SHIFT) | (unsigned long)digits[1]) << PyLong_SHIFT) | (unsigned long)digits[0])))
                        } else if (8 * sizeof(size_t) - 1 > 3 * PyLong_SHIFT) {
                            return (size_t) (((size_t)-1)*(((((((size_t)digits[2]) << PyLong_SHIFT) | (size_t)digits[1]) << PyLong_SHIFT) | (size_t)digits[0])));
                        }
                    }
                    break;
                case 3:
                    if (8 * sizeof(size_t) > 2 * PyLong_SHIFT) {
                        if (8 * sizeof(unsigned long) > 3 * PyLong_SHIFT) {
                            __PYX_VERIFY_RETURN_INT(size_t, unsigned long, (((((((unsigned long)digits[2]) << PyLong_SHIFT) | (unsigned long)digits[1]) << PyLong_SHIFT) | (unsigned long)digits[0])))
                        } else if (8 * sizeof(size_t) - 1 > 3 * PyLong_SHIFT) {
                            return (size_t) ((((((((size_t)digits[2]) << PyLong_SHIFT) | (size_t)digits[1]) << PyLong_SHIFT) | (size_t)digits[0])));
                        }
                    }
                    break;
                case -4:
                    if (8 * sizeof(size_t) - 1 > 3 * PyLong_SHIFT) {
                        if (8 * sizeof(unsigned long) > 4 * PyLong_SHIFT) {
                            __PYX_VERIFY_RETURN_INT(size_t, long, -(long) (((((((((unsigned long)digits[3]) << PyLong_SHIFT) | (unsigned long)digits[2]) << PyLong_SHIFT) | (unsigned long)digits[1]) << PyLong_SHIFT) | (unsigned long)digits[0])))
                        } else if (8 * sizeof(size_t) - 1 > 4 * PyLong_SHIFT) {
                            return (size_t) (((size_t)-1)*(((((((((size_t)digits[3]) << PyLong_SHIFT) | (size_t)digits[2]) << PyLong_SHIFT) | (size_t)digits[1]) << PyLong_SHIFT) | (size_t)digits[0])));
                        }
                    }
                    break;
                case 4:
                    if (8 * sizeof(size_t) > 3 * PyLong_SHIFT) {
                        if (8 * sizeof(unsigned long) > 4 * PyLong_SHIFT) {
                            __PYX_VERIFY_RETURN_INT(size_t, unsigned long, (((((((((unsigned long)digits[3]) << PyLong_SHIFT) | (unsigned long)digits[2]) << PyLong_SHIFT) | (unsigned long)digits[1]) << PyLong_SHIFT) | (unsigned long)digits[0])))
                        } else if (8 * sizeof(size_t) - 1 > 4 * PyLong_SHIFT) {
                            return (size_t) ((((((((((size_t)digits[3]) << PyLong_SHIFT) | (size_t)digits[2]) << PyLong_SHIFT) | (size_t)digits[1]) << PyLong_SHIFT) | (size_t)digits[0])));
                        }
                    }
                    break;
            }
#endif
            if (sizeof(size_t) <= sizeof(long)) {
                __PYX_VERIFY_RETURN_INT_EXC(size_t, long, PyLong_AsLong(x))
            } else if (sizeof(size_t) <= sizeof(PY_LONG_LONG)) {
                __PYX_VERIFY_RETURN_INT_EXC(size_t, PY_LONG_LONG, PyLong_AsLongLong(x))
            }
        }
        {
#if CYTHON_COMPILING_IN_PYPY && !defined(_PyLong_AsByteArray)
            PyErr_SetString(PyExc_RuntimeError,
                            "_PyLong_AsByteArray() not available in PyPy, cannot convert large numbers");
#else
            size_t val;
            PyObject *v = __Pyx_PyNumber_IntOrLong(x);
 #if PY_MAJOR_VERSION < 3
            if (likely(v) && !PyLong_Check(v)) {
                PyObject *tmp = v;
                v = PyNumber_Long(tmp);
                Py_DECREF(tmp);
            }
 #endif
            if (likely(v)) {
                int one = 1; int is_little = (int)*(unsigned char *)&one;
                unsigned char *bytes = (unsigned char *)&val;
                int ret = _PyLong_AsByteArray((PyLongObject *)v,
                                              bytes, sizeof(val),
                                              is_little, !is_unsigned);
                Py_DECREF(v);
                if (likely(!ret))
                    return val;
            }
#endif
            return (size_t) -1;
        }
    } else {
        size_t val;
        PyObject *tmp = __Pyx_PyNumber_IntOrLong(x);
        if (!tmp) return (size_t) -1;
        val = __Pyx_PyInt_As_size_t(tmp);
        Py_DECREF(tmp);
        return val;
    }
raise_overflow:
    PyErr_SetString(PyExc_OverflowError,
        "value too large to convert to size_t");
    return (size_t) -1;
raise_neg_overflow:
    PyErr_SetString(PyExc_OverflowError,
        "can't convert negative value to size_t");
    return (size_t) -1;
}

/* PrintOne */
#if !CYTHON_COMPILING_IN_PYPY && PY_MAJOR_VERSION < 3
static int __Pyx_PrintOne(PyObject* f, PyObject *o) {
    if (!f) {
        if (!(f = __Pyx_GetStdout()))
            return -1;
    }
    Py_INCREF(f);
    if (PyFile_SoftSpace(f, 0)) {
        if (PyFile_WriteString(" ", f) < 0)
            goto error;
    }
    if (PyFile_WriteObject(o, f, Py_PRINT_RAW) < 0)
        goto error;
    if (PyFile_WriteString("\n", f) < 0)
        goto error;
    Py_DECREF(f);
    return 0;
error:
    Py_DECREF(f);
    return -1;
    /* the line below is just to avoid C compiler
     * warnings about unused functions */
    return __Pyx_Print(f, NULL, 0);
}
#else
static int __Pyx_PrintOne(PyObject* stream, PyObject *o) {
    int res;
    PyObject* arg_tuple = PyTuple_Pack(1, o);
    if (unlikely(!arg_tuple))
        return -1;
    res = __Pyx_Print(stream, arg_tuple, 1);
    Py_DECREF(arg_tuple);
    return res;
}
#endif

/* CIntToPy */
static CYTHON_INLINE PyObject* __Pyx_PyInt_From_long(long value) {
    const long neg_one = (long) -1, const_zero = (long) 0;
    const int is_unsigned = neg_one > const_zero;
    if (is_unsigned) {
        if (sizeof(long) < sizeof(long)) {
            return PyInt_FromLong((long) value);
        } else if (sizeof(long) <= sizeof(unsigned long)) {
            return PyLong_FromUnsignedLong((unsigned long) value);
        } else if (sizeof(long) <= sizeof(unsigned PY_LONG_LONG)) {
            return PyLong_FromUnsignedLongLong((unsigned PY_LONG_LONG) value);
        }
    } else {
        if (sizeof(long) <= sizeof(long)) {
            return PyInt_FromLong((long) value);
        } else if (sizeof(long) <= sizeof(PY_LONG_LONG)) {
            return PyLong_FromLongLong((PY_LONG_LONG) value);
        }
    }
    {
        int one = 1; int little = (int)*(unsigned char *)&one;
        unsigned char *bytes = (unsigned char *)&value;
        return _PyLong_FromByteArray(bytes, sizeof(long),
                                     little, !is_unsigned);
    }
}

/* CIntFromPy */
static CYTHON_INLINE long __Pyx_PyInt_As_long(PyObject *x) {
    const long neg_one = (long) -1, const_zero = (long) 0;
    const int is_unsigned = neg_one > const_zero;
#if PY_MAJOR_VERSION < 3
    if (likely(PyInt_Check(x))) {
        if (sizeof(long) < sizeof(long)) {
            __PYX_VERIFY_RETURN_INT(long, long, PyInt_AS_LONG(x))
        } else {
            long val = PyInt_AS_LONG(x);
            if (is_unsigned && unlikely(val < 0)) {
                goto raise_neg_overflow;
            }
            return (long) val;
        }
    } else
#endif
    if (likely(PyLong_Check(x))) {
        if (is_unsigned) {
#if CYTHON_USE_PYLONG_INTERNALS
            const digit* digits = ((PyLongObject*)x)->ob_digit;
            switch (Py_SIZE(x)) {
                case  0: return (long) 0;
                case  1: __PYX_VERIFY_RETURN_INT(long, digit, digits[0])
                case 2:
                    if (8 * sizeof(long) > 1 * PyLong_SHIFT) {
                        if (8 * sizeof(unsigned long) > 2 * PyLong_SHIFT) {
                            __PYX_VERIFY_RETURN_INT(long, unsigned long, (((((unsigned long)digits[1]) << PyLong_SHIFT) | (unsigned long)digits[0])))
                        } else if (8 * sizeof(long) >= 2 * PyLong_SHIFT) {
                            return (long) (((((long)digits[1]) << PyLong_SHIFT) | (long)digits[0]));
                        }
                    }
                    break;
                case 3:
                    if (8 * sizeof(long) > 2 * PyLong_SHIFT) {
                        if (8 * sizeof(unsigned long) > 3 * PyLong_SHIFT) {
                            __PYX_VERIFY_RETURN_INT(long, unsigned long, (((((((unsigned long)digits[2]) << PyLong_SHIFT) | (unsigned long)digits[1]) << PyLong_SHIFT) | (unsigned long)digits[0])))
                        } else if (8 * sizeof(long) >= 3 * PyLong_SHIFT) {
                            return (long) (((((((long)digits[2]) << PyLong_SHIFT) | (long)digits[1]) << PyLong_SHIFT) | (long)digits[0]));
                        }
                    }
                    break;
                case 4:
                    if (8 * sizeof(long) > 3 * PyLong_SHIFT) {
                        if (8 * sizeof(unsigned long) > 4 * PyLong_SHIFT) {
                            __PYX_VERIFY_RETURN_INT(long, unsigned long, (((((((((unsigned long)digits[3]) << PyLong_SHIFT) | (unsigned long)digits[2]) << PyLong_SHIFT) | (unsigned long)digits[1]) << PyLong_SHIFT) | (unsigned long)digits[0])))
                        } else if (8 * sizeof(long) >= 4 * PyLong_SHIFT) {
                            return (long) (((((((((long)digits[3]) << PyLong_SHIFT) | (long)digits[2]) << PyLong_SHIFT) | (long)digits[1]) << PyLong_SHIFT) | (long)digits[0]));
                        }
                    }
                    break;
            }
#endif
#if CYTHON_COMPILING_IN_CPYTHON
            if (unlikely(Py_SIZE(x) < 0)) {
                goto raise_neg_overflow;
            }
#else
            {
                int result = PyObject_RichCompareBool(x, Py_False, Py_LT);
                if (unlikely(result < 0))
                    return (long) -1;
                if (unlikely(result == 1))
                    goto raise_neg_overflow;
            }
#endif
            if (sizeof(long) <= sizeof(unsigned long)) {
                __PYX_VERIFY_RETURN_INT_EXC(long, unsigned long, PyLong_AsUnsignedLong(x))
            } else if (sizeof(long) <= sizeof(unsigned PY_LONG_LONG)) {
                __PYX_VERIFY_RETURN_INT_EXC(long, unsigned PY_LONG_LONG, PyLong_AsUnsignedLongLong(x))
            }
        } else {
#if CYTHON_USE_PYLONG_INTERNALS
            const digit* digits = ((PyLongObject*)x)->ob_digit;
            switch (Py_SIZE(x)) {
                case  0: return (long) 0;
                case -1: __PYX_VERIFY_RETURN_INT(long, sdigit, (sdigit) (-(sdigit)digits[0]))
                case  1: __PYX_VERIFY_RETURN_INT(long,  digit, +digits[0])
                case -2:
                    if (8 * sizeof(long) - 1 > 1 * PyLong_SHIFT) {
                        if (8 * sizeof(unsigned long) > 2 * PyLong_SHIFT) {
                            __PYX_VERIFY_RETURN_INT(long, long, -(long) (((((unsigned long)digits[1]) << PyLong_SHIFT) | (unsigned long)digits[0])))
                        } else if (8 * sizeof(long) - 1 > 2 * PyLong_SHIFT) {
                            return (long) (((long)-1)*(((((long)digits[1]) << PyLong_SHIFT) | (long)digits[0])));
                        }
                    }
                    break;
                case 2:
                    if (8 * sizeof(long) > 1 * PyLong_SHIFT) {
                        if (8 * sizeof(unsigned long) > 2 * PyLong_SHIFT) {
                            __PYX_VERIFY_RETURN_INT(long, unsigned long, (((((unsigned long)digits[1]) << PyLong_SHIFT) | (unsigned long)digits[0])))
                        } else if (8 * sizeof(long) - 1 > 2 * PyLong_SHIFT) {
                            return (long) ((((((long)digits[1]) << PyLong_SHIFT) | (long)digits[0])));
                        }
                    }
                    break;
                case -3:
                    if (8 * sizeof(long) - 1 > 2 * PyLong_SHIFT) {
                        if (8 * sizeof(unsigned long) > 3 * PyLong_SHIFT) {
                            __PYX_VERIFY_RETURN_INT(long, long, -(long) (((((((unsigned long)digits[2]) << PyLong_SHIFT) | (unsigned long)digits[1]) << PyLong_SHIFT) | (unsigned long)digits[0])))
                        } else if (8 * sizeof(long) - 1 > 3 * PyLong_SHIFT) {
                            return (long) (((long)-1)*(((((((long)digits[2]) << PyLong_SHIFT) | (long)digits[1]) << PyLong_SHIFT) | (long)digits[0])));
                        }
                    }
                    break;
                case 3:
                    if (8 * sizeof(long) > 2 * PyLong_SHIFT) {
                        if (8 * sizeof(unsigned long) > 3 * PyLong_SHIFT) {
                            __PYX_VERIFY_RETURN_INT(long, unsigned long, (((((((unsigned long)digits[2]) << PyLong_SHIFT) | (unsigned long)digits[1]) << PyLong_SHIFT) | (unsigned long)digits[0])))
                        } else if (8 * sizeof(long) - 1 > 3 * PyLong_SHIFT) {
                            return (long) ((((((((long)digits[2]) << PyLong_SHIFT) | (long)digits[1]) << PyLong_SHIFT) | (long)digits[0])));
                        }
                    }
                    break;
                case -4:
                    if (8 * sizeof(long) - 1 > 3 * PyLong_SHIFT) {
                        if (8 * sizeof(unsigned long) > 4 * PyLong_SHIFT) {
                            __PYX_VERIFY_RETURN_INT(long, long, -(long) (((((((((unsigned long)digits[3]) << PyLong_SHIFT) | (unsigned long)digits[2]) << PyLong_SHIFT) | (unsigned long)digits[1]) << PyLong_SHIFT) | (unsigned long)digits[0])))
                        } else if (8 * sizeof(long) - 1 > 4 * PyLong_SHIFT) {
                            return (long) (((long)-1)*(((((((((long)digits[3]) << PyLong_SHIFT) | (long)digits[2]) << PyLong_SHIFT) | (long)digits[1]) << PyLong_SHIFT) | (long)digits[0])));
                        }
                    }
                    break;
                case 4:
                    if (8 * sizeof(long) > 3 * PyLong_SHIFT) {
                        if (8 * sizeof(unsigned long) > 4 * PyLong_SHIFT) {
                            __PYX_VERIFY_RETURN_INT(long, unsigned long, (((((((((unsigned long)digits[3]) << PyLong_SHIFT) | (unsigned long)digits[2]) << PyLong_SHIFT) | (unsigned long)digits[1]) << PyLong_SHIFT) | (unsigned long)digits[0])))
                        } else if (8 * sizeof(long) - 1 > 4 * PyLong_SHIFT) {
                            return (long) ((((((((((long)digits[3]) << PyLong_SHIFT) | (long)digits[2]) << PyLong_SHIFT) | (long)digits[1]) << PyLong_SHIFT) | (long)digits[0])));
                        }
                    }
                    break;
            }
#endif
            if (sizeof(long) <= sizeof(long)) {
                __PYX_VERIFY_RETURN_INT_EXC(long, long, PyLong_AsLong(x))
            } else if (sizeof(long) <= sizeof(PY_LONG_LONG)) {
                __PYX_VERIFY_RETURN_INT_EXC(long, PY_LONG_LONG, PyLong_AsLongLong(x))
            }
        }
        {
#if CYTHON_COMPILING_IN_PYPY && !defined(_PyLong_AsByteArray)
            PyErr_SetString(PyExc_RuntimeError,
                            "_PyLong_AsByteArray() not available in PyPy, cannot convert large numbers");
#else
            long val;
            PyObject *v = __Pyx_PyNumber_IntOrLong(x);
 #if PY_MAJOR_VERSION < 3
            if (likely(v) && !PyLong_Check(v)) {
                PyObject *tmp = v;
                v = PyNumber_Long(tmp);
                Py_DECREF(tmp);
            }
 #endif
            if (likely(v)) {
                int one = 1; int is_little = (int)*(unsigned char *)&one;
                unsigned char *bytes = (unsigned char *)&val;
                int ret = _PyLong_AsByteArray((PyLongObject *)v,
                                              bytes, sizeof(val),
                                              is_little, !is_unsigned);
                Py_DECREF(v);
                if (likely(!ret))
                    return val;
            }
#endif
            return (long) -1;
        }
    } else {
        long val;
        PyObject *tmp = __Pyx_PyNumber_IntOrLong(x);
        if (!tmp) return (long) -1;
        val = __Pyx_PyInt_As_long(tmp);
        Py_DECREF(tmp);
        return val;
    }
raise_overflow:
    PyErr_SetString(PyExc_OverflowError,
        "value too large to convert to long");
    return (long) -1;
raise_neg_overflow:
    PyErr_SetString(PyExc_OverflowError,
        "can't convert negative value to long");
    return (long) -1;
}

/* CIntFromPy */
static CYTHON_INLINE int __Pyx_PyInt_As_int(PyObject *x) {
    const int neg_one = (int) -1, const_zero = (int) 0;
    const int is_unsigned = neg_one > const_zero;
#if PY_MAJOR_VERSION < 3
    if (likely(PyInt_Check(x))) {
        if (sizeof(int) < sizeof(long)) {
            __PYX_VERIFY_RETURN_INT(int, long, PyInt_AS_LONG(x))
        } else {
            long val = PyInt_AS_LONG(x);
            if (is_unsigned && unlikely(val < 0)) {
                goto raise_neg_overflow;
            }
            return (int) val;
        }
    } else
#endif
    if (likely(PyLong_Check(x))) {
        if (is_unsigned) {
#if CYTHON_USE_PYLONG_INTERNALS
            const digit* digits = ((PyLongObject*)x)->ob_digit;
            switch (Py_SIZE(x)) {
                case  0: return (int) 0;
                case  1: __PYX_VERIFY_RETURN_INT(int, digit, digits[0])
                case 2:
                    if (8 * sizeof(int) > 1 * PyLong_SHIFT) {
                        if (8 * sizeof(unsigned long) > 2 * PyLong_SHIFT) {
                            __PYX_VERIFY_RETURN_INT(int, unsigned long, (((((unsigned long)digits[1]) << PyLong_SHIFT) | (unsigned long)digits[0])))
                        } else if (8 * sizeof(int) >= 2 * PyLong_SHIFT) {
                            return (int) (((((int)digits[1]) << PyLong_SHIFT) | (int)digits[0]));
                        }
                    }
                    break;
                case 3:
                    if (8 * sizeof(int) > 2 * PyLong_SHIFT) {
                        if (8 * sizeof(unsigned long) > 3 * PyLong_SHIFT) {
                            __PYX_VERIFY_RETURN_INT(int, unsigned long, (((((((unsigned long)digits[2]) << PyLong_SHIFT) | (unsigned long)digits[1]) << PyLong_SHIFT) | (unsigned long)digits[0])))
                        } else if (8 * sizeof(int) >= 3 * PyLong_SHIFT) {
                            return (int) (((((((int)digits[2]) << PyLong_SHIFT) | (int)digits[1]) << PyLong_SHIFT) | (int)digits[0]));
                        }
                    }
                    break;
                case 4:
                    if (8 * sizeof(int) > 3 * PyLong_SHIFT) {
                        if (8 * sizeof(unsigned long) > 4 * PyLong_SHIFT) {
                            __PYX_VERIFY_RETURN_INT(int, unsigned long, (((((((((unsigned long)digits[3]) << PyLong_SHIFT) | (unsigned long)digits[2]) << PyLong_SHIFT) | (unsigned long)digits[1]) << PyLong_SHIFT) | (unsigned long)digits[0])))
                        } else if (8 * sizeof(int) >= 4 * PyLong_SHIFT) {
                            return (int) (((((((((int)digits[3]) << PyLong_SHIFT) | (int)digits[2]) << PyLong_SHIFT) | (int)digits[1]) << PyLong_SHIFT) | (int)digits[0]));
                        }
                    }
                    break;
            }
#endif
#if CYTHON_COMPILING_IN_CPYTHON
            if (unlikely(Py_SIZE(x) < 0)) {
                goto raise_neg_overflow;
            }
#else
            {
                int result = PyObject_RichCompareBool(x, Py_False, Py_LT);
                if (unlikely(result < 0))
                    return (int) -1;
                if (unlikely(result == 1))
                    goto raise_neg_overflow;
            }
#endif
            if (sizeof(int) <= sizeof(unsigned long)) {
                __PYX_VERIFY_RETURN_INT_EXC(int, unsigned long, PyLong_AsUnsignedLong(x))
            } else if (sizeof(int) <= sizeof(unsigned PY_LONG_LONG)) {
                __PYX_VERIFY_RETURN_INT_EXC(int, unsigned PY_LONG_LONG, PyLong_AsUnsignedLongLong(x))
            }
        } else {
#if CYTHON_USE_PYLONG_INTERNALS
            const digit* digits = ((PyLongObject*)x)->ob_digit;
            switch (Py_SIZE(x)) {
                case  0: return (int) 0;
                case -1: __PYX_VERIFY_RETURN_INT(int, sdigit, (sdigit) (-(sdigit)digits[0]))
                case  1: __PYX_VERIFY_RETURN_INT(int,  digit, +digits[0])
                case -2:
                    if (8 * sizeof(int) - 1 > 1 * PyLong_SHIFT) {
                        if (8 * sizeof(unsigned long) > 2 * PyLong_SHIFT) {
                            __PYX_VERIFY_RETURN_INT(int, long, -(long) (((((unsigned long)digits[1]) << PyLong_SHIFT) | (unsigned long)digits[0])))
                        } else if (8 * sizeof(int) - 1 > 2 * PyLong_SHIFT) {
                            return (int) (((int)-1)*(((((int)digits[1]) << PyLong_SHIFT) | (int)digits[0])));
                        }
                    }
                    break;
                case 2:
                    if (8 * sizeof(int) > 1 * PyLong_SHIFT) {
                        if (8 * sizeof(unsigned long) > 2 * PyLong_SHIFT) {
                            __PYX_VERIFY_RETURN_INT(int, unsigned long, (((((unsigned long)digits[1]) << PyLong_SHIFT) | (unsigned long)digits[0])))
                        } else if (8 * sizeof(int) - 1 > 2 * PyLong_SHIFT) {
                            return (int) ((((((int)digits[1]) << PyLong_SHIFT) | (int)digits[0])));
                        }
                    }
                    break;
                case -3:
                    if (8 * sizeof(int) - 1 > 2 * PyLong_SHIFT) {
                        if (8 * sizeof(unsigned long) > 3 * PyLong_SHIFT) {
                            __PYX_VERIFY_RETURN_INT(int, long, -(long) (((((((unsigned long)digits[2]) << PyLong_SHIFT) | (unsigned long)digits[1]) << PyLong_SHIFT) | (unsigned long)digits[0])))
                        } else if (8 * sizeof(int) - 1 > 3 * PyLong_SHIFT) {
                            return (int) (((int)-1)*(((((((int)digits[2]) << PyLong_SHIFT) | (int)digits[1]) << PyLong_SHIFT) | (int)digits[0])));
                        }
                    }
                    break;
                case 3:
                    if (8 * sizeof(int) > 2 * PyLong_SHIFT) {
                        if (8 * sizeof(unsigned long) > 3 * PyLong_SHIFT) {
                            __PYX_VERIFY_RETURN_INT(int, unsigned long, (((((((unsigned long)digits[2]) << PyLong_SHIFT) | (unsigned long)digits[1]) << PyLong_SHIFT) | (unsigned long)digits[0])))
                        } else if (8 * sizeof(int) - 1 > 3 * PyLong_SHIFT) {
                            return (int) ((((((((int)digits[2]) << PyLong_SHIFT) | (int)digits[1]) << PyLong_SHIFT) | (int)digits[0])));
                        }
                    }
                    break;
                case -4:
                    if (8 * sizeof(int) - 1 > 3 * PyLong_SHIFT) {
                        if (8 * sizeof(unsigned long) > 4 * PyLong_SHIFT) {
                            __PYX_VERIFY_RETURN_INT(int, long, -(long) (((((((((unsigned long)digits[3]) << PyLong_SHIFT) | (unsigned long)digits[2]) << PyLong_SHIFT) | (unsigned long)digits[1]) << PyLong_SHIFT) | (unsigned long)digits[0])))
                        } else if (8 * sizeof(int) - 1 > 4 * PyLong_SHIFT) {
                            return (int) (((int)-1)*(((((((((int)digits[3]) << PyLong_SHIFT) | (int)digits[2]) << PyLong_SHIFT) | (int)digits[1]) << PyLong_SHIFT) | (int)digits[0])));
                        }
                    }
                    break;
                case 4:
                    if (8 * sizeof(int) > 3 * PyLong_SHIFT) {
                        if (8 * sizeof(unsigned long) > 4 * PyLong_SHIFT) {
                            __PYX_VERIFY_RETURN_INT(int, unsigned long, (((((((((unsigned long)digits[3]) << PyLong_SHIFT) | (unsigned long)digits[2]) << PyLong_SHIFT) | (unsigned long)digits[1]) << PyLong_SHIFT) | (unsigned long)digits[0])))
                        } else if (8 * sizeof(int) - 1 > 4 * PyLong_SHIFT) {
                            return (int) ((((((((((int)digits[3]) << PyLong_SHIFT) | (int)digits[2]) << PyLong_SHIFT) | (int)digits[1]) << PyLong_SHIFT) | (int)digits[0])));
                        }
                    }
                    break;
            }
#endif
            if (sizeof(int) <= sizeof(long)) {
                __PYX_VERIFY_RETURN_INT_EXC(int, long, PyLong_AsLong(x))
            } else if (sizeof(int) <= sizeof(PY_LONG_LONG)) {
                __PYX_VERIFY_RETURN_INT_EXC(int, PY_LONG_LONG, PyLong_AsLongLong(x))
            }
        }
        {
#if CYTHON_COMPILING_IN_PYPY && !defined(_PyLong_AsByteArray)
            PyErr_SetString(PyExc_RuntimeError,
                            "_PyLong_AsByteArray() not available in PyPy, cannot convert large numbers");
#else
            int val;
            PyObject *v = __Pyx_PyNumber_IntOrLong(x);
 #if PY_MAJOR_VERSION < 3
            if (likely(v) && !PyLong_Check(v)) {
                PyObject *tmp = v;
                v = PyNumber_Long(tmp);
                Py_DECREF(tmp);
            }
 #endif
            if (likely(v)) {
                int one = 1; int is_little = (int)*(unsigned char *)&one;
                unsigned char *bytes = (unsigned char *)&val;
                int ret = _PyLong_AsByteArray((PyLongObject *)v,
                                              bytes, sizeof(val),
                                              is_little, !is_unsigned);
                Py_DECREF(v);
                if (likely(!ret))
                    return val;
            }
#endif
            return (int) -1;
        }
    } else {
        int val;
        PyObject *tmp = __Pyx_PyNumber_IntOrLong(x);
        if (!tmp) return (int) -1;
        val = __Pyx_PyInt_As_int(tmp);
        Py_DECREF(tmp);
        return val;
    }
raise_overflow:
    PyErr_SetString(PyExc_OverflowError,
        "value too large to convert to int");
    return (int) -1;
raise_neg_overflow:
    PyErr_SetString(PyExc_OverflowError,
        "can't convert negative value to int");
    return (int) -1;
}

/* CheckBinaryVersion */
static int __Pyx_check_binary_version(void) {
    char ctversion[4], rtversion[4];
    PyOS_snprintf(ctversion, 4, "%d.%d", PY_MAJOR_VERSION, PY_MINOR_VERSION);
    PyOS_snprintf(rtversion, 4, "%s", Py_GetVersion());
    if (ctversion[0] != rtversion[0] || ctversion[2] != rtversion[2]) {
        char message[200];
        PyOS_snprintf(message, sizeof(message),
                      "compiletime version %s of module '%.100s' "
                      "does not match runtime version %s",
                      ctversion, __Pyx_MODULE_NAME, rtversion);
        return PyErr_WarnEx(NULL, message, 1);
    }
    return 0;
}

/* ModuleImport */
#ifndef __PYX_HAVE_RT_ImportModule
#define __PYX_HAVE_RT_ImportModule
static PyObject *__Pyx_ImportModule(const char *name) {
    PyObject *py_name = 0;
    PyObject *py_module = 0;
    py_name = __Pyx_PyIdentifier_FromString(name);
    if (!py_name)
        goto bad;
    py_module = PyImport_Import(py_name);
    Py_DECREF(py_name);
    return py_module;
bad:
    Py_XDECREF(py_name);
    return 0;
}
#endif

/* TypeImport */
#ifndef __PYX_HAVE_RT_ImportType
#define __PYX_HAVE_RT_ImportType
static PyTypeObject *__Pyx_ImportType(const char *module_name, const char *class_name,
    size_t size, int strict)
{
    PyObject *py_module = 0;
    PyObject *result = 0;
    PyObject *py_name = 0;
    char warning[200];
    Py_ssize_t basicsize;
#ifdef Py_LIMITED_API
    PyObject *py_basicsize;
#endif
    py_module = __Pyx_ImportModule(module_name);
    if (!py_module)
        goto bad;
    py_name = __Pyx_PyIdentifier_FromString(class_name);
    if (!py_name)
        goto bad;
    result = PyObject_GetAttr(py_module, py_name);
    Py_DECREF(py_name);
    py_name = 0;
    Py_DECREF(py_module);
    py_module = 0;
    if (!result)
        goto bad;
    if (!PyType_Check(result)) {
        PyErr_Format(PyExc_TypeError,
            "%.200s.%.200s is not a type object",
            module_name, class_name);
        goto bad;
    }
#ifndef Py_LIMITED_API
    basicsize = ((PyTypeObject *)result)->tp_basicsize;
#else
    py_basicsize = PyObject_GetAttrString(result, "__basicsize__");
    if (!py_basicsize)
        goto bad;
    basicsize = PyLong_AsSsize_t(py_basicsize);
    Py_DECREF(py_basicsize);
    py_basicsize = 0;
    if (basicsize == (Py_ssize_t)-1 && PyErr_Occurred())
        goto bad;
#endif
    if (!strict && (size_t)basicsize > size) {
        PyOS_snprintf(warning, sizeof(warning),
            "%s.%s size changed, may indicate binary incompatibility. Expected %zd, got %zd",
            module_name, class_name, basicsize, size);
        if (PyErr_WarnEx(NULL, warning, 0) < 0) goto bad;
    }
    else if ((size_t)basicsize != size) {
        PyErr_Format(PyExc_ValueError,
            "%.200s.%.200s has the wrong size, try recompiling. Expected %zd, got %zd",
            module_name, class_name, basicsize, size);
        goto bad;
    }
    return (PyTypeObject *)result;
bad:
    Py_XDECREF(py_module);
    Py_XDECREF(result);
    return NULL;
}
#endif

/* InitStrings */
static int __Pyx_InitStrings(__Pyx_StringTabEntry *t) {
    while (t->p) {
        #if PY_MAJOR_VERSION < 3
        if (t->is_unicode) {
            *t->p = PyUnicode_DecodeUTF8(t->s, t->n - 1, NULL);
        } else if (t->intern) {
            *t->p = PyString_InternFromString(t->s);
        } else {
            *t->p = PyString_FromStringAndSize(t->s, t->n - 1);
        }
        #else
        if (t->is_unicode | t->is_str) {
            if (t->intern) {
                *t->p = PyUnicode_InternFromString(t->s);
            } else if (t->encoding) {
                *t->p = PyUnicode_Decode(t->s, t->n - 1, t->encoding, NULL);
            } else {
                *t->p = PyUnicode_FromStringAndSize(t->s, t->n - 1);
            }
        } else {
            *t->p = PyBytes_FromStringAndSize(t->s, t->n - 1);
        }
        #endif
        if (!*t->p)
            return -1;
        ++t;
    }
    return 0;
}

static CYTHON_INLINE PyObject* __Pyx_PyUnicode_FromString(const char* c_str) {
    return __Pyx_PyUnicode_FromStringAndSize(c_str, (Py_ssize_t)strlen(c_str));
}
static CYTHON_INLINE char* __Pyx_PyObject_AsString(PyObject* o) {
    Py_ssize_t ignore;
    return __Pyx_PyObject_AsStringAndSize(o, &ignore);
}
static CYTHON_INLINE char* __Pyx_PyObject_AsStringAndSize(PyObject* o, Py_ssize_t *length) {
#if CYTHON_COMPILING_IN_CPYTHON && (__PYX_DEFAULT_STRING_ENCODING_IS_ASCII || __PYX_DEFAULT_STRING_ENCODING_IS_DEFAULT)
    if (
#if PY_MAJOR_VERSION < 3 && __PYX_DEFAULT_STRING_ENCODING_IS_ASCII
            __Pyx_sys_getdefaultencoding_not_ascii &&
#endif
            PyUnicode_Check(o)) {
#if PY_VERSION_HEX < 0x03030000
        char* defenc_c;
        PyObject* defenc = _PyUnicode_AsDefaultEncodedString(o, NULL);
        if (!defenc) return NULL;
        defenc_c = PyBytes_AS_STRING(defenc);
#if __PYX_DEFAULT_STRING_ENCODING_IS_ASCII
        {
            char* end = defenc_c + PyBytes_GET_SIZE(defenc);
            char* c;
            for (c = defenc_c; c < end; c++) {
                if ((unsigned char) (*c) >= 128) {
                    PyUnicode_AsASCIIString(o);
                    return NULL;
                }
            }
        }
#endif
        *length = PyBytes_GET_SIZE(defenc);
        return defenc_c;
#else
        if (__Pyx_PyUnicode_READY(o) == -1) return NULL;
#if __PYX_DEFAULT_STRING_ENCODING_IS_ASCII
        if (PyUnicode_IS_ASCII(o)) {
            *length = PyUnicode_GET_LENGTH(o);
            return PyUnicode_AsUTF8(o);
        } else {
            PyUnicode_AsASCIIString(o);
            return NULL;
        }
#else
        return PyUnicode_AsUTF8AndSize(o, length);
#endif
#endif
    } else
#endif
#if (!CYTHON_COMPILING_IN_PYPY) || (defined(PyByteArray_AS_STRING) && defined(PyByteArray_GET_SIZE))
    if (PyByteArray_Check(o)) {
        *length = PyByteArray_GET_SIZE(o);
        return PyByteArray_AS_STRING(o);
    } else
#endif
    {
        char* result;
        int r = PyBytes_AsStringAndSize(o, &result, length);
        if (unlikely(r < 0)) {
            return NULL;
        } else {
            return result;
        }
    }
}
static CYTHON_INLINE int __Pyx_PyObject_IsTrue(PyObject* x) {
   int is_true = x == Py_True;
   if (is_true | (x == Py_False) | (x == Py_None)) return is_true;
   else return PyObject_IsTrue(x);
}
static CYTHON_INLINE PyObject* __Pyx_PyNumber_IntOrLong(PyObject* x) {
  PyNumberMethods *m;
  const char *name = NULL;
  PyObject *res = NULL;
#if PY_MAJOR_VERSION < 3
  if (PyInt_Check(x) || PyLong_Check(x))
#else
  if (PyLong_Check(x))
#endif
    return __Pyx_NewRef(x);
  m = Py_TYPE(x)->tp_as_number;
#if PY_MAJOR_VERSION < 3
  if (m && m->nb_int) {
    name = "int";
    res = PyNumber_Int(x);
  }
  else if (m && m->nb_long) {
    name = "long";
    res = PyNumber_Long(x);
  }
#else
  if (m && m->nb_int) {
    name = "int";
    res = PyNumber_Long(x);
  }
#endif
  if (res) {
#if PY_MAJOR_VERSION < 3
    if (!PyInt_Check(res) && !PyLong_Check(res)) {
#else
    if (!PyLong_Check(res)) {
#endif
      PyErr_Format(PyExc_TypeError,
                   "__%.4s__ returned non-%.4s (type %.200s)",
                   name, name, Py_TYPE(res)->tp_name);
      Py_DECREF(res);
      return NULL;
    }
  }
  else if (!PyErr_Occurred()) {
    PyErr_SetString(PyExc_TypeError,
                    "an integer is required");
  }
  return res;
}
static CYTHON_INLINE Py_ssize_t __Pyx_PyIndex_AsSsize_t(PyObject* b) {
  Py_ssize_t ival;
  PyObject *x;
#if PY_MAJOR_VERSION < 3
  if (likely(PyInt_CheckExact(b))) {
    if (sizeof(Py_ssize_t) >= sizeof(long))
        return PyInt_AS_LONG(b);
    else
        return PyInt_AsSsize_t(x);
  }
#endif
  if (likely(PyLong_CheckExact(b))) {
    #if CYTHON_USE_PYLONG_INTERNALS
    const digit* digits = ((PyLongObject*)b)->ob_digit;
    const Py_ssize_t size = Py_SIZE(b);
    if (likely(__Pyx_sst_abs(size) <= 1)) {
        ival = likely(size) ? digits[0] : 0;
        if (size == -1) ival = -ival;
        return ival;
    } else {
      switch (size) {
         case 2:
           if (8 * sizeof(Py_ssize_t) > 2 * PyLong_SHIFT) {
             return (Py_ssize_t) (((((size_t)digits[1]) << PyLong_SHIFT) | (size_t)digits[0]));
           }
           break;
         case -2:
           if (8 * sizeof(Py_ssize_t) > 2 * PyLong_SHIFT) {
             return -(Py_ssize_t) (((((size_t)digits[1]) << PyLong_SHIFT) | (size_t)digits[0]));
           }
           break;
         case 3:
           if (8 * sizeof(Py_ssize_t) > 3 * PyLong_SHIFT) {
             return (Py_ssize_t) (((((((size_t)digits[2]) << PyLong_SHIFT) | (size_t)digits[1]) << PyLong_SHIFT) | (size_t)digits[0]));
           }
           break;
         case -3:
           if (8 * sizeof(Py_ssize_t) > 3 * PyLong_SHIFT) {
             return -(Py_ssize_t) (((((((size_t)digits[2]) << PyLong_SHIFT) | (size_t)digits[1]) << PyLong_SHIFT) | (size_t)digits[0]));
           }
           break;
         case 4:
           if (8 * sizeof(Py_ssize_t) > 4 * PyLong_SHIFT) {
             return (Py_ssize_t) (((((((((size_t)digits[3]) << PyLong_SHIFT) | (size_t)digits[2]) << PyLong_SHIFT) | (size_t)digits[1]) << PyLong_SHIFT) | (size_t)digits[0]));
           }
           break;
         case -4:
           if (8 * sizeof(Py_ssize_t) > 4 * PyLong_SHIFT) {
             return -(Py_ssize_t) (((((((((size_t)digits[3]) << PyLong_SHIFT) | (size_t)digits[2]) << PyLong_SHIFT) | (size_t)digits[1]) << PyLong_SHIFT) | (size_t)digits[0]));
           }
           break;
      }
    }
    #endif
    return PyLong_AsSsize_t(b);
  }
  x = PyNumber_Index(b);
  if (!x) return -1;
  ival = PyInt_AsSsize_t(x);
  Py_DECREF(x);
  return ival;
}
static CYTHON_INLINE PyObject * __Pyx_PyInt_FromSize_t(size_t ival) {
    return PyInt_FromSize_t(ival);
}


#endif /* Py_PYTHON_H */
